## sound/pci/Kconfig
```kconfig
# ALSA PCI drivers

menu "PCI devices"
	depends on SND!=n && PCI

config SND_AC97_CODEC
	tristate
	select SND_PCM

config SND_ALI5451
	tristate "ALi PCI Audio M5451"
	depends on SND
	select SND_MPU401_UART
	select SND_AC97_CODEC
	help
	  Say 'Y' or 'M' to include support for ALI PCI Audio M5451 sound core.

config SND_ATIIXP
	tristate "ATI IXP 150/200/250/300"
	depends on SND
	select SND_AC97_CODEC
	help
	  Say 'Y' or 'M' to include support for ATI IXP 150/200/250/300 AC97 controller.

config SND_AU8810
        tristate "Aureal Advantage"
        depends on SND
	select SND_MPU401_UART
	select SND_AC97_CODEC
        help
          Say 'Y' or 'M' to include support for Aureal Advantage soundcards.
          Supported features: Hardware Mixer, SRC, EQ and SPDIF output.
          3D support code is in place, but not yet useable. For more info, 
          email the ALSA developer list, or mjander@users.sourceforge.net.
 
config SND_AU8820
        tristate "Aureal Vortex"
        depends on SND
	select SND_MPU401_UART
	select SND_AC97_CODEC
        help
          Say 'Y' or 'M' to include support for Aureal Vortex soundcards.
          Supported features: Hardware Mixer and SRC. For more info, email 
          the ALSA developer list, or mjander@users.sourceforge.net.
 
config SND_AU8830
        tristate "Aureal Vortex 2"
        depends on SND
	select SND_MPU401_UART
	select SND_AC97_CODEC
        help
          Say 'Y' or 'M' to include support for Aureal Vortex 2 soundcards.
          Supported features: Hardware Mixer, SRC, EQ and SPDIF output.
          3D support code is in place, but not yet useable. For more info, 
          email the ALSA developer list, or mjander@users.sourceforge.net.
 
config SND_AZT3328
	tristate "Aztech AZF3328 / PCI168 (EXPERIMENTAL)"
	depends on SND && EXPERIMENTAL
	select SND_OPL3_LIB
	select SND_MPU401_UART
	select SND_PCM
	help
	  Say 'Y' or 'M' to include support for Aztech AZF3328 (PCI168) soundcards.

config SND_BT87X
        tristate "Bt87x Audio Capture"
        depends on SND
	select SND_PCM
        help
          Say 'Y' or 'M' to include support for recording audio from TV cards
          based on Brooktree Bt878/Bt879 chips.

config SND_CS46XX
	tristate "Cirrus Logic (Sound Fusion) CS4280/CS461x/CS462x/CS463x"
	depends on SND
	select SND_RAWMIDI
	select SND_AC97_CODEC
	help
	  Say 'Y' or 'M' to include support for Cirrus Logic CS4610 / CS4612 /
	  CS4614 / CS4615 / CS4622 / CS4624 / CS4630 / CS4280 chips.

config SND_CS46XX_NEW_DSP
	bool "Cirrus Logic (Sound Fusion) New DSP support (EXPERIMENTAL)"
	depends on SND_CS46XX && EXPERIMENTAL
	help
	  Say 'Y' to use a new DSP image for SPDIF and dual codecs.

config SND_CS4281
	tristate "Cirrus Logic (Sound Fusion) CS4281"
	depends on SND
	select SND_OPL3_LIB
	select SND_RAWMIDI
	select SND_AC97_CODEC
	help
	  Say 'Y' or 'M' to include support for Cirrus Logic CS4281.

config SND_EMU10K1
	tristate "EMU10K1 (SB Live! & Audigy, E-mu APS)"
	depends on SND
	select SND_HWDEP
	select SND_RAWMIDI
	select SND_AC97_CODEC
	help
	  Say 'Y' or 'M' to include support for Sound Blaster PCI 512, Live!,
	  Audigy and E-mu APS (partially supported).

config SND_KORG1212
	tristate "Korg 1212 IO"
	depends on SND
	select SND_PCM
	help
	  Say 'Y' or 'M' to include support for Korg 1212IO.

config SND_MIXART
	tristate "Digigram miXart"
	depends on SND
	select SND_HWDEP
	select SND_PCM
	help
	  Say 'Y' or 'M' to include support for Digigram miXart soundcard.

config SND_NM256
	tristate "NeoMagic NM256AV/ZX"
	depends on SND
	select SND_AC97_CODEC
	help
	  Say 'Y' or 'M' to include support for NeoMagic NM256AV/ZX chips.

config SND_RME32
	tristate "RME Digi32, 32/8, 32 PRO"
	depends on SND
	select SND_PCM
	help
	  Say 'Y' or 'M' to include support for RME Digi32, Digi32 PRO and
	  Digi32/8 (Sek'd Prodif32, Prodif96 and Prodif Gold) audio devices.

config SND_RME96
	tristate "RME Digi96, 96/8, 96/8 PRO"
	depends on SND
	select SND_PCM
	help
	  Say 'Y' or 'M' to include support for RME Digi96, Digi96/8 and
	  Digi96/8 PRO/PAD/PST.

config SND_RME9652
	tristate "RME Digi9652 (Hammerfall)"
	depends on SND
	select SND_PCM
	help
	  Say 'Y' or 'M' to include support for RME Hammerfall (RME Digi9652 /
	  Digi9636) soundcards.

config SND_HDSP
	tristate "RME Hammerfall DSP Audio"
	depends on SND
	select SND_HWDEP
	select SND_RAWMIDI
	select SND_PCM
	help
	  Say 'Y' or 'M' to include support for RME Hammerfall DSP Audio
	  soundcards.

config SND_TRIDENT
	tristate "Trident 4D-Wave DX/NX; SiS 7018"
	depends on SND
	select SND_MPU401_UART
	select SND_AC97_CODEC
	help
	  Say 'Y' or 'M' to include support for Trident 4D-Wave DX/NX and
	  SiS 7018 soundcards.

config SND_YMFPCI
	tristate "Yamaha YMF724/740/744/754"
	depends on SND
	select SND_OPL3_LIB
	select SND_MPU401_UART
	select SND_AC97_CODEC
	help
	  Say 'Y' or 'M' to include support for Yamaha PCI audio chips - 
	  YMF724, YMF724F, YMF740, YMF740C, YMF744, YMF754.

config SND_ALS4000
	tristate "Avance Logic ALS4000"
	depends on SND
	select SND_OPL3_LIB
	select SND_MPU401_UART
	select SND_PCM
	help
	  Say 'Y' or 'M' to include support for Avance Logic ALS4000.

config SND_CMIPCI
	tristate "C-Media 8738, 8338"
	depends on SND
	select SND_OPL3_LIB
	select SND_MPU401_UART
	select SND_PCM
	help
	  Say 'Y' or 'M' to include support for C-Media CMI8338 and 8738 PCI
	  soundcards.

config SND_ENS1370
	tristate "(Creative) Ensoniq AudioPCI 1370"
	depends on SND
	select SND_RAWMIDI
	select SND_PCM
	help
	  Say 'Y' or 'M' to include support for Ensoniq AudioPCI ES1370.

config SND_ENS1371
	tristate "(Creative) Ensoniq AudioPCI 1371/1373"
	depends on SND
	select SND_RAWMIDI
	select SND_AC97_CODEC
	help
	  Say 'Y' or 'M' to include support for Ensoniq AudioPCI ES1371 and
	  Sound Blaster PCI 64 or 128 soundcards.

config SND_ES1938
	tristate "ESS ES1938/1946/1969 (Solo-1)"
	depends on SND
	select SND_OPL3_LIB
	select SND_MPU401_UART
	select SND_AC97_CODEC
	help
	  Say 'Y' or 'M' to include support for ESS Solo-1 (ES1938, ES1946, ES1969)
	  soundcard.

config SND_ES1968
	tristate "ESS ES1968/1978 (Maestro-1/2/2E)"
	depends on SND
	select SND_MPU401_UART
	select SND_AC97_CODEC
	help
	  Say 'Y' or 'M' to include support for ESS Maestro 1/2/2E.

config SND_MAESTRO3
	tristate "ESS Allegro/Maestro3"
	depends on SND
	select SND_AC97_CODEC
	help
	  Say 'Y' or 'M' to include support for ESS Maestro 3 (Allegro) soundcard.

config SND_FM801
	tristate "ForteMedia FM801"
	depends on SND
	select SND_OPL3_LIB
	select SND_MPU401_UART
	select SND_AC97_CODEC
	help
	  Say 'Y' or 'M' to include support for ForteMedia FM801 based soundcards.

config SND_FM801_TEA575X
	tristate "ForteMedia FM801 + TEA5757 tuner"
	depends on SND_FM801
        select VIDEO_DEV
	help
	  Say 'Y' or 'M' to include support for ForteMedia FM801 based soundcards
          with TEA5757 tuner connected to GPIO1-3 pins (Media Forte SF256-PCS-02).

config SND_ICE1712
	tristate "ICEnsemble ICE1712 (Envy24)"
	depends on SND
	select SND_MPU401_UART
	select SND_AC97_CODEC
	help
	  Say 'Y' or 'M' to include support for ICE1712 (Envy24) based soundcards.
	  Currently supported hardware is: MidiMan M Audio - Delta 1010(LT), Dio 2496,
	  Delta 66/44, Audiophile 24/96; Hoontech SoundTrack DSP 24 (Value);
	  TerraTec - EWX 24/96, EWS 88MT, EWS 88D, DMX 6Fire.

config SND_ICE1724
	tristate "ICE/VT1724/1720 (Envy24HT/PT)"
	depends on SND
	select SND_MPU401_UART
	select SND_AC97_CODEC
	help
	  Say 'Y' or 'M' to include support for ICE/VT1724/1720 (Envy24HT/PT) based
	  soundcards.
	  Currently supported hardware is: MidiMan M Audio - Revolution 7.1,
	  AMP Ltd AUDIO2000, Terratec Aureon 5.1 Sky/7.1, AudioTrak Prodigy 7.1.

config SND_INTEL8X0
	tristate "Intel i8x0/MX440, SiS 7012; Ali 5455; NForce Audio; AMD768/8111"
	depends on SND
	select SND_MPU401_UART
	select SND_AC97_CODEC
	help
	  Say 'Y' or 'M' to include support for Intel8x0 based soundcards,
	  SiS 7012, AMD768/8111, NVidia NForce and ALi 5455 chips.

config SND_INTEL8X0M
	tristate "Intel i8x0/MX440; AMD768/8111 modems (EXPERIMENTAL)"
	depends on SND && EXPERIMENTAL
	select SND_AC97_CODEC
	help
	  Say 'Y' or 'M' to include support for Intel8x0 and AMD768/8111 based
	  modems.

config SND_SONICVIBES
	tristate "S3 SonicVibes"
	depends on SND
	select SND_OPL3_LIB
	select SND_MPU401_UART
	select SND_AC97_CODEC
	help
	  Say 'Y' or 'M' to include support for S3 SonicVibes based soundcards.

config SND_VIA82XX
	tristate "VIA 82C686A/B, 8233 South Bridge"
	depends on SND
	select SND_MPU401_UART
	select SND_AC97_CODEC
	help
	  Say 'Y' or 'M' to include support for VIA VT82C686A/B, VT8233 South Bridge.

config SND_VX222
	tristate "Digigram VX222"
	depends on SND
	select SND_VX_LIB
	help
	  Say 'Y' or 'M' to include support for Digigram VX222 soundcards.

endmenu
```

## sound/pcmcia/Kconfig
```kconfig
# ALSA PCMCIA drivers

menu "PCMCIA devices"
	depends on SND!=n && PCMCIA

config SND_VXPOCKET
	tristate "Digigram VXpocket"
	depends on SND && PCMCIA && ISA
	select SND_VX_LIB
	help
	  Say 'Y' or 'M' to include support for Digigram VXpocket soundcard.

config SND_VXP440
	tristate "Digigram VXpocket 440"
	depends on SND && PCMCIA && ISA
	select SND_VX_LIB
	help
	  Say 'Y' or 'M' to include support for Digigram VXpocket 440 soundcard.

config SND_PDAUDIOCF
	tristate "Sound Core PDAudioCF"
	depends on SND && PCMCIA && ISA
	select SND_PCM
	help
	  Say 'Y' or 'M' to include support for Sound Core PDAudioCF soundcard.

endmenu
```

## sound/ppc/Kconfig
```kconfig
# ALSA PowerMac drivers

menu "ALSA PowerMac devices"
	depends on SND!=n && PPC

comment "ALSA PowerMac requires I2C"
	depends on SND && I2C=n

config SND_POWERMAC
	tristate "PowerMac (AWACS, DACA, Burgundy, Tumbler, Keywest)"
	depends on SND && I2C
	select SND_PCM

endmenu
```

## sound/soc/amd/Kconfig
```kconfig
config SND_SOC_AMD_ACP
	tristate "AMD Audio Coprocessor support"
	help
	 This option enables ACP DMA support on AMD platform.
config SND_SOC_AMD_ACP3x
	tristate "AMD Audio Coprocessor-v3.x support"
	help
	 This option enables ACP v3.x I2S support on AMD platform.
config SND_SOC_AMD_CZ_RT5645_MACH
	tristate "AMD CZ support for RT5645"
	select SND_SOC_RT5645
	select SND_SOC_AMD_ACP
	depends on I2C_DESIGNWARE_PLATFORM
	help
	 This option enables machine driver for rt5645.
```
