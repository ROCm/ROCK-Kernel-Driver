## sound/isa/Kconfig
```kconfig
# ALSA ISA drivers

menu "ISA devices"
	depends on SND!=n && ISA

config SND_AD1816A
	tristate "Analog Devices SoundPort AD1816A"
	depends on SND && ISAPNP
	select SND_OPL3_LIB
	select SND_MPU401_UART
	select SND_PCM
	help
	  Say 'Y' or 'M' to include support for Analog Devices SoundPort AD1816A or
	  compatible sound chips.

config SND_AD1848
	tristate "Generic AD1848/CS4248 driver"
	depends on SND
	select SND_PCM
	help
	  Say 'Y' or 'M' to include support for AD1848 (Analog Devices) or CS4248 
	  (Cirrus Logic - Crystal Semiconductors) chips. Please, for newer chips
	  from Cirrus Logic, use CS4231, CS4232 or CS4236+ driver.

config SND_CS4231
	tristate "Generic Cirrus Logic CS4231 driver"
	depends on SND
	select SND_MPU401_UART
	select SND_PCM
	help
	  Say 'Y' or 'M' to include support for CS4231 chips from Cirrus Logic -
	  Crystal Semiconductors.

config SND_CS4232
	tristate "Generic Cirrus Logic CS4232 driver"
	depends on SND
	select SND_OPL3_LIB
	select SND_MPU401_UART
	select SND_PCM
	help
	  Say 'Y' or 'M' to include support for CS4232 chips from Cirrus Logic -
	  Crystal Semiconductors.

config SND_CS4236
	tristate "Generic Cirrus Logic CS4236+ driver"
	depends on SND
	select SND_OPL3_LIB
	select SND_MPU401_UART
	select SND_PCM
	help
	  Say 'Y' or 'M' to include support for CS4235,CS4236,CS4237B,CS4238B,CS4239
	  chips from Cirrus Logic - Crystal Semiconductors.

config SND_ES968
	tristate "Generic ESS ES968 driver"
	depends on SND && ISAPNP
	select SND_MPU401_UART
	select SND_PCM
	help
	  Say 'Y' or 'M' to include support for ESS AudioDrive ES968 chip.

config SND_ES1688
	tristate "Generic ESS ES688/ES1688 driver"
	depends on SND
	select SND_OPL3_LIB
	select SND_MPU401_UART
	select SND_PCM
	help
	  Say 'Y' or 'M' to include support for ESS AudioDrive ES688 or ES1688 chips.

config SND_ES18XX
	tristate "Generic ESS ES18xx driver"
	depends on SND
	select SND_OPL3_LIB
	select SND_MPU401_UART
	select SND_PCM
	help
	  Say 'Y' or 'M' to include support for ESS AudioDrive ES18xx chips.

config SND_GUSCLASSIC
	tristate "Gravis UltraSound Classic"
	depends on SND
	select SND_RAWMIDI
	select SND_PCM
	help
	  Say 'Y' or 'M' to include support for Gravis UltraSound Classic soundcard.

config SND_GUSEXTREME
	tristate "Gravis UltraSound Extreme"
	depends on SND
	select SND_HWDEP
	select SND_MPU401_UART
	select SND_PCM
	help
	  Say 'Y' or 'M' to include support for Gravis UltraSound Extreme soundcard.

config SND_GUSMAX
	tristate "Gravis UltraSound MAX"
	depends on SND
	select SND_RAWMIDI
	select SND_PCM
	help
	  Say 'Y' or 'M' to include support for Gravis UltraSound MAX soundcard.

config SND_INTERWAVE
	tristate "AMD InterWave, Gravis UltraSound PnP"
	depends on SND
	select SND_RAWMIDI
	select SND_PCM
	help
	  Say 'Y' or 'M' to include support for AMD InterWave based soundcards
	  (Gravis UltraSound Plug & Play, STB SoundRage32, MED3210, Dynasonic Pro,
	  Panasonic PCA761AW).

config SND_INTERWAVE_STB
	tristate "AMD InterWave + TEA6330T (UltraSound 32-Pro)"
	depends on SND
	select SND_RAWMIDI
	select SND_PCM
	help
	  Say 'Y' or 'M' to include support for AMD InterWave based soundcards
	  with TEA6330T bass and treble regulator (UltraSound 32-Pro).

config SND_OPTI92X_AD1848
	tristate "OPTi 82C92x - AD1848"
	depends on SND
	select SND_OPL3_LIB
	select SND_OPL4_LIB
	select SND_MPU401_UART
	select SND_PCM
	help
	  Say 'Y' or 'M' to include support for Opti92x soundcards equiped with
	  AD1848 codec.

config SND_OPTI92X_CS4231
	tristate "OPTi 82C92x - CS4231"
	depends on SND
	select SND_OPL3_LIB
	select SND_OPL4_LIB
	select SND_MPU401_UART
	select SND_PCM
	help
	  Say 'Y' or 'M' to include support for Opti92x soundcards equiped with
	  CS4231 codec.

config SND_OPTI93X
	tristate "OPTi 82C93x"
	depends on SND
	select SND_OPL3_LIB
	select SND_MPU401_UART
	select SND_PCM
	help
	  Say 'Y' or 'M' to include support for Opti93x soundcards.

config SND_SB8
	tristate "Sound Blaster 1.0/2.0/Pro (8-bit)"
	depends on SND
	select SND_OPL3_LIB
	select SND_RAWMIDI
	select SND_PCM
	help
	  Say 'Y' or 'M' to include support for Sound Blaster 1.0/2.0/Pro (8-bit)
	  soundcards or 100% compatible from Creative.

config SND_SB16
	tristate "Sound Blaster 16 (PnP)"
	depends on SND
	select SND_OPL3_LIB
	select SND_MPU401_UART
	select SND_PCM
	help
	  Say 'Y' or 'M' to include support for Sound Blaster 16 (including
	  Plug and Play version).

config SND_SBAWE
	tristate "Sound Blaster AWE (32,64) (PnP)"
	depends on SND
	select SND_OPL3_LIB
	select SND_MPU401_UART
	select SND_PCM
	help
	  Say 'Y' or 'M' to include support for Sound Blaster AWE (including
	  Plug and Play version).

config SND_SB16_CSP
	bool "Sound Blaster 16/AWE CSP support"
	depends on (SND_SB16 || SND_SBAWE) && (BROKEN || !PPC)
	help
	  Say 'Y' to include support for CSP core. This special coprocessor
	  can do variable tasks like various compression and decompression
	  algorithms.

config SND_WAVEFRONT
	tristate "Turtle Beach Maui,Tropez,Tropez+ (Wavefront)"
	depends on SND
	select SND_OPL3_LIB
	select SND_MPU401_UART
	select SND_PCM
	help
	  Say 'Y' or 'M' to include support for Turtle Beach Maui, Tropez
	  and Tropez+ soundcards based on Wavefront chip.

config SND_ALS100
	tristate "Avance Logic ALS100/ALS120"
	depends on SND && ISAPNP
	select SND_OPL3_LIB
	select SND_MPU401_UART
	select SND_PCM
	help
	  Say 'Y' or 'M' to include support for Avance Logic ALS100, ALS110,
	  ALS120 and ALS200 soundcards.

config SND_AZT2320
	tristate "Aztech Systems AZT2320"
	depends on SND && ISAPNP
	select SND_OPL3_LIB
	select SND_MPU401_UART
	select SND_PCM
	help
	  Say 'Y' or 'M' to include support for Aztech Systems AZT2320 soundcard.

config SND_CMI8330
	tristate "C-Media CMI8330"
	depends on SND
	select SND_PCM
	help
	  Say 'Y' or 'M' to include support for C-Media CMI8330 based soundcards.

config SND_DT019X
	tristate "Diamond Technologies DT-019X, Avance Logic ALS-007"
	depends on SND && ISAPNP
	select SND_OPL3_LIB
	select SND_MPU401_UART
	select SND_PCM
	help
	  Say 'Y' or 'M' to include support for Diamond Technologies DT-019X and
	  Avance Logic ALS-007 soundcards.

config SND_OPL3SA2
	tristate "Yamaha OPL3-SA2/SA3"
	depends on SND
	select SND_OPL3_LIB
	select SND_MPU401_UART
	select SND_PCM
	help
	  Say 'Y' or 'M' to include support for Yamaha OPL3SA2 or OPL3SA3 chips.

config SND_SGALAXY
	tristate "Aztech Sound Galaxy"
	depends on SND
	select SND_PCM
	help
	  Say 'Y' or 'M' to include support for Aztech Sound Galaxy.

config SND_SSCAPE
	tristate "Ensoniq SoundScape PnP driver"
	depends on SND
	select SND_HWDEP
	select SND_MPU401_UART
	select SND_PCM
	help
	  Say 'Y' or 'M' to include support for Ensoniq SoundScape PnP
	  soundcard.

endmenu
```

## sound/oss/dmasound/Kconfig
```kconfig
# drivers/sound/dmasound/Config.in
config DMASOUND_ATARI
	tristate "Atari DMA sound support"
	depends on ATARI && SOUND
	help
	  If you want to use the internal audio of your Atari in Linux, answer
	  Y to this question. This will provide a Sun-like /dev/audio,
	  compatible with the Linux/i386 sound system. Otherwise, say N.

	  This driver is also available as a module ( = code which can be
	  inserted in and removed from the running kernel whenever you
	  want). If you want to compile it as a module, say M here and read
	  <file:Documentation/modules.txt>.

config DMASOUND_AWACS
	tristate "PowerMac DMA sound support"
	depends on PPC_PMAC && SOUND
	help
	  If you want to use the internal audio of your PowerMac in Linux,
	  answer Y to this question. This will provide a Sun-like /dev/audio,
	  compatible with the Linux/i386 sound system. Otherwise, say N.

	  This driver is also available as a module ( = code which can be
	  inserted in and removed from the running kernel whenever you
	  want). If you want to compile it as a module, say M here and read
	  <file:Documentation/modules.txt>.

config DMASOUND_PAULA
	tristate "Amiga DMA sound support"
	depends on (AMIGA || APUS) && SOUND
	help
	  If you want to use the internal audio of your Amiga in Linux, answer
	  Y to this question. This will provide a Sun-like /dev/audio,
	  compatible with the Linux/i386 sound system. Otherwise, say N.

	  This driver is also available as a module ( = code which can be
	  inserted in and removed from the running kernel whenever you
	  want). If you want to compile it as a module, say M here and read
	  <file:Documentation/modules.txt>.

config DMASOUND_Q40
	tristate "Q40 sound support"
	depends on Q40 && SOUND
	help
	  If you want to use the internal audio of your Q40 in Linux, answer
	  Y to this question. This will provide a Sun-like /dev/audio,
	  compatible with the Linux/i386 sound system. Otherwise, say N.

	  This driver is also available as a module ( = code which can be
	  inserted in and removed from the running kernel whenever you
	  want). If you want to compile it as a module, say M here and read
	  <file:Documentation/modules.txt>.

config DMASOUND
	tristate
	depends on SOUND!=n
	default m if DMASOUND_ATARI!=y && DMASOUND_AWACS!=y && DMASOUND_PAULA!=y && DMASOUND_Q40!=y && (DMASOUND_ATARI=m || DMASOUND_AWACS=m || DMASOUND_PAULA=m || DMASOUND_Q40=m)
	default y if DMASOUND_ATARI=y || DMASOUND_AWACS=y || DMASOUND_PAULA=y || DMASOUND_Q40=y
	help
	  Support built-in audio chips accessible by DMA on various machines
	  that have them.  Note that this symbol does not affect the kernel
	  directly; rather, it controls whether configuration questions
	  enabling DMA sound drivers for various specific machine
	  architectures will be used.
```

## sound/parisc/Kconfig
```kconfig
# ALSA PA-RISC drivers

menu "ALSA PA-RISC devices"
	depends on SND!=n && PARISC

config SND_HARMONY
	tristate "Harmony/Vivace sound chip"
	depends on SND
	select SND_PCM
	help
	  Say Y here to include support for the Harmony/Vivace soundchip
	  on HP712s, 715/new and many other GSC based machines.

	  To compile this driver as a module, choose M here: the module
	  will be called snd-harmony.

endmenu
```
