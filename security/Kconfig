## security/Kconfig
```kconfig
#
# Security configuration
#

menu "Security options"

config SECURITY
	bool "Enable different security models"
	help
	  This allows you to choose different security modules to be
	  configured into your kernel.

	  If this option is not selected, the default Linux security
	  model will be used.

	  If you are unsure how to answer this question, answer N.

config SECURITY_NETWORK
	bool "Socket and Networking Security Hooks"
	depends on SECURITY
	help
	  This enables the socket and networking security hooks.
	  If enabled, a security module can use these hooks to
	  implement socket and networking access controls.
	  If you are unsure how to answer this question, answer N.

config SECURITY_CAPABILITIES
	tristate "Default Linux Capabilities"
	depends on SECURITY!=n
	help
	  This enables the "default" Linux capabilities functionality.
	  If you are unsure how to answer this question, answer Y.

config SECURITY_CAPABILITIES_BOOTPARAM
        bool "Capabilities boot parameter"
        depends on SECURITY_CAPABILITIES
        default n
        help
          This option adds a kernel parameter 'capabilities', which allows 
	  Capabilities to be disabled at boot.  If this option is selected, 
	  SECURITY_CAPABILITIES functionality can be disabled with 
	  capabilities=0 on the kernel command line.  The purpose of this 
	  option is to allow a single kernel image to be distributed with 
	  Capabilities built in, but not necessarily enabled.  

	  It is expected that capabilities will be disabled along with also 
	  disabling SELinux (if configured, see SECURITY_SELINUX_BOOTPARAM) 
	  thereby allowing a alternative security policy to be loaded via a 
	  kernel module.  N.B. Any third party security modules loaded in this 
	  manner should compose the functionality of the Capability module 
	  (depend on the commoncap module).

          If you are unsure how to answer this question, answer N.


config SECURITY_ROOTPLUG
	tristate "Root Plug Support"
	depends on USB && SECURITY!=n
	help
	  This is a sample LSM module that should only be used as such.
	  It prevents any programs running with egid == 0 if a specific
	  USB device is not present in the system.

	  See <http://www.linuxjournal.com/article.php?sid=6279> for
	  more information about this module.
	  
	  If you are unsure how to answer this question, answer N.

source security/selinux/Kconfig

endmenu
```

## security/apparmor/Kconfig
```kconfig
config SECURITY_APPARMOR
	bool "AppArmor support"
	depends on SECURITY && NET
	select AUDIT
	select SECURITY_PATH
	select SECURITYFS
	select SECURITY_NETWORK
	default n
	help
	  This enables the AppArmor security module.
	  Required userspace tools (if they are not included in your
	  distribution) and further information may be found at
	  http://apparmor.wiki.kernel.org

	  If you are unsure how to answer this question, answer N.

config SECURITY_APPARMOR_BOOTPARAM_VALUE
	int "AppArmor boot parameter default value"
	depends on SECURITY_APPARMOR
	range 0 1
	default 1
	help
	  This option sets the default value for the kernel parameter
	  'apparmor', which allows AppArmor to be enabled or disabled
          at boot.  If this option is set to 0 (zero), the AppArmor
	  kernel parameter will default to 0, disabling AppArmor at
	  boot.  If this option is set to 1 (one), the AppArmor
	  kernel parameter will default to 1, enabling AppArmor at
	  boot.

	  If you are unsure how to answer this question, answer 1.

config SECURITY_APPARMOR_COMPAT_24
	bool "Enable AppArmor 2.4 compatability"
	depends on SECURITY_APPARMOR
	default y
	help
	  This option enables compatability with AppArmor 2.4.  It is
          recommended if compatability with older versions of AppArmor
          is desired.
```

## security/rsa/Kconfig
```kconfig
config SECURITY_RSA
	tristate "RSA crap"
	help
	  bah bah bah...

	  If you are unsure how to answer this question, answer N.
```

## security/selinux/Kconfig
```kconfig
config SECURITY_SELINUX
	bool "NSA SELinux Support"
	depends on SECURITY
	default n
	help
	  This selects NSA Security-Enhanced Linux (SELinux).
	  You will also need a policy configuration and a labeled filesystem.
	  You can obtain the policy compiler (checkpolicy), the utility for
	  labeling filesystems (setfiles), and an example policy configuration
	  from <http://www.nsa.gov/selinux/>.
	  If you are unsure how to answer this question, answer N.

config SECURITY_SELINUX_BOOTPARAM
	bool "NSA SELinux boot parameter"
	depends on SECURITY_SELINUX
	default n
	help
	  This option adds a kernel parameter 'selinux', which allows SELinux
	  to be disabled at boot.  If this option is selected, SELinux
	  functionality can be disabled with selinux=0 on the kernel
	  command line.  The purpose of this option is to allow a single
	  kernel image to be distributed with SELinux built in, but not
	  necessarily enabled.

	  If you are unsure how to answer this question, answer N.

config SECURITY_SELINUX_DEVELOP
	bool "NSA SELinux Development Support"
	depends on SECURITY_SELINUX
	default y
	help
	  This enables the development support option of NSA SELinux,
	  which is useful for experimenting with SELinux and developing
	  policies.  If unsure, say Y.  With this option enabled, the
	  kernel will start in permissive mode (log everything, deny nothing)
	  unless you specify enforcing=1 on the kernel command line.  You
	  can interactively toggle the kernel between enforcing mode and
	  permissive mode (if permitted by the policy) via /selinux/enforce.

config SECURITY_SELINUX_MLS
	bool "NSA SELinux MLS policy (EXPERIMENTAL)"
	depends on SECURITY_SELINUX && EXPERIMENTAL
	default n
	help
	  This enables the NSA SELinux Multi-Level Security (MLS) policy in
	  addition to the default RBAC/TE policy.  This policy is
	  experimental and has not been configured for use.  Unless you
	  specifically want to experiment with MLS, say N.
```

## sound/Config.in
```kconfig
# sound/Config.in
#

mainmenu_option next_comment
comment 'Open Sound System'

dep_tristate 'Open Sound System' CONFIG_SOUND_PRIME $CONFIG_SOUND
if [ "$CONFIG_SOUND_PRIME" != "n" ]; then
  source sound/oss/Config.in
fi

endmenu

mainmenu_option next_comment
comment 'Advanced Linux Sound Architecture'

dep_tristate 'Advanced Linux Sound Architecture' CONFIG_SND $CONFIG_SOUND
if [ "$CONFIG_SND" != "n" ]; then
  source sound/core/Config.in
  source sound/drivers/Config.in
fi
if [ "$CONFIG_SND" != "n" -a "$CONFIG_ISA" = "y" ]; then
  source sound/isa/Config.in
fi
if [ "$CONFIG_SND" != "n" -a "$CONFIG_PCI" = "y" ]; then
  source sound/pci/Config.in
fi
if [ "$CONFIG_SND" != "n" -a "$CONFIG_PPC" = "y" ]; then
  source sound/ppc/Config.in
fi
if [ "$CONFIG_SND" != "n" -a "$CONFIG_ARM" = "y" ]; then
  source sound/arm/Config.in
fi
# the following will depenend on the order of config.
# here assuming USB is defined before ALSA
if [ "$CONFIG_SND" != "n" -a "$CONFIG_USB" != "n" ]; then
  source sound/usb/Config.in
fi
if [ "$CONFIG_SND" != "n" ]; then
  if [ "$CONFIG_SPARC32" = "y" -o "$CONFIG_SPARC64" = "y" ]; then
    source sound/sparc/Config.in
  fi
fi

endmenu
```

## sound/Kconfig
```kconfig
# sound/Config.in
#

menu "Advanced Linux Sound Architecture"
	depends on SOUND!=n

config SND
	tristate "Advanced Linux Sound Architecture"
	depends on SOUND

source "sound/core/Kconfig"

source "sound/drivers/Kconfig"

source "sound/isa/Kconfig"

source "sound/pci/Kconfig"

source "sound/ppc/Kconfig"

source "sound/arm/Kconfig"

# the following will depenend on the order of config.
# here assuming USB is defined before ALSA
source "sound/usb/Kconfig"

# the following will depenend on the order of config.
# here assuming PCMCIA is defined before ALSA
source "sound/pcmcia/Kconfig"

source "sound/sparc/Kconfig"

source "sound/parisc/Kconfig"

endmenu

menu "Open Sound System"
	depends on SOUND!=n

config SOUND_PRIME
	tristate "Open Sound System (DEPRECATED)"
	depends on SOUND
	help
	  Say 'Y' or 'M' to enable Open Sound System drivers.

source "sound/oss/Kconfig"

endmenu
```

## sound/arm/Kconfig
```kconfig
# ALSA ARM drivers

menu "ALSA ARM devices"
	depends on SND!=n && ARM

config SND_SA11XX_UDA1341
	tristate "SA11xx UDA1341TS driver (H3600)"
	depends on ARCH_SA1100 && SND && L3
	help
	  Say Y or M if you have a Compaq iPaq H3x00 handheld computer and want
	  to use its Philips UDA 1341 audio chip.

endmenu
```

## sound/core/Kconfig
```kconfig
# ALSA soundcard-configuration
config SND_TIMER
	tristate

config SND_PCM
	tristate
	select SND_TIMER

config SND_HWDEP
	tristate

config SND_RAWMIDI
	tristate

config SND_SEQUENCER
	tristate "Sequencer support"
	depends on SND
	select SND_TIMER
	help
	  Say 'Y' or 'M' to enable MIDI sequencer and router support. This feature
	  allows routing and enqueing MIDI events. Events can be processed at given
	  time.

config SND_SEQ_DUMMY
	tristate "Sequencer dummy client"
	depends on SND_SEQUENCER
	help
	  Say 'Y' or 'M' to enable dummy sequencer client. This client is a simple
	  midi-through client. All normal input events are redirected to output port
	  immediately.

config SND_OSSEMUL
	bool

config SND_MIXER_OSS
	tristate "OSS Mixer API"
	depends on SND
	select SND_OSSEMUL
	help
	  Say 'Y' or 'M' to enable mixer OSS API emulation (/dev/mixer*).

config SND_PCM_OSS
	tristate "OSS PCM (digital audio) API"
	depends on SND
	select SND_OSSEMUL
	select SND_PCM
	help
	  Say 'Y' or 'M' to enable digital audio (PCM) OSS API emulation (/dev/dsp*).

config SND_SEQUENCER_OSS
	bool "OSS Sequencer API"
	depends on SND_SEQUENCER
	select SND_OSSEMUL
	help
	  Say 'Y' to enable OSS sequencer emulation (both /dev/sequencer and
	  /dev/music interfaces).

config SND_BIT32_EMUL
	tristate "Emulation for 32-bit applications"
	depends on SND && (MIPS64 || SPARC64 || PPC64 || X86_64 && IA32_EMULATION)
	select SND_PCM
	select SND_RAWMIDI
	select SND_TIMER
	select SND_HWDEP
	help
	  Say 'Y' or 'M' to enable the emulation for 32-bit ALSA-native
	  applications.

config SND_RTCTIMER
	tristate "RTC Timer support"
	depends on SND && RTC
	select SND_TIMER
	help
	  Say 'Y' or 'M' to enable RTC timer support for ALSA. ALSA code uses RTC
	  timer as precise timing source and maps the RTC timer to the ALSA's timer
	  interface. ALSA sequencer code can also use this timing source.

config SND_VERBOSE_PRINTK
	bool "Verbose printk"
	depends on SND
	help
	  Say 'Y' to enable verbose log messages. These messages will help to
	  identify source file and position containing printed messages.

config SND_DEBUG
	bool "Debug"
	depends on SND
	help
	  Say 'Y' to enable ALSA debug code.

config SND_DEBUG_MEMORY
	bool "Debug memory"
	depends on SND_DEBUG
	help
	  Say 'Y' to enable debugging of memory allocation.

config SND_DEBUG_DETECT
	bool "Debug detection"
	depends on SND_DEBUG
```

## sound/drivers/Kconfig
```kconfig
# ALSA generic drivers

menu "Generic devices"
	depends on SND!=n


config SND_MPU401_UART
        tristate
	select SND_TIMER
        select SND_RAWMIDI

config SND_OPL3_LIB
	tristate
	select SND_TIMER
	select SND_HWDEP

config SND_OPL4_LIB
	tristate
	select SND_TIMER
	select SND_HWDEP

config SND_VX_LIB
	tristate
	select SND_HWDEP
	select SND_PCM


config SND_DUMMY
	tristate "Dummy (/dev/null) soundcard"
	depends on SND
	select SND_PCM
	help
	  Say 'Y' or 'M' to include dummy driver. This driver does nothing, but
	  emulates various mixer controls and PCM devices.

config SND_VIRMIDI
	tristate "Virtual MIDI soundcard"
	depends on SND_SEQUENCER
	select SND_TIMER
	select SND_RAWMIDI
	help
	  Say 'Y' or 'M' to include virtual MIDI driver. This driver allows to
	  connect applications using raw MIDI devices to sequencer.

config SND_MTPAV
	tristate "MOTU MidiTimePiece AV multiport MIDI"
	depends on SND
	select SND_TIMER
	select SND_RAWMIDI
	help
	  Say 'Y' or 'M' to include support for MOTU MidiTimePiece AV multiport
	  MIDI adapter.

config SND_SERIAL_U16550
	tristate "UART16550 - MIDI only driver"
	depends on SND
	select SND_TIMER
	select SND_RAWMIDI
	help
	  Say 'Y' or 'M' to include support for MIDI serial port driver. It works
	  with serial UARTs 16550 and better.

config SND_MPU401
	tristate "Generic MPU-401 UART driver"
	depends on SND
	select SND_MPU401_UART
	help
	  Say 'Y' or 'M' to include support for MPU401 hardware using UART access.

endmenu
```
