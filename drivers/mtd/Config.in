## drivers/net/Config.in
```kconfig
#
# Network device configuration
#

source drivers/net/arcnet/Config.in
source drivers/net/appletalk/Config.in

tristate 'Dummy net driver support' CONFIG_DUMMY
tristate 'Bonding driver support' CONFIG_BONDING
tristate 'EQL (serial line load balancing) support' CONFIG_EQUALIZER
tristate 'Universal TUN/TAP device driver support' CONFIG_TUN
if [ "$CONFIG_EXPERIMENTAL" = "y" ]; then
   if [ "$CONFIG_NETLINK" = "y" ]; then
      tristate 'Ethertap network tap (OBSOLETE)' CONFIG_ETHERTAP
   fi
fi

tristate 'General Instruments Surfboard 1000' CONFIG_NET_SB1000

#
#	Ethernet
#

mainmenu_option next_comment
comment 'Ethernet (10 or 100Mbit)'

bool 'Ethernet (10 or 100Mbit)' CONFIG_NET_ETHERNET
if [ "$CONFIG_NET_ETHERNET" = "y" ]; then
   if [ "$CONFIG_ARM" = "y" ]; then
      if [ "$CONFIG_ARCH_ACORN" != "y" ]; then
	 tristate '  AM79C961A support' CONFIG_ARM_AM79C961A
      else
	 source drivers/acorn/net/Config.in
      fi
   fi
   if [ "$CONFIG_PPC" = "y" ]; then
      tristate '  MACE (Power Mac ethernet) support' CONFIG_MACE
      tristate '  BMAC (G3 ethernet) support' CONFIG_BMAC
      tristate '  GMAC (G4/iBook ethernet) support' CONFIG_GMAC
      tristate '  Symbios 53c885 (Synergy ethernet) support' CONFIG_NCR885E
      tristate '  National DP83902AV (Oak ethernet) support' CONFIG_OAKNET
   fi
   if [ "$CONFIG_ZORRO" = "y" ]; then
      tristate '  Ariadne support' CONFIG_ARIADNE
      tristate '  Ariadne II and X-Surf support' CONFIG_NE2K_ZORRO
      tristate '  A2065 support' CONFIG_A2065
      tristate '  Hydra support' CONFIG_HYDRA
   fi
   if [ "$CONFIG_MIPS_JAZZ" = "y" ]; then
      tristate '  MIPS JAZZ onboard SONIC Ethernet support' CONFIG_MIPS_JAZZ_SONIC
   fi
   if [ "$CONFIG_SGI_IP27" = "y" ]; then
      bool '  SGI IOC3 Ethernet' CONFIG_SGI_IOC3_ETH
   fi
   if [ "CONFIG_IA64_SGI_SN1" = "y" ]; then
      bool '  SGI IOC3 Ethernet' CONFIG_SGI_IOC3_ETH
   fi
   if [ "$CONFIG_SUPERH" = "y" ]; then
      tristate '  National DP83902AV  support' CONFIG_STNIC
   fi
   bool '  3COM cards' CONFIG_NET_VENDOR_3COM
   if [ "$CONFIG_NET_VENDOR_3COM" = "y" ]; then
      dep_tristate '    3c501 "EtherLink" support' CONFIG_EL1 $CONFIG_ISA
      dep_tristate '    3c503 "EtherLink II" support' CONFIG_EL2 $CONFIG_ISA
      dep_tristate '    3c505 "EtherLink Plus" support' CONFIG_ELPLUS $CONFIG_ISA
      dep_tristate '    3c507 "EtherLink 16" support (EXPERIMENTAL)' CONFIG_EL16 $CONFIG_ISA $CONFIG_EXPERIMENTAL
      if [ "$CONFIG_ISA" = "y" -o "$CONFIG_EISA" = "y" -o "$CONFIG_MCA" = "y" ]; then
         tristate '    3c509/3c529 (MCA)/3c579 "EtherLink III" support' CONFIG_EL3
      fi
      if [ "$CONFIG_ISA" = "y" -o "$CONFIG_EISA" = "y" ]; then
         tristate '    3c515 ISA "Fast EtherLink"' CONFIG_3C515
      fi
      dep_tristate '    3c523 "EtherLink/MC" support' CONFIG_ELMC $CONFIG_MCA
      dep_tristate '    3c527 "EtherLink/MC 32" support (EXPERIMENTAL)' CONFIG_ELMC_II $CONFIG_MCA $CONFIG_EXPERIMENTAL
      if [ "$CONFIG_PCI" = "y" -o "$CONFIG_EISA" = "y" ]; then
         tristate '    3c590/3c900 series (592/595/597) "Vortex/Boomerang" support' CONFIG_VORTEX
      fi
   fi
   dep_tristate '  AMD LANCE and PCnet (AT1500 and NE2100) support' CONFIG_LANCE $CONFIG_ISA
   bool '  Western Digital/SMC cards' CONFIG_NET_VENDOR_SMC
   if [ "$CONFIG_NET_VENDOR_SMC" = "y" ]; then
      tristate '    WD80*3 support' CONFIG_WD80x3
      if [ "$CONFIG_MCA" = "y" ]; then
	 tristate '    SMC Ultra MCA support' CONFIG_ULTRAMCA
      fi
      tristate '    SMC Ultra support' CONFIG_ULTRA
      dep_tristate '    SMC Ultra32 EISA support' CONFIG_ULTRA32 $CONFIG_EISA
      tristate '    SMC 9194 support' CONFIG_SMC9194
   fi
   bool '  Racal-Interlan (Micom) NI cards' CONFIG_NET_VENDOR_RACAL
   if [ "$CONFIG_NET_VENDOR_RACAL" = "y" ]; then
      dep_tristate '    NI5010 support (EXPERIMENTAL)' CONFIG_NI5010 $CONFIG_EXPERIMENTAL
      tristate '    NI5210 support' CONFIG_NI52
      tristate '    NI6510 support' CONFIG_NI65
   fi
   if [ "$CONFIG_EXPERIMENTAL" = "y" ]; then
      tristate '  AT1700/1720 support (EXPERIMENTAL)' CONFIG_AT1700
   fi
   tristate '  DEPCA, DE10x, DE200, DE201, DE202, DE422 support' CONFIG_DEPCA
   if [ "$CONFIG_ISA" = "y" -o "$CONFIG_EISA" = "y" -o "$CONFIG_PCI" = "y" ]; then
      tristate '  HP 10/100VG PCLAN (ISA, EISA, PCI) support' CONFIG_HP100
   fi
   dep_bool '  Other ISA cards' CONFIG_NET_ISA $CONFIG_ISA
   if [ "$CONFIG_NET_ISA" = "y" ]; then
      tristate '    Cabletron E21xx support' CONFIG_E2100
      if [ "$CONFIG_OBSOLETE" = "y" ]; then
         tristate '    EtherWORKS 3 (DE203, DE204, DE205) support' CONFIG_EWRK3
      fi
      tristate '    EtherExpress 16 support' CONFIG_EEXPRESS
      tristate '    EtherExpressPro support/EtherExpress 10 (i82595) support' CONFIG_EEXPRESS_PRO
      if [ "$CONFIG_OBSOLETE" = "y" ]; then
         tristate '    FMV-181/182/183/184 support' CONFIG_FMV18X
      fi
      tristate '    HP PCLAN+ (27247B and 27252A) support' CONFIG_HPLAN_PLUS
      tristate '    HP PCLAN (27245 and other 27xxx series) support' CONFIG_HPLAN
      tristate '    ICL EtherTeam 16i/32 support' CONFIG_ETH16I
      tristate '    NE2000/NE1000 support' CONFIG_NE2000
      if [ "$CONFIG_OBSOLETE" = "y" ]; then
	 tristate '    SEEQ8005 support (EXPERIMENTAL)' CONFIG_SEEQ8005
      fi
      tristate '    SK_G16 support' CONFIG_SK_G16
   fi
   if [ "$CONFIG_MCA" = "y" ]; then
      tristate '  SKnet MCA support' CONFIG_SKMC
      tristate '  NE/2 (ne2000 MCA version) support' CONFIG_NE2_MCA
      tristate '  IBM LAN Adapter/A support' CONFIG_IBMLANA
   fi
   bool '  EISA, VLB, PCI and on board controllers' CONFIG_NET_PCI
   if [ "$CONFIG_NET_PCI" = "y" ]; then
      dep_tristate '    AMD PCnet32 PCI support' CONFIG_PCNET32 $CONFIG_PCI
      dep_tristate '    Adaptec Starfire support (EXPERIMENTAL)' CONFIG_ADAPTEC_STARFIRE $CONFIG_PCI $CONFIG_EXPERIMENTAL
      if [ "$CONFIG_ISA" = "y" -o "$CONFIG_EISA" = "y" ]; then
	 dep_tristate '    Ansel Communications EISA 3200 support (EXPERIMENTAL)' CONFIG_AC3200 $CONFIG_EXPERIMENTAL
      fi

      tristate '    Apricot Xen-II on board Ethernet' CONFIG_APRICOT
      dep_tristate '    CS89x0 support' CONFIG_CS89x0 $CONFIG_ISA
      dep_tristate '    DECchip Tulip (dc21x4x) PCI support' CONFIG_TULIP $CONFIG_PCI
      if [ "$CONFIG_PCI" = "y" -o "$CONFIG_EISA" = "y" ]; then
         tristate '    Generic DECchip & DIGITAL EtherWORKS PCI/EISA' CONFIG_DE4X5
         tristate '    Digi Intl. RightSwitch SE-X support' CONFIG_DGRS
      fi
      dep_tristate '    DM9102 PCI Fast Ethernet Adapter support (EXPERIMENTAL)' CONFIG_DM9102 $CONFIG_PCI $CONFIG_EXPERIMENTAL
      dep_tristate '    EtherExpressPro/100 support' CONFIG_EEPRO100 $CONFIG_PCI
      dep_mbool '      Enable Power Management (EXPERIMENTAL)' CONFIG_EEPRO100_PM $CONFIG_EEPRO100 $CONFIG_EXPERIMENTAL
      dep_tristate '    Mylex EISA LNE390A/B support (EXPERIMENTAL)' CONFIG_LNE390 $CONFIG_EISA $CONFIG_EXPERIMENTAL
      dep_tristate '    National Semiconductor DP83810 series PCI Ethernet support' CONFIG_NATSEMI $CONFIG_PCI
      dep_tristate '    PCI NE2000 and clones support (see help)' CONFIG_NE2K_PCI $CONFIG_PCI
      dep_tristate '    Novell/Eagle/Microdyne NE3210 EISA support (EXPERIMENTAL)' CONFIG_NE3210 $CONFIG_EISA $CONFIG_EXPERIMENTAL
      dep_tristate '    Racal-Interlan EISA ES3210 support (EXPERIMENTAL)' CONFIG_ES3210 $CONFIG_EISA $CONFIG_EXPERIMENTAL
      dep_tristate '    RealTek RTL-8139 PCI Fast Ethernet Adapter support' CONFIG_8139TOO $CONFIG_PCI
      dep_tristate '    RealTek 8129 (not 8019/8029/8139!) support (EXPERIMENTAL)' CONFIG_RTL8129 $CONFIG_PCI $CONFIG_EXPERIMENTAL
      dep_tristate '    SiS 900/7016 PCI Fast Ethernet Adapter support' CONFIG_SIS900 $CONFIG_PCI
      dep_tristate '    SMC EtherPower II' CONFIG_EPIC100 $CONFIG_PCI
      dep_tristate '    Sundance Alta support' CONFIG_SUNDANCE $CONFIG_PCI
      if [ "$CONFIG_PCI" = "y" -o "$CONFIG_EISA" = "y" ]; then
         tristate '    TI ThunderLAN support' CONFIG_TLAN
      fi
      dep_tristate '    VIA Rhine support' CONFIG_VIA_RHINE $CONFIG_PCI
      dep_tristate '    Winbond W89c840 Ethernet support' CONFIG_WINBOND_840 $CONFIG_PCI
      dep_tristate '    Sun Happy Meal 10/100baseT PCI support' CONFIG_HAPPYMEAL $CONFIG_PCI
      if [ "$CONFIG_OBSOLETE" = "y" ]; then
	 bool '    Zenith Z-Note support (EXPERIMENTAL)' CONFIG_ZNET
      fi
   fi
   bool '  Pocket and portable adapters' CONFIG_NET_POCKET
   if [ "$CONFIG_NET_POCKET" = "y" ]; then
      dep_tristate '    AT-LAN-TEC/RealTek pocket adapter support' CONFIG_ATP $CONFIG_ISA
      tristate '    D-Link DE600 pocket adapter support' CONFIG_DE600
      tristate '    D-Link DE620 pocket adapter support' CONFIG_DE620
   fi
fi

endmenu

#
#	Gigabit Ethernet
#

mainmenu_option next_comment
comment 'Ethernet (1000 Mbit)'

dep_tristate 'Alteon AceNIC/3Com 3C985/NetGear GA620 Gigabit support' CONFIG_ACENIC $CONFIG_PCI
if [ "$CONFIG_ACENIC" != "n" ]; then
   bool '  Omit support for old Tigon I based AceNICs' CONFIG_ACENIC_OMIT_TIGON_I
fi
dep_tristate 'Packet Engines Hamachi GNIC-II support' CONFIG_HAMACHI $CONFIG_PCI
if [ "$CONFIG_EXPERIMENTAL" = "y" ]; then
   dep_tristate 'Packet Engines Yellowfin Gigabit-NIC support (EXPERIMENTAL)' CONFIG_YELLOWFIN $CONFIG_PCI
fi
dep_tristate 'SysKonnect SK-98xx support' CONFIG_SK98LIN $CONFIG_PCI

endmenu

bool 'FDDI driver support' CONFIG_FDDI
if [ "$CONFIG_FDDI" = "y" ]; then
   dep_tristate '  Digital DEFEA and DEFPA adapter support' CONFIG_DEFXX $CONFIG_PCI
   tristate '  SysKonnect FDDI PCI support' CONFIG_SKFP
fi

if [ "$CONFIG_EXPERIMENTAL" = "y" ]; then
   if [ "$CONFIG_INET" = "y" ]; then
      bool 'HIPPI driver support (EXPERIMENTAL)' CONFIG_HIPPI
      if [ "$CONFIG_HIPPI" = "y" ]; then
         tristate '  Essential RoadRunner HIPPI PCI adapter support' CONFIG_ROADRUNNER
         if [ "$CONFIG_ROADRUNNER" != "n" ]; then
   	    bool '    Use large TX/RX rings' CONFIG_ROADRUNNER_LARGE_RINGS
         fi
      fi
   fi
fi

if [ ! "$CONFIG_PARPORT" = "n" ]; then
   dep_tristate 'PLIP (parallel port) support' CONFIG_PLIP $CONFIG_PARPORT
fi

tristate 'PPP (point-to-point protocol) support' CONFIG_PPP
if [ ! "$CONFIG_PPP" = "n" ]; then
   dep_bool '  PPP multilink support (EXPERIMENTAL)' CONFIG_PPP_MULTILINK $CONFIG_EXPERIMENTAL
   dep_tristate '  PPP support for async serial ports' CONFIG_PPP_ASYNC $CONFIG_PPP
   dep_tristate '  PPP support for sync tty ports' CONFIG_PPP_SYNC_TTY $CONFIG_PPP
   dep_tristate '  PPP Deflate compression' CONFIG_PPP_DEFLATE $CONFIG_PPP
   dep_tristate '  PPP BSD-Compress compression' CONFIG_PPP_BSDCOMP $CONFIG_PPP
   if [ "$CONFIG_EXPERIMENTAL" = "y" ]; then
      dep_tristate '  PPP over Ethernet (EXPERIMENTAL)' CONFIG_PPPOE $CONFIG_PPP
   fi
fi

tristate 'SLIP (serial line) support' CONFIG_SLIP
if [ "$CONFIG_SLIP" != "n" ]; then
   bool '  CSLIP compressed headers' CONFIG_SLIP_COMPRESSED
   bool '  Keepalive and linefill' CONFIG_SLIP_SMART
   bool '  Six bit SLIP encapsulation' CONFIG_SLIP_MODE_SLIP6
fi

mainmenu_option next_comment
comment 'Wireless LAN (non-hamradio)'

bool 'Wireless LAN (non-hamradio)' CONFIG_NET_RADIO
if [ "$CONFIG_NET_RADIO" = "y" ]; then
   dep_tristate '  STRIP (Metricom starmode radio IP)' CONFIG_STRIP $CONFIG_INET
   tristate '  AT&T WaveLAN & DEC RoamAbout DS support' CONFIG_WAVELAN
   tristate '  Aironet Arlan 655 & IC2200 DS support' CONFIG_ARLAN
   tristate '  Aironet 4500/4800 series adapters' CONFIG_AIRONET4500
   dep_tristate '   Aironet 4500/4800 ISA/PCI/PNP/365 support ' CONFIG_AIRONET4500_NONCS $CONFIG_AIRONET4500
   if [ "$CONFIG_AIRONET4500" != "n" -a "$CONFIG_AIRONET4500_NONCS" != "n" ]; then
      bool '     Aironet 4500/4800 PNP support ' CONFIG_AIRONET4500_PNP
      dep_bool '     Aironet 4500/4800 PCI support ' CONFIG_AIRONET4500_PCI $CONFIG_PCI
      dep_bool '     Aironet 4500/4800 ISA broken support (EXPERIMENTAL)' CONFIG_AIRONET4500_ISA $CONFIG_EXPERIMENTAL
      dep_bool '     Aironet 4500/4800 I365 broken support (EXPERIMENTAL)' CONFIG_AIRONET4500_I365 $CONFIG_EXPERIMENTAL
   fi
   dep_tristate '   Aironet 4500/4800 PROC interface ' CONFIG_AIRONET4500_PROC $CONFIG_AIRONET4500 m
fi

endmenu

source drivers/net/tokenring/Config.in

bool 'Fibre Channel driver support' CONFIG_NET_FC
if [ "$CONFIG_NET_FC" = "y" ]; then
   dep_tristate '  Interphase 5526 Tachyon chipset based adapter support' CONFIG_IPHASE5526 $CONFIG_SCSI $CONFIG_PCI
fi

if [ "$CONFIG_EXPERIMENTAL" = "y" ]; then
   tristate 'Red Creek Hardware VPN (EXPERIMENTAL)' CONFIG_RCPCI
   tristate 'Traffic Shaper (EXPERIMENTAL)' CONFIG_SHAPER
fi

source drivers/net/wan/Config.in

if [ "$CONFIG_HOTPLUG" = "y" -a "$CONFIG_PCMCIA" != "n" ]; then
   source drivers/net/pcmcia/Config.in
fi
```

## drivers/net/arm/Kconfig
```kconfig
#
# Acorn Network device configuration
#  These are for Acorn's Expansion card network interfaces
#
config ARM_AM79C961A
	bool "ARM EBSA110 AM79C961A support"
	depends on NET_ETHERNET && ARM && ARCH_EBSA110
	select CRC32
	help
	  If you wish to compile a kernel for the EBSA-110, then you should
	  always answer Y to this.

config ARM_ETHER1
	tristate "Acorn Ether1 support"
	depends on NET_ETHERNET && ARM && ARCH_ACORN
	help
	  If you have an Acorn system with one of these (AKA25) network cards,
	  you should say Y to this option if you wish to use it with Linux.

config ARM_ETHER3
	tristate "Acorn/ANT Ether3 support"
	depends on NET_ETHERNET && ARM && ARCH_ACORN
	help
	  If you have an Acorn system with one of these network cards, you
	  should say Y to this option if you wish to use it with Linux.

config ARM_ETHERH
	tristate "I-cubed EtherH/ANT EtherM support"
	depends on NET_ETHERNET && ARM && ARCH_ACORN
	select CRC32
	help
	  If you have an Acorn system with one of these network cards, you
	  should say Y to this option if you wish to use it with Linux.

config ARM_ETHER00
	tristate "Altera Ether00 support"
	depends on NET_ETHERNET && ARM && ARCH_CAMELOT
	help
	  This is the driver for Altera's ether00 ethernet mac IP core. Say
	  Y here if you want to build support for this into the kernel. It
	  is also available as a module (say M here) that can be inserted/
	  removed from the kernel at the same time as the PLD is configured.
	  If this driver is running on an epxa10 development board then it
	  will generate a suitable hw address based on the board serial
	  number (MTD support is required for this). Otherwise you will
	  need to set a suitable hw address using ifconfig.

config SMC91X
	tristate "SMC 91C9x/91C1xxx support"
	select CRC32
	select MII
	depends on ARM
	help
	  This is a driver for SMC's 91x series of Ethernet chipsets,
	  including the SMC91C94 and the SMC91C111. Say Y if you want it
	  compiled into the kernel, and read the file
	  <file:Documentation/networking/smc9.txt>  and the Ethernet-HOWTO,
	  available from  <http://www.linuxdoc.org/docs.html#howto>.

	  This driver is also available as a module ( = code which can be
	  inserted in and removed from the running kernel whenever you want).
	  The module will be called smc91x.  If you want to compile it as a
	  module, say M here and read <file:Documentation/modules.txt> as well
	  as <file:Documentation/networking/net-modules.txt>.
```

## drivers/net/fec_mpc52xx/Kconfig
```kconfig
menu "MPC5200 Networking Options"
	depends PPC_MPC52xx && NET_ETHERNET

config FEC_MPC52xx
	tristate "FEC Ethernet"
	select CRC32
	---help---
	  This option enables support for the MPC5200's on-chip
	  Fast Ethernet Controller

config FEC_MPC52xx_USE_MDIO
	bool "Use external Ethernet MII PHY"
	select MII
	depends on FEC_MPC52xx != n
	---help---
	  The MPC5200's FEC can connect to the Ethernet either with
	  an external MII PHY chip or 10 Mbps 7-wire interface
	  (Motorola? industry standard).
	  If your board uses an external PHY, say y, else n.

endmenu
```
