## drivers/net/tokenring/Kconfig
```kconfig
#
# Token Ring driver configuration
#

menu "Token Ring devices (depends on LLC=y)"
	depends on NETDEVICES

# So far, we only have PCI, ISA, and MCA token ring devices
config TR
	bool "Token Ring driver support"
	depends on (PCI || ISA || MCA || CCW) && LLC=y
	help
	  Token Ring is IBM's way of communication on a local network; the
	  rest of the world uses Ethernet. To participate on a Token Ring
	  network, you need a special Token ring network card. If you are
	  connected to such a Token Ring network and want to use your Token
	  Ring card under Linux, say Y here and to the driver for your
	  particular card below and read the Token-Ring mini-HOWTO, available
	  from <http://www.tldp.org/docs.html#howto>. Most people can
	  say N here.

config IBMTR
	tristate "IBM Tropic chipset based adapter support"
	depends on TR && (ISA || MCA)
	---help---
	  This is support for all IBM Token Ring cards that don't use DMA. If
	  you have such a beast, say Y and read the Token-Ring mini-HOWTO,
	  available from <http://www.tldp.org/docs.html#howto>.

	  Warning: this driver will almost definitely fail if more than one
	  active Token Ring card is present.

	  This driver is also available as a module ( = code which can be
	  inserted in and removed from the running kernel whenever you want).
	  The module will be called ibmtr. If you want to compile it as a
	  module, say M here and read <file:Documentation/modules.txt>.

config IBMOL
	tristate "IBM Olympic chipset PCI adapter support"
	depends on TR && PCI
	---help---
	  This is support for all non-Lanstreamer IBM PCI Token Ring Cards.
	  Specifically this is all IBM PCI, PCI Wake On Lan, PCI II, PCI II
	  Wake On Lan, and PCI 100/16/4 adapters.

	  If you have such an adapter, say Y and read the Token-Ring
	  mini-HOWTO, available from <http://www.tldp.org/docs.html#howto>.

	  This driver is also available as a module ( = code which can be
	  inserted in and removed from the running kernel whenever you want).
	  The module will be called olympic. If you want to compile it
	  as a module, say M here and read <file:Documentation/modules.txt>.

	  Also read <file:Documentation/networking/olympic.txt> or check the
	  Linux Token Ring Project site for the latest information at
	  <http://www.linuxtr.net/>.

config IBMLS
	tristate "IBM Lanstreamer chipset PCI adapter support"
	depends on TR && PCI
	help
	  This is support for IBM Lanstreamer PCI Token Ring Cards.

	  If you have such an adapter, say Y and read the Token-Ring
	  mini-HOWTO, available from <http://www.tldp.org/docs.html#howto>.

	  This driver is also available as a modules ( = code which can be
	  inserted in and removed from the running kernel whenever you want).
	  The modules will be called lanstreamer. If you want to compile it
	  as a module, say M here and read <file:Documentation/modules.txt>.

config 3C359
	tristate "3Com 3C359 Token Link Velocity XL adapter support"
	depends on TR && PCI
	---help---
	  This is support for the 3Com PCI Velocity XL cards, specifically
	  the 3Com 3C359, please note this is not for the 3C339 cards, you
	  should use the tms380 driver instead.

	  If you have such an adapter, say Y and read the Token-Ring
	  mini-HOWTO, available from <http://www.tldp.org/docs.html#howto>.

	  This driver is also available as a module ( = code which can be
	  inserted in and removed from the running kernel whenever you want).
	  The module will will be called 3c359. If you want to compile it
	  as a module, say M here and read Documentation/modules.txt.

	  Also read the file <file:Documentation/networking/3c359.txt> or check the 
	  Linux Token Ring Project site for the latest information at
	  <http://www.linuxtr.net>

config TMS380TR
	tristate "Generic TMS380 Token Ring ISA/PCI adapter support"
	depends on TR && (PCI || ISA)
	---help---
	  This driver provides generic support for token ring adapters
	  based on the Texas Instruments TMS380 series chipsets.  This
	  includes the SysKonnect TR4/16(+) ISA (SK-4190), SysKonnect
	  TR4/16(+) PCI (SK-4590), SysKonnect TR4/16 PCI (SK-4591),
	  Compaq 4/16 PCI, Thomas-Conrad TC4048 4/16 PCI, and several
	  Madge adapters.  If you say Y here, you will be asked to select
	  which cards to support below.  If you're using modules, each
	  class of card will be supported by a separate module.

	  If you have such an adapter and would like to use it, say Y and
	  read the Token-Ring mini-HOWTO, available from
	  <http://www.tldp.org/docs.html#howto>.

	  Also read the file <file:Documentation/networking/tms380tr.txt> or
	  check <http://www.auk.cx/tms380tr/>.

	  This driver is also available as a module ( = code which can be
	  inserted in and removed from the running kernel whenever you want).
	  The module will be called tms380tr. If you want to compile it
	  as a module, say M here and read <file:Documentation/modules.txt>.

config TMSPCI
	tristate "Generic TMS380 PCI support"
	depends on TR && TMS380TR!=n && PCI
	---help---
	  This tms380 module supports generic TMS380-based PCI cards.

	  These cards are known to work:
	  - Compaq 4/16 TR PCI
	  - SysKonnect TR4/16 PCI (SK-4590/SK-4591)
	  - Thomas-Conrad TC4048 PCI 4/16
	  - 3Com Token Link Velocity

	  This driver is available as a module ( = code which can be
	  inserted in and removed from the running kernel whenever you want).
	  The module will be called tmspci. If you want to compile it
	  as a module, say M here and read <file:Documentation/modules.txt>.

config SKISA
	tristate "SysKonnect TR4/16 ISA support"
	depends on TR && TMS380TR!=n && ISA
	help
	  This tms380 module supports SysKonnect TR4/16 ISA cards.

	  These cards are known to work:
	  - SysKonnect TR4/16 ISA (SK-4190)

	  This driver is available as a module ( = code which can be
	  inserted in and removed from the running kernel whenever you want).
	  The module will be called skisa. If you want to compile it
	  as a module, say M here and read <file:Documentation/modules.txt>.

config PROTEON
	tristate "Proteon ISA support"
	depends on TR && TMS380TR!=n && ISA
	help
	  This tms380 module supports Proteon ISA cards.

	  These cards are known to work:
	  - Proteon 1392
	  - Proteon 1392 plus

	  This driver is available as a module ( = code which can be
	  inserted in and removed from the running kernel whenever you want).
	  The module will be called proteon. If you want to compile it
	  as a module, say M here and read <file:Documentation/modules.txt>.

config ABYSS
	tristate "Madge Smart 16/4 PCI Mk2 support"
	depends on TR && TMS380TR!=n && PCI
	help
	  This tms380 module supports the Madge Smart 16/4 PCI Mk2
	  cards (51-02).

	  This driver is available as a module ( = code which can be
	  inserted in and removed from the running kernel whenever you want).
	  The module will be called abyss. If you want to compile it
	  as a module, say M here and read <file:Documentation/modules.txt>.

config MADGEMC
	tristate "Madge Smart 16/4 Ringnode MicroChannel"
	depends on TR && TMS380TR!=n && MCA
	help
	  This tms380 module supports the Madge Smart 16/4 MC16 and MC32
	  MicroChannel adapters.

	  This driver is available as a module ( = code which can be
	  inserted in and removed from the running kernel whenever you want).
	  The module will be called madgemc. If you want to compile it
	  as a module, say M here and read <file:Documentation/modules.txt>.

config SMCTR
	tristate "SMC ISA/MCA adapter support"
	depends on TR && (ISA || MCA)
	---help---
	  This is support for the ISA and MCA SMC Token Ring cards,
	  specifically SMC TokenCard Elite (8115T) and SMC TokenCard Elite/A
	  (8115T/A) adapters.

	  If you have such an adapter and would like to use it, say Y or M and
	  read the Token-Ring mini-HOWTO, available from
	  <http://www.tldp.org/docs.html#howto> and the file
	  <file:Documentation/networking/smctr.txt>.

	  This driver is also available as a module ( = code which can be
	  inserted in and removed from the running kernel whenever you want).
	  The module will be called smctr. If you want to compile it
	  as a module, say M here and read <file:Documentation/modules.txt>.

endmenu
```

## drivers/net/tulip/Kconfig
```kconfig
#
# Tulip family network device configuration
#

menu "Tulip family network device support"
	depends on NET_ETHERNET && (PCI || EISA || CARDBUS)

config NET_TULIP
	bool "\"Tulip\" family network device support"
	help
	  This selects the "Tulip" family of EISA/PCI network cards.

config DE2104X
	tristate "Early DECchip Tulip (dc2104x) PCI support (EXPERIMENTAL)"
	depends on NET_TULIP && PCI && EXPERIMENTAL
	---help---
	  This driver is developed for the SMC EtherPower series Ethernet
	  cards and also works with cards based on the DECchip
	  21040 (Tulip series) chips.  Some LinkSys PCI cards are
	  of this type.  (If your card is NOT SMC EtherPower 10/100 PCI
	  (smc9332dst), you can also try the driver for "Generic DECchip"
	  cards, above.  However, most people with a network card of this type
	  will say Y here.) Do read the Ethernet-HOWTO, available from
	  <http://www.tldp.org/docs.html#howto>.  More specific
	  information is contained in
	  <file:Documentation/DocBook/tulip-user.tmpl>.

	  This driver is also available as a module ( = code which can be
	  inserted in and removed from the running kernel whenever you want).
	  The module will be called tulip.  If you want to compile it as a
	  module, say M here and read <file:Documentation/modules.txt> as well
	  as <file:Documentation/networking/net-modules.txt>.

config TULIP
	tristate "DECchip Tulip (dc2114x) PCI support"
	depends on NET_TULIP && PCI
	---help---
	  This driver is developed for the SMC EtherPower series Ethernet
	  cards and also works with cards based on the DECchip 
	  21040/21041/21140 (Tulip series) chips.  Some LinkSys PCI cards are
	  of this type.  (If your card is NOT SMC EtherPower 10/100 PCI
	  (smc9332dst), you can also try the driver for "Generic DECchip"
	  cards, above.  However, most people with a network card of this type
	  will say Y here.) Do read the Ethernet-HOWTO, available from
	  <http://www.tldp.org/docs.html#howto>.  More specific
	  information is contained in 
	  <file:Documentation/networking/tulip.txt>.

	  This driver is also available as a module ( = code which can be
	  inserted in and removed from the running kernel whenever you want).
	  The module will be called tulip.  If you want to compile it as a
	  module, say M here and read <file:Documentation/modules.txt> as well
	  as <file:Documentation/networking/net-modules.txt>.

config TULIP_MWI
	bool "New bus configuration (EXPERIMENTAL)"
	depends on TULIP && EXPERIMENTAL
	help
	  This configures your Tulip card specifically for the card and
	  system cache line size type you are using.

	  This is experimental code, not yet tested on many boards.

	  If unsure, say N.

config TULIP_MMIO
	bool "Use PCI shared mem for NIC registers"
	depends on TULIP
	help
	  Use PCI shared memory for the NIC registers, rather than going through
	  the Tulip's PIO (programmed I/O ports).  Faster, but could produce
	  obscure bugs if your mainboard has memory controller timing issues.
	  If in doubt, say N.

config DE4X5
	tristate "Generic DECchip & DIGITAL EtherWORKS PCI/EISA"
	depends on NET_TULIP && (PCI || EISA)
	---help---
	  This is support for the DIGITAL series of PCI/EISA Ethernet cards.
	  These include the DE425, DE434, DE435, DE450 and DE500 models.  If
	  you have a network card of this type, say Y and read the
	  Ethernet-HOWTO, available from
	  <http://www.tldp.org/docs.html#howto>. More specific
	  information is contained in
	  <file:Documentation/networking/de4x5.txt>.

	  This driver is also available as a module ( = code which can be
	  inserted in and removed from the running kernel whenever you want).
	  The module will be called de4x5.  If you want to compile it as a
	  module, say M here and read <file:Documentation/modules.txt> as well
	  as <file:Documentation/networking/net-modules.txt>.

config WINBOND_840
	tristate "Winbond W89c840 Ethernet support"
	depends on NET_TULIP && PCI
	help
	  This driver is for the Winbond W89c840 chip.  It also works with 
	  the TX9882 chip on the Compex RL100-ATX board.
	  More specific information and updates are available from
	  <http://www.scyld.com/network/drivers.html>.

config DM9102
	tristate "Davicom DM910x/DM980x support"
	depends on NET_TULIP && PCI
	---help---
	  This driver is for DM9102(A)/DM9132/DM9801 compatible PCI cards from
	  Davicom (<http://www.davicom.com.tw/>).  If you have such a network
	  (Ethernet) card, say Y.  Some information is contained in the file
	  <file:Documentation/networking/dmfe.txt>.

	  This driver is also available as a module ( = code which can be
	  inserted in and removed from the running kernel whenever you want).
	  The module will be called dmfe.  If you want to compile it as a
	  module, say M here and read <file:Documentation/modules.txt> as well
	  as <file:Documentation/networking/net-modules.txt>.

config PCMCIA_XIRCOM
	tristate "Xircom CardBus support (new driver)"
	depends on NET_TULIP && CARDBUS
	---help---
	  This driver is for the Digital "Tulip" Ethernet CardBus adapters.
	  It should work with most DEC 21*4*-based chips/ethercards, as well
	  as with work-alike chips from Lite-On (PNIC) and Macronix (MXIC) and
	  ASIX.

	  This driver is also available as a module ( = code which can be
	  inserted in and removed from the running kernel whenever you want).
	  The module will be called xircom_cb.  If you want to compile
	  it as a module, say M here and read
	  <file:Documentation/modules.txt>. If unsure, say N.

config PCMCIA_XIRTULIP
	tristate "Xircom Tulip-like CardBus support (old driver)"
	depends on NET_TULIP && CARDBUS
	---help---
	  This driver is for the Digital "Tulip" Ethernet CardBus adapters.
	  It should work with most DEC 21*4*-based chips/ethercards, as well
	  as with work-alike chips from Lite-On (PNIC) and Macronix (MXIC) and
	  ASIX.

	  This driver is also available as a module ( = code which can be
	  inserted in and removed from the running kernel whenever you want).
	  The module will be called xircom_tulip_cb.  If you want to compile
	  it as a module, say M here and read
	  <file:Documentation/modules.txt>. If unsure, say N.

endmenu
```
