## drivers/net/wan/Kconfig
```kconfig
#
# wan devices configuration
#

menu "Wan interfaces"
	depends on NETDEVICES

config WAN
	bool "Wan interfaces support"
	---help---
	  Wide Area Networks (WANs), such as X.25, frame relay and leased
	  lines, are used to interconnect Local Area Networks (LANs) over vast
	  distances with data transfer rates significantly higher than those
	  achievable with commonly used asynchronous modem connections.
	  Usually, a quite expensive external device called a `WAN router' is
	  needed to connect to a WAN.

	  As an alternative, a relatively inexpensive WAN interface card can
	  allow your Linux box to directly connect to a WAN. If you have one
	  of those cards and wish to use it under Linux, say Y here and also
	  to the WAN driver for your card, below.

	  If unsure, say N.

# There is no way to detect a comtrol sv11 - force it modular for now.
config HOSTESS_SV11
	tristate "Comtrol Hostess SV-11 support"
	depends on WAN && ISA && m
	help
	  This is a network card for low speed synchronous serial links, at
	  up to 256Kbps. It supports both PPP and Cisco HDLC.

	  At this point, the driver can only be compiled as a module.

# The COSA/SRP driver has not been tested as non-modular yet.
config COSA
	tristate "COSA/SRP sync serial boards support"
	depends on WAN && ISA && m
	---help---
	  This is a driver for COSA and SRP synchronous serial boards. These
	  boards allow to connect synchronous serial devices (for example
	  base-band modems, or any other device with the X.21, V.24, V.35 or
	  V.36 interface) to your Linux box. The cards can work as the
	  character device, synchronous PPP network device, or the Cisco HDLC
	  network device.

	  To actually use the COSA or SRP board, you will need user-space
	  utilities for downloading the firmware to the cards and to set them
	  up. Look at the <http://www.fi.muni.cz/~kas/cosa/> for more
	  information about the cards (including the pointer to the user-space
	  utilities). You can also read the comment at the top of the
	  <file:drivers/net/wan/cosa.c> for details about the cards and the driver
	  itself.

	  The driver will be compiled as a module: the module will be called cosa.

#
# COMX drivers
#
# Not updated to 2.6.
config COMX
	tristate "MultiGate (COMX) synchronous serial boards support"
	depends on WAN && (ISA || PCI) && BROKEN
	---help---
	  Say Y if you want to use any board from the MultiGate (COMX) family.
	  These boards are synchronous serial adapters for the PC,
	  manufactured by ITConsult-Pro Co, Hungary.

	  Read <file:Documentation/networking/comx.txt> for help on
	  configuring and using COMX interfaces.  Further info on these cards
	  can be found at <http://www.itc.hu/> or <info@itc.hu>.

	  You must say Y to "/proc file system support" (CONFIG_PROC_FS) to
	  use this driver.

	  To compile this driver as a module, choose M here: the
	  module will be called comx.

config COMX_HW_COMX
	tristate "Support for COMX/CMX/HiCOMX boards"
	depends on COMX
	help
	  Hardware driver for the 'CMX', 'COMX' and 'HiCOMX' boards from the
	  MultiGate family. Say Y if you have one of these.

	  You will need additional firmware to use these cards, which are
	  downloadable from <ftp://ftp.itc.hu/>.

	  To compile this driver as a module, choose M here: the
	  module will be called comx-hw-comx.

config COMX_HW_LOCOMX
	tristate "Support for LoCOMX board"
	depends on COMX
	help
	  Hardware driver for the 'LoCOMX' board from the MultiGate family.
	  Say Y if you have a board like this.

	  To compile this driver as a module, choose M here: the
	  module will be called comx-hw-locomx.

config COMX_HW_MIXCOM
	tristate "Support for MixCOM board"
	depends on COMX
	---help---
	  Hardware driver for the 'MixCOM' board from the MultiGate family.
	  Say Y if you have a board like this.

	  If you want to use the watchdog device on this card, you should
	  select it in the Watchdog Cards section of the Character Devices
	  configuration. The ISDN interface of this card is Teles 16.3
	  compatible, you should enable it in the ISDN configuration menu. The
	  driver for the flash ROM of this card is available separately on
	  <ftp://ftp.itc.hu/>.

	  To compile this driver as a module, choose M here: the
	  module will be called comx-hw-mixcom.

config COMX_HW_MUNICH
	tristate "Support for MUNICH based boards: SliceCOM, PCICOM (WelCOM)"
	depends on COMX
	---help---
	  Hardware driver for the 'SliceCOM' (channelized E1) and 'PciCOM'
	  boards (X21) from the MultiGate family.

	  To compile this driver as a module, choose M here: the
	  module will be called comx-hw-munich.

	  Read linux/Documentation/networking/slicecom.txt for help on
	  configuring and using SliceCOM interfaces. Further info on these cards
	  can be found at http://www.itc.hu or <info@itc.hu>.

config COMX_PROTO_PPP
	tristate "Support for HDLC and syncPPP protocols on MultiGate boards"
	depends on COMX
	help
	  Cisco-HDLC and synchronous PPP protocol driver for all MultiGate
	  boards. Say Y if you want to use either protocol on your MultiGate
	  boards.

	  To compile this as a module, choose M here: the module will be called
	  comx-proto-ppp.

config COMX_PROTO_LAPB
	tristate "Support for LAPB protocol on MultiGate boards"
	depends on WAN && (COMX!=n && LAPB=m && LAPB || LAPB=y && COMX)
	help
	  LAPB protocol driver for all MultiGate boards. Say Y if you
	  want to use this protocol on your MultiGate boards.

	  To compile this as a module, choose M here: the module will be called
	  comx-proto-lapb.

config COMX_PROTO_FR
	tristate "Support for Frame Relay on MultiGate boards"
	depends on COMX
	help
	  Frame Relay protocol driver for all MultiGate boards. Say Y if you
	  want to use this protocol on your MultiGate boards.

	  To compile this as a module, choose M here: the module will be called
	  comx-proto-fr.

config DSCC4
	tristate "Etinc PCISYNC serial board support"
	depends on WAN && PCI && m
	help
	  This is a driver for Etinc PCISYNC boards based on the Infineon
	  (ex. Siemens) DSCC4 chipset. It is supposed to work with the four
	  ports card. Take a look at <http://www.cogenit.fr/dscc4/>
	  for further informations about the driver and his configuration.

	  To compile this driver as a module, choose M here: the module
	  will be called dscc4.

config DSCC4_PCISYNC
	bool "Etinc PCISYNC features"
	depends on DSCC4
	help
	  Due to Etinc's design choice for its PCISYNC cards, some operations
	  are only allowed on specific ports of the DSCC4. This option is the
	  only way for the driver to know that it shouldn't return a success
	  code for these operations.

	  Please say Y if your card is an Etinc's PCISYNC.

config DSCC4_PCI_RST
	bool "Hard reset support"
	depends on DSCC4
	help
	  Various DSCC4 bugs forbid any reliable software reset of the asic.
	  As a replacement, some vendors provide a way to assert the PCI #RST
	  pin of DSCC4 through the GPIO port of the card. If you choose Y,
	  the driver will make use of this feature before module removal
	  (i.e. rmmod).
	  The feature is known to be available on Commtech's cards.
	  Contact your manufacturer for details.

	  Say Y if your card supports this feature.

#
# Lan Media's board. Currently 1000, 1200, 5200, 5245
#
config LANMEDIA
	tristate "LanMedia Corp. SSI/V.35, T1/E1, HSSI, T3 boards"
	depends on WAN && PCI
	---help---
	  This is a driver for the following Lan Media family of serial
	  boards.

	  LMC 1000 board allows you to connect synchronous serial devices (for
	  example base-band modems, or any other device with the X.21, V.24,
	  V.35 or V.36 interface) to your Linux box.

	  LMC 1200 with on board DSU board allows you to connect your Linux
	  box dirrectly to a T1 or E1 circuit.

	  LMC 5200 board provides a HSSI interface capable of running up to
	  52 mbits per second.

	  LMC 5245 board connects directly to a T3 circuit saving the
	  additional external hardware.

	  To change setting such as syncPPP vs cisco HDLC or clock source you
	  will need lmcctl.  It is available at <ftp://ftp.lanmedia.com/>.

	  To compile this driver as a module, choose M here: the module
	  will be called lmc.

# There is no way to detect a Sealevel board. Force it modular
config SEALEVEL_4021
	tristate "Sealevel Systems 4021 support"
	depends on WAN && ISA && m
	help
	  This is a driver for the Sealevel Systems ACB 56 serial I/O adapter.

	  This driver can only be compiled as a module ( = code which can be
	  inserted in and removed from the running kernel whenever you want).
	  If you want to do that, say M here. The module will be called
	  sealevel.

config SYNCLINK_SYNCPPP
	tristate "SyncLink HDLC/SYNCPPP support"
	depends on WAN
	help
	  Enables HDLC/SYNCPPP support for the SyncLink WAN driver.
	  Normally the SyncLink WAN driver works with the main PPP
	  driver (ppp.c) and pppd program. HDLC/SYNCPPP support allows use
	  of the Cisco HDLC/PPP driver (syncppp.c).
	  The SyncLink WAN driver (in character devices) must also be enabled.

# Generic HDLC
config HDLC
	tristate "Generic HDLC layer"
	depends on WAN
	help
	  Say Y to this option if your Linux box contains a WAN card supported
	  by this driver and you are planning to connect the box to a WAN
	  ( = Wide Area Network). You will need supporting software from
	  <http://hq.pm.waw.pl/hdlc/>.
	  Generic HDLC driver currently supports raw HDLC, Cisco HDLC, Frame
	  Relay, synchronous Point-to-Point Protocol (PPP) and X.25.

 	  To compile this driver as a module, choose M here: the module
	  will be called hdlc.

	  If unsure, say N here.

config HDLC_RAW
	bool "Raw HDLC support"
	depends on HDLC
	help
	  Say Y to this option if you want generic HDLC driver to support
	  raw HDLC over WAN (Wide Area Network) connections.

	  If unsure, say N here.

config HDLC_RAW_ETH
	bool "Raw HDLC Ethernet device support"
	depends on HDLC
	help
	  Say Y to this option if you want generic HDLC driver to support
	  raw HDLC Ethernet device emulation over WAN (Wide Area Network)
	  connections.
	  You will need it for Ethernet over HDLC bridges.

	  If unsure, say N here.

config HDLC_CISCO
	bool "Cisco HDLC support"
	depends on HDLC
	help
	  Say Y to this option if you want generic HDLC driver to support
	  Cisco HDLC over WAN (Wide Area Network) connections.

	  If unsure, say N here.

config HDLC_FR
	bool "Frame Relay support"
	depends on HDLC
	help
	  Say Y to this option if you want generic HDLC driver to support
	  Frame-Relay protocol over WAN (Wide Area Network) connections.

	  If unsure, say N here.

config HDLC_PPP
	bool "Synchronous Point-to-Point Protocol (PPP) support"
	depends on HDLC
	help
	  Say Y to this option if you want generic HDLC driver to support
	  PPP over WAN (Wide Area Network) connections.

	  If unsure, say N here.

config HDLC_X25
	bool "X.25 protocol support"
	depends on HDLC && (LAPB=m && HDLC=m || LAPB=y)
	help
	  Say Y to this option if you want generic HDLC driver to support
	  X.25 protocol over WAN (Wide Area Network) connections.

	  If unsure, say N here.

comment "X.25/LAPB support is disabled"
	depends on WAN && HDLC && (LAPB!=m || HDLC!=m) && LAPB!=y

config WANXL
	tristate "SBE Inc. wanXL support"
	depends on HDLC && PCI
	help
	  This driver is for wanXL PCI cards made by SBE Inc.  If you have
	  such a card, say Y here and see <http://hq.pm.waw.pl/pub/hdlc/>.

	  If you want to compile the driver as a module ( = code which can be
	  inserted in and removed from the running kernel whenever you want),
	  say M here and read <file:Documentation/modules.txt>.  The module
	  will be called wanxl.

	  If unsure, say N here.

config WANXL_BUILD_FIRMWARE
	bool "rebuild wanXL firmware"
	depends on WANXL
	help
	  This option allows you to rebuild firmware run by the QUICC
	  processor. It requires as68k, ld68k and hexdump programs.
	  You should never need this option.

	  If unsure, say N here.

config PC300
	tristate "Cyclades-PC300 support (RS-232/V.35, X.21, T1/E1 boards)"
	depends on HDLC && PCI
	---help---
	  This is a driver for the Cyclades-PC300 synchronous communication
	  boards. These boards provide synchronous serial interfaces to your
	  Linux box (interfaces currently available are RS-232/V.35, X.21 and
	  T1/E1). If you wish to support Multilink PPP, please select the
	  option below this one and read the file README.mlppp provided by PC300
	  package.

	  To compile this as a module, choose M here: the module will be
	  called pc300.

	  If you haven't heard about it, it's safe to say N.

config PC300_MLPPP
	bool "Cyclades-PC300 MLPPP support"
	depends on PC300 && PPP_MULTILINK && PPP_SYNC_TTY && HDLC_PPP
	help
	  Say 'Y' to this option if you are planning to use Multilink PPP over the
	  PC300 synchronous communication boards.

comment "Cyclades-PC300 MLPPP support is disabled."
	depends on WAN && HDLC && PC300 && (PPP=n || !PPP_MULTILINK || PPP_SYNC_TTY=n || !HDLC_PPP)

comment "Refer to the file README.mlppp, provided by PC300 package."
	depends on WAN && HDLC && PC300 && (PPP=n || !PPP_MULTILINK || PPP_SYNC_TTY=n || !HDLC_PPP)

config N2
	tristate "SDL RISCom/N2 support"
	depends on HDLC && ISA
	help
	  This driver is for RISCom/N2 single or dual channel ISA cards
	  made by SDL Communications Inc.  If you have such a card,
	  say Y here and see <http://hq.pm.waw.pl/pub/hdlc/>.

	  Note that N2csu and N2dds cards are not supported by this driver.

	  To compile this driver as a module, choose M here: the module
	  will be called n2.

	  If unsure, say N here.

config C101
	tristate "Moxa C101 support"
	depends on HDLC && ISA
	help
	  This driver is for C101 SuperSync ISA cards made by Moxa
	  Technologies Co., Ltd. If you have such a card,
	  say Y here and see <http://hq.pm.waw.pl/pub/hdlc/>

	  To compile this driver as a module, choose M here: the module
	  will be called c101.

	  If unsure, say N here.

config FARSYNC
	tristate "FarSync T-Series support"
	depends on HDLC && PCI
	---help---
	  This driver supports the FarSync T-Series X.21 (and V.35/V.24) cards
	  from FarSite Communications Ltd.
	  Synchronous communication is supported on all ports at speeds up to
	  8Mb/s (128K on V.24) using synchronous PPP, Cisco HDLC, raw HDLC,
	  Frame Relay or X.25/LAPB.

	  To compile this driver as a module, choose M here: the module will be
	  called farsync.  If you want the module to be automatically loaded
	  when the interface is referenced then you should add
	  "alias hdlcX farsync" to /etc/modules.conf for each interface, where
	  X is 0, 1, 2, ...

config DLCI
	tristate "Frame relay DLCI support"
	depends on WAN
	---help---
	  This is support for the frame relay protocol; frame relay is a fast
	  low-cost way to connect to a remote Internet access provider or to
	  form a private wide area network. The one physical line from your
	  box to the local "switch" (i.e. the entry point to the frame relay
	  network, usually at the phone company) can carry several logical
	  point-to-point connections to other computers connected to the frame
	  relay network. For a general explanation of the protocol, check out
	  <http://www.frforum.com/> on the WWW. To use frame relay, you need
	  supporting hardware (called FRAD) and certain programs from the
	  net-tools package as explained in
	  <file:Documentation/networking/framerelay.txt>.

	  To compile this driver as a module, choose M here: the module will be
	  called dlci.

config DLCI_COUNT
	int "Max open DLCI"
	depends on DLCI
	default "24"
	help
	  This is the maximal number of logical point-to-point frame relay
	  connections (the identifiers of which are called DCLIs) that
	  the driver can handle. The default is probably fine.

config DLCI_MAX
	int "Max DLCI per device"
	depends on DLCI
	default "8"
	help
	  You can specify here how many logical point-to-point frame relay
	  connections (the identifiers of which are called DCLIs) should be
	  handled by each of your hardware frame relay access devices. Go with
	  the default.

config SDLA
	tristate "SDLA (Sangoma S502/S508) support"
	depends on DLCI && ISA
	help
	  Say Y here if you need a driver for the Sangoma S502A, S502E, and
	  S508 Frame Relay Access Devices. These are multi-protocol cards, but
	  only frame relay is supported by the driver at this time. Please
	  read <file:Documentation/framerelay.txt>.

	  To compile this driver as a module, choose M here: the module will be
	  called sdla.

# Wan router core.
config WAN_ROUTER_DRIVERS
	bool "WAN router drivers"
	depends on WAN && WAN_ROUTER
	---help---
	  If you have a WAN interface card and you want your Linux box to act
	  as a WAN router, thereby connecting you Local Area Network to the
	  outside world over the WAN connection, say Y here and then to the
	  driver for your card below. In addition, you need to say Y to "Wan
	  Router".

	  You will need the wan-tools package which is available from
	  <ftp://ftp.sangoma.com/>. Read
	  <file:Documentation/networking/wan-router.txt> for more information.

	  Note that the answer to this question won't directly affect the
	  kernel: saying N will just cause the configurator to skip all
	  the questions about WAN router drivers. If unsure, say N.

config VENDOR_SANGOMA
	tristate "Sangoma WANPIPE(tm) multiprotocol cards"
	depends on WAN_ROUTER_DRIVERS && WAN_ROUTER && (PCI || ISA) && BROKEN
	---help---
	  WANPIPE from Sangoma Technologies Inc. (<http://www.sangoma.com/>)
	  is a family of intelligent multiprotocol WAN adapters with data
	  transfer rates up to 4Mbps. They are also known as Synchronous
	  Data Link Adapters (SDLA) and are designated as S514-PCI or
	  S508-ISA.  These cards support

	  - X.25, Frame Relay, PPP, Cisco HDLC protocols.

	  - API support for protocols like HDLC (LAPB),
	  HDLC Streaming, X.25, Frame Relay and BiSync.

	  - Ethernet Bridging over Frame Relay protocol.

	  - MULTILINK PPP

	  - Async PPP (Modem Dialup)

	  If you have one or more of these cards, say M to this option; you
	  may then also want to read the file
	  <file:Documentation/networking/wanpipe.txt>.  The next questions
	  will ask you about the protocols you want the driver to support.

	  To compile this driver as a module, choose M here: the module will
	  be called wanpipe.

config WANPIPE_CHDLC
	bool "WANPIPE Cisco HDLC support"
	depends on VENDOR_SANGOMA
	---help---
	  Say Y to this option if you are planning to connect a WANPIPE card
	  to a leased line using the Cisco HDLC protocol. This now supports
	  Dual Port Cisco HDLC on the S514-PCI/S508-ISA cards.
	  This support also allows user to build applications using the
	  HDLC streaming API.

	  CHDLC Streaming driver also supports MULTILINK PPP
	  support that can bind multiple WANPIPE T1 cards into
	  a single logical channel.

	  If you say  N, the Cisco HDLC support and
	  HDLC streaming API and MULTILINK PPP will not be
	  included in the driver.

config WANPIPE_FR
	bool "WANPIPE Frame Relay support"
	depends on VENDOR_SANGOMA
	help
	  Say Y to this option if you are planning to connect a WANPIPE card
	  to a frame relay network, or use frame relay API to develope
	  custom applications over the Frame  Relay protocol.
	  This feature also contains the Ethernet Bridging over Frame Relay,
	  where a WANPIPE frame relay link can be directly connected to the
	  Linux kernel bridge.  If you say N, the frame relay support will
	  not be included in the driver. The Frame Relay option is
	  supported on S514-PCI and S508-ISA cards.

config WANPIPE_X25
	bool "WANPIPE X.25 support"
	depends on VENDOR_SANGOMA
	help
	  Say Y to this option if you are planning to connect a WANPIPE card
	  to an X.25 network.  Note, this feature also includes the X.25 API
	  support used to develope custom applications over the X.25 protocol.
	  If you say N, the X.25 support will not be included in the driver.
	  The X.25 option is supported on S514-PCI and S508-ISA cards.

config WANPIPE_PPP
	bool "WANPIPE PPP support"
	depends on VENDOR_SANGOMA
	help
	  Say Y to this option if you are planning to connect a WANPIPE card
	  to a leased line using Point-to-Point protocol (PPP). If you say N,
	  the PPP support will not be included in the driver. The PPP option
	  is supported on S514-PCI/S508-ISA cards.

config WANPIPE_MULTPPP
	bool "WANPIPE Multi-Port PPP support"
	depends on VENDOR_SANGOMA
	help
	  Say Y to this option if you are planning to connect a WANPIPE card
	  to a leased line using Point-to-Point protocol (PPP).  Note, the
	  MultiPort PPP uses the Linux Kernel SyncPPP protocol over the
	  Sangoma HDLC Streaming adapter.  In this case each Sangoma adapter
	  port can support an independent PPP connection.  For example, a
	  single Quad-Port PCI adapter can support up to four independent
	  PPP links. If you say N,the PPP support will not be included in the
	  driver.  The PPP option is supported on S514-PCI/S508-ISA cards.

config CYCLADES_SYNC
	tristate "Cyclom 2X(tm) cards (EXPERIMENTAL)"
	depends on WAN_ROUTER_DRIVERS && (PCI || ISA)
	---help---
	  Cyclom 2X from Cyclades Corporation (<http://www.cyclades.com/> and
	  <http://www.cyclades.com.br/>) is an intelligent multiprotocol WAN
	  adapter with data transfer rates up to 512 Kbps. These cards support
	  the X.25 and SNA related protocols. If you have one or more of these
	  cards, say Y to this option. The next questions will ask you about
	  the protocols you want the driver to support (for now only X.25 is
	  supported).

	  While no documentation is available at this time please grab the
	  wanconfig tarball in
	  <http://www.conectiva.com.br/~acme/cycsyn-devel/> (with minor changes
	  to make it compile with the current wanrouter include files; efforts
	  are being made to use the original package available at
	  <ftp://ftp.sangoma.com/>).

	  Feel free to contact me or the cycsyn-devel mailing list at
	  acme@conectiva.com.br and cycsyn-devel@bazar.conectiva.com.br for
	  additional details, I hope to have documentation available as soon
	  as possible. (Cyclades Brazil is writing the Documentation).

	  To compile this driver as a module, choose M here: the module will be
	  called cyclomx.

config CYCLOMX_X25
	bool "Cyclom 2X X.25 support (EXPERIMENTAL)"
	depends on CYCLADES_SYNC
	help
	  Say Y to this option if you are planning to connect a Cyclom 2X card
	  to an X.25 network.

	  If you say N, the X.25 support will not be included in the driver
	  (saves about 11 KB of kernel memory).

# X.25 network drivers
config LAPBETHER
	tristate "LAPB over Ethernet driver (EXPERIMENTAL)"
	depends on WAN && LAPB && X25
	---help---
	  This is a driver for a pseudo device (typically called /dev/lapb0)
	  which allows you to open an LAPB point-to-point connection to some
	  other computer on your Ethernet network.  In order to do this, you
	  need to say Y or M to the driver for your Ethernet card as well as
	  to "LAPB Data Link Driver".

	  To compile this driver as a module, choose M here: the module
	  will be called lapbether.  If unsure, say N.

config X25_ASY
	tristate "X.25 async driver (EXPERIMENTAL)"
	depends on WAN && LAPB && X25
	---help---
	  This is a driver for sending and receiving X.25 frames over regular
	  asynchronous serial lines such as telephone lines equipped with
	  ordinary modems.  Experts should note that this driver doesn't
	  currently comply with the asynchronous HDLS framing protocols in
	  CCITT recommendation X.25.

	  To compile this driver as a module, choose M here: the module
	  will be called x25_asy.  If unsure, say N.

config SBNI
	tristate "Granch SBNI12 Leased Line adapter support"
	depends on WAN && X86
	---help---
	  This is a driver for ISA SBNI12-xx cards which are low cost
	  alternatives to leased line modems. Say Y if you want to insert
	  the driver into the kernel or say M to compile it as a module (the
	  module will be called sbni).

	  You can find more information and last versions of drivers and
	  utilities at <http://www.granch.ru/>. If you have any question you
	  can send email to sbni@granch.ru.

	  Say N if unsure.

config SBNI_MULTILINE
	bool "Multiple line feature support"
	depends on SBNI
	help
	  Schedule traffic for some parallel lines, via SBNI12 adapters.
	  If you have two computers connected with two parallel lines it's
	  possible to increase transfer rate nearly twice. You should have
	  a program named 'sbniconfig' to configure adapters.

	  Say N if unsure.

endmenu
```
