## drivers/mtd/chips/Config.in
```kconfig
# drivers/mtd/chips/Config.in

# $Id: Config.in,v 1.4 2001/05/14 09:48:12 dwmw2 Exp $

mainmenu_option next_comment

comment 'RAM/ROM/Flash chip drivers'

dep_tristate '  Common Flash Interface (CFI) support' CONFIG_MTD_CFI $CONFIG_MTD
if [ "$CONFIG_MTD_CFI" = "y" -o "$CONFIG_MTD_CFI" = "m" ]; then
   bool '  CFI Virtual erase regions (EXPERIMENTAL)' CONFIG_MTD_CFI_VIRTUAL_ER 
   bool '  CFI Advanced configuration options' CONFIG_MTD_CFI_ADV_OPTIONS
   if [ "$CONFIG_MTD_CFI_ADV_OPTIONS" = "y" ]; then
     choice 'Flash cmd/query data swapping'			\
	"NO			CONFIG_MTD_CFI_NOSWAP		\
	 BIG_ENDIAN_BYTE	CONFIG_MTD_CFI_BE_BYTE_SWAP	\
	 LITTLE_ENDIAN_BYTE	CONFIG_MTD_CFI_LE_BYTE_SWAP	\
	 LART_ENDIAN_BYTE	CONFIG_MTD_CFI_LART_BIT_SWAP"	NO
     bool '  Specific CFI Flash geometry selection' CONFIG_MTD_CFI_GEOMETRY
     if [ "$CONFIG_MTD_CFI_GEOMETRY" = "y" ]; then
       bool '    Support  8-bit buswidth' CONFIG_MTD_CFI_B1
       bool '    Support 16-bit buswidth' CONFIG_MTD_CFI_B2
       bool '    Support 32-bit buswidth' CONFIG_MTD_CFI_B4
	 if [ "$CONFIG_MTD_CFI_B1" = "y" ]; then
	   define_bool CONFIG_MTD_CFI_I1 y
         else
           bool '    Support 1-chip flash interleave' CONFIG_MTD_CFI_I1
	 fi
       bool '    Support 2-chip flash interleave' CONFIG_MTD_CFI_I2
       bool '    Support 4-chip flash interleave' CONFIG_MTD_CFI_I4
     fi
  fi
fi
dep_tristate '    CFI support for Intel/Sharp Basic/Extended Commands' CONFIG_MTD_CFI_INTELEXT $CONFIG_MTD_CFI
dep_tristate '    CFI support for AMD/Fujitsu Standard Commands' CONFIG_MTD_CFI_AMDSTD $CONFIG_MTD_CFI
dep_tristate '  AMD compatible flash chip support (non-CFI)' CONFIG_MTD_AMDSTD $CONFIG_MTD
dep_tristate '  pre-CFI Sharp chip support' CONFIG_MTD_SHARP $CONFIG_MTD
dep_tristate '  Support for RAM chips in bus mapping' CONFIG_MTD_RAM $CONFIG_MTD
dep_tristate '  Support for ROM chips in bus mapping' CONFIG_MTD_ROM $CONFIG_MTD
dep_tristate '  JEDEC device support' CONFIG_MTD_JEDEC $CONFIG_MTD

endmenu
```

## drivers/mtd/nand/Kconfig
```kconfig
# drivers/mtd/nand/Kconfig
# $Id: Kconfig,v 1.4 2003/05/28 10:04:23 dwmw2 Exp $

menu "NAND Flash Device Drivers"
	depends on MTD!=n

config MTD_NAND
	tristate "NAND Device Support"
	depends on MTD
	help
	  This enables support for accessing all type of NAND flash
	  devices with an 8-bit data bus interface. For further information see
	  <http://www.linux-mtd.infradead.org/tech/nand.html>.

config MTD_NAND_VERIFY_WRITE
	bool "Verify NAND page writes"
	depends on MTD_NAND
	help
	  This adds an extra check when data is written to the flash. The
	  NAND flash device internally checks only bits transitioning
	  from 1 to 0. There is a rare possibility that even though the
	  device thinks the write was successful, a bit could have been
	  flipped accidentaly due to device wear or something else.

config MTD_NAND_AUTCPU12
	tristate "SmartMediaCard on autronix autcpu12 board"
	depends on ARM && MTD_NAND && ARCH_AUTCPU12
	help
	  This enables the driver for the autronix autcpu12 board to 
	  access the SmartMediaCard.

config MTD_NAND_EDB7312
	tristate "Support for Cirrus Logic EBD7312 evaluation board"
	depends on ARM && MTD_NAND && ARCH_EDB7312
	help
	  This enables the driver for the Cirrus Logic EBD7312 evaluation 
	  board to access the onboard NAND Flash.

config MTD_NAND_SPIA
	tristate "NAND Flash device on SPIA board"
	depends on ARM && ARCH_P720T && MTD_NAND
	help
	  If you had to ask, you don't have one. Say 'N'.

config MTD_NAND_IDS
	tristate
	default y if MTD_NAND = y || MTD_DOC2000 = y || MTD_DOC2001 = y || MTD_DOC2001PLUS = y
	default m if MTD_NAND = m || MTD_DOC2000 = m || MTD_DOC2001 = m || MTD_DOC2001PLUS = m
	
endmenu
```
