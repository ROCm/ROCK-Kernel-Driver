## drivers/parisc/Kconfig
```kconfig
menu "Bus options (PCI, PCMCIA, EISA, GSC, ISA)"

config GSC
	bool "VSC/GSC/HSC bus support"
	default y
	help
	  The VSC, GSC and HSC busses were used from the earliest 700-series
	  workstations up to and including the C360/J2240 workstations.  They
	  were also used in servers from the E-class to the K-class.  They
	  are not found in B1000, C3000, J5000, A500, L1000, N4000 and upwards.
	  If in doubt, say "Y".

config IOMMU_CCIO
	bool "U2/Uturn I/O MMU"
	depends on GSC
	help
	  Say Y here to enable DMA management routines for the first
	  generation of PA-RISC cache-coherent machines.  Programs the
	  U2/Uturn chip in "Virtual Mode" and use the I/O MMU.

config GSC_LASI
	bool "Lasi I/O support"
	depends on GSC
	help
	  Say Y here to directly support the Lasi controller chip found on
	  PA-RISC workstations.  Linux-oriented documentation for this chip
	  can be found at <http://www.parisc-linux.org/documentation/>.

config GSC_WAX
	bool "Wax I/O support"
	depends on GSC
	help
	  Say Y here to support the Wax GSC to EISA Bridge found in some older
	  systems, including B/C/D/R class.  Some machines use Wax for other
	  purposes, such as providing one of the serial ports or being an
	  interface chip for an X.25 GSC card.

config EISA
	bool "EISA support"
	depends on GSC
	help
	  Say Y here if you have an EISA bus in your machine.  This code
	  supports both the Mongoose & Wax EISA adapters.  It is sadly
	  incomplete and lacks support for card-to-host DMA.

config ISA
	bool
	depends on EISA

config PCI
	bool "PCI support"
	help
	  All recent HP machines have PCI slots, and you should say Y here
	  if you have a recent machine.  If you are convinced you do not have
	  PCI slots in your machine (eg a 712), then you may say "N" here.
	  Beware that some GSC cards have a Dino onboard and PCI inside them,
	  so it may be safest to say "Y" anyway.

config GSC_DINO
	bool "GSCtoPCI/Dino PCI support"
	depends on PCI && GSC
	help
	  Say Y here to support the Dino & Cujo GSC to PCI bridges found in
	  machines from the B132 to the C360, the J2240 and the A180.  Some
	  GSC/HSC cards (eg gigabit & dual 100 Mbit Ethernet) have a Dino on
	  the card, and you also need to say Y here if you have such a card.
	  If in doubt, say Y.

config PCI_LBA
	bool "LBA/Elroy PCI support"
	depends on PCI
	help
	  Say Y here to support the Elroy PCI Lower Bus Adapter.  This is
	  present on B, C, J, L and N-class machines with 4-digit model
	  numbers and the A400/A500.

config IOSAPIC
	bool
	depends on PCI_LBA
	default y

config IOMMU_SBA
	bool
	depends on PCI_LBA
	default y

#config PCI_EPIC
#	bool "EPIC/SAGA PCI support"
#	depends on PCI

config SUPERIO
	bool
	depends on PCI
	help
	  Say Y here to support the SuperIO chip found in Bxxxx, C3xxx and
	  J5xxx+ machines.

source "drivers/pci/Kconfig"

config CHASSIS_LCD_LED
	bool "Chassis LCD and LED support"

endmenu
```

## drivers/pci/Kconfig
```kconfig
#
# PCI configuration
#
config ARCH_SUPPORTS_MSI
	bool
	default n

config PCI_MSI
	bool "Message Signaled Interrupts (MSI and MSI-X)"
	depends on PCI
	depends on ARCH_SUPPORTS_MSI
	help
	   This allows device drivers to enable MSI (Message Signaled
	   Interrupts).  Message Signaled Interrupts enable a device to
	   generate an interrupt using an inbound Memory Write on its
	   PCI bus instead of asserting a device IRQ pin.

	   Use of PCI MSI interrupts can be disabled at kernel boot time
	   by using the 'pci=nomsi' option.  This disables MSI for the
	   entire system.

	   If you don't know what to do here, say Y.

config PCI_DEBUG
	bool "PCI Debugging"
	depends on PCI && DEBUG_KERNEL
	help
	  Say Y here if you want the PCI core to produce a bunch of debug
	  messages to the system log.  Select this if you are having a
	  problem with PCI support and want to see more of what is going on.

	  When in doubt, say N.

config PCI_GUESTDEV
	bool "PCI Device Reservation for Passthrough"
	depends on PCI && ACPI && XEN
	default y
	help
	  Say Y here if you want to reserve PCI device for passthrough.

config PCI_IOMULTI
	tristate "PCI Device IO Multiplex for Passthrough"
	depends on PCI && ACPI && XEN
	default y
	help
	  Say Y here if you need io multiplexing.

config PCI_RESERVE
	bool "PCI IO/MEMORY space reserve"
	depends on PCI && XEN_PRIVILEGED_GUEST
	default y
	help
	  Say Y here if you need PCI IO/MEMORY space reserve

config PCI_STUB
	tristate "PCI Stub driver"
	depends on PCI
	help
	  Say Y or M here if you want be able to reserve a PCI device
	  when it is going to be assigned to a guest operating system.

	  When in doubt, say N.

config PARAVIRT_XEN_PCIDEV_FRONTEND
        tristate "Xen PCI Frontend"
        depends on PCI && X86 && PARAVIRT_XEN
        select HOTPLUG
        select PCI_XEN
	select XEN_XENBUS_FRONTEND
        default y
        help
          The PCI device frontend driver allows the kernel to import arbitrary
          PCI devices from a PCI backend to support PCI driver domains.

config XEN_PCIDEV_FRONTEND
	def_bool y
	prompt "Xen PCI Frontend" if X86_64 && !XEN_UNPRIVILEGED_GUEST
	depends on PCI && XEN && (PCI_GOXEN_FE || PCI_GOANY || X86_64)
 	select HOTPLUG
	help
	  The PCI device frontend driver allows the kernel to import arbitrary
	  PCI devices from a PCI backend to support PCI driver domains.

config XEN_PCIDEV_FE_DEBUG
        bool "Xen PCI Frontend debugging"
        depends on XEN_PCIDEV_FRONTEND || (PARAVIRT_XEN_PCIDEV_FRONTEND && PCI_DEBUG)
	help
	  Say Y here if you want the Xen PCI frontend to produce a bunch of debug
	  messages to the system log.  Select this if you are having a
	  problem with Xen PCI frontend support and want to see more of what is
	  going on.

	  When in doubt, say N.

config HT_IRQ
	bool "Interrupts on hypertransport devices"
	default y
	depends on PCI && X86_LOCAL_APIC && X86_IO_APIC && !XEN
	help
	   This allows native hypertransport devices to use interrupts.

	   If unsure say Y.

config PCI_IOV
	bool "PCI IOV support"
	depends on PCI
	help
	  I/O Virtualization is a PCI feature supported by some devices
	  which allows them to create virtual devices which share their
	  physical resources.

	  If unsure, say N.

config PCI_IOAPIC
	bool
	depends on PCI && !XEN
	depends on ACPI
	depends on HOTPLUG
	default y

config PCI_LABEL
	def_bool y if (DMI || ACPI)
	select NLS
```

## drivers/pci/hotplug/Kconfig
```kconfig
#
# PCI Hotplug support
#

menu "PCI Hotplug Support"
	depends on HOTPLUG

config HOTPLUG_PCI
	tristate "Support for PCI Hotplug (EXPERIMENTAL)"
	depends on PCI && EXPERIMENTAL
	---help---
	  Say Y here if you have a motherboard with a PCI Hotplug controller.
	  This allows you to add and remove PCI cards while the machine is
	  powered up and running.  The file system pcihpfs must be mounted
	  in order to interact with any PCI Hotplug controllers.

	  This code is also available as a module ( = code which can be
	  inserted in and removed from the running kernel whenever you want).
	  The module will be called pci_hotplug. If you want to compile it
	  as a module, say M here and read <file:Documentation/modules.txt>.

	  When in doubt, say N.

config HOTPLUG_PCI_FAKE
	tristate "Fake PCI Hotplug driver"
	depends on HOTPLUG_PCI
	help
	  Say Y here if you want to use the fake PCI hotplug driver. It can
	  be used to simulate PCI hotplug events if even if your system is
	  not PCI hotplug capable.

	  This driver will "emulate" removing PCI devices from the system.
	  If the "power" file is written to with "0" then the specified PCI
	  device will be completely removed from the kernel.

	  WARNING, this does NOT turn off the power to the PCI device.
	  This is a "logical" removal, not a physical or electrical
	  removal.

	  Use this module at your own risk.  You have been warned!

	  This code is also available as a module ( = code which can be
	  inserted in and removed from the running kernel whenever you want).
	  The module will be called fakephp. If you want to compile it
	  as a module, say M here and read <file:Documentation/modules.txt>.

	  When in doubt, say N.

config HOTPLUG_PCI_COMPAQ
	tristate "Compaq PCI Hotplug driver"
	depends on HOTPLUG_PCI && X86
	help
	  Say Y here if you have a motherboard with a Compaq PCI Hotplug
	  controller.

	  This code is also available as a module ( = code which can be
	  inserted in and removed from the running kernel whenever you want).
	  The module will be called cpqphp. If you want to compile it
	  as a module, say M here and read <file:Documentation/modules.txt>.

	  When in doubt, say N.

config HOTPLUG_PCI_COMPAQ_NVRAM
	bool "Save configuration into NVRAM on Compaq servers"
	depends on HOTPLUG_PCI_COMPAQ
	help
	  Say Y here if you have a Compaq server that has a PCI Hotplug
	  controller.  This will allow the PCI Hotplug driver to store the PCI
	  system configuration options in NVRAM.

	  When in doubt, say N.

config HOTPLUG_PCI_IBM
	tristate "IBM PCI Hotplug driver"
	depends on HOTPLUG_PCI && X86_IO_APIC && X86
	help
	  Say Y here if you have a motherboard with a IBM PCI Hotplug
	  controller.

	  This code is also available as a module ( = code which can be
	  inserted in and removed from the running kernel whenever you want).
	  The module will be called cpqphp. If you want to compile it
	  as a module, say M here and read <file:Documentation/modules.txt>.

	  When in doubt, say N.

config HOTPLUG_PCI_ACPI
	tristate "ACPI PCI Hotplug driver"
	depends on ACPI_BUS && HOTPLUG_PCI
	help
	  Say Y here if you have a system that supports PCI Hotplug using
	  ACPI.

	  This code is also available as a module ( = code which can be
	  inserted in and removed from the running kernel whenever you want).
	  The module will be called acpiphp. If you want to compile it
	  as a module, say M here and read <file:Documentation/modules.txt>.

	  When in doubt, say N.

config HOTPLUG_PCI_CPCI
	tristate "CompactPCI Hotplug driver"
	depends on HOTPLUG_PCI
	help
	  Say Y here if you have a CompactPCI system card with CompactPCI
	  hotswap support per the PICMG 2.1 specification.

	  This code is also available as a module ( = code which can be
	  inserted in and removed from the running kernel whenever you want).
	  The module will be called cpci_hotplug. If you want to compile it
	  as a module, say M here and read <file:Documentation/modules.txt>.

	  When in doubt, say N.

config HOTPLUG_PCI_CPCI_ZT5550
	tristate "Ziatech ZT5550 CompactPCI Hotplug driver"
	depends on HOTPLUG_PCI_CPCI && X86
	help
	  Say Y here if you have an Performance Technologies (formerly Intel,
          formerly just Ziatech) Ziatech ZT5550 CompactPCI system card.

	  This code is also available as a module ( = code which can be
	  inserted in and removed from the running kernel whenever you want).
	  The module will be called cpcihp_zt5550. If you want to compile it
	  as a module, say M here and read <file:Documentation/modules.txt>.

	  When in doubt, say N.

config HOTPLUG_PCI_CPCI_GENERIC
	tristate "Generic port I/O CompactPCI Hotplug driver"
	depends on HOTPLUG_PCI_CPCI && X86
	help
	  Say Y here if you have a CompactPCI system card that exposes the #ENUM
	  hotswap signal as a bit in a system register that can be read through
	  standard port I/O.

	  This code is also available as a module ( = code which can be
	  inserted in and removed from the running kernel whenever you want).
	  The module will be called cpcihp_generic. If you want to compile it
	  as a module, say M here and read <file:Documentation/modules.txt>.

	  When in doubt, say N.

endmenu
```

## drivers/pcmcia/Kconfig
```kconfig
#
# PCMCIA bus subsystem configuration
#
# Right now the non-CardBus choices are not supported
# by the integrated kernel driver.
#

menu "PCMCIA/CardBus support"
	depends on HOTPLUG

config PCMCIA
	tristate "PCMCIA/CardBus support"
	---help---
	  Say Y here if you want to attach PCMCIA- or PC-cards to your Linux
	  computer.  These are credit-card size devices such as network cards,
	  modems or hard drives often used with laptops computers.  There are
	  actually two varieties of these cards: the older 16 bit PCMCIA cards
	  and the newer 32 bit CardBus cards.  If you want to use CardBus
	  cards, you need to say Y here and also to "CardBus support" below.

	  To use your PC-cards, you will need supporting software from David
	  Hinds' pcmcia-cs package (see the file <file:Documentation/Changes>
	  for location).  Please also read the PCMCIA-HOWTO, available from
	  <http://www.tldp.org/docs.html#howto>.

	  To compile this driver as modules, choose M here: the
	  modules will be called pcmcia_core and ds.

config PCMCIA_DEBUG
	bool "Enable PCMCIA debugging"
	depends on PCMCIA != n
	help
	  Say Y here to enable PCMCIA subsystem debugging.  You
	  will need to choose the debugging level either via the
	  kernel command line, or module options depending whether
	  you build the PCMCIA as modules.

	  The kernel command line options are:
	    pcmcia_core.pc_debug=N
	    ds.pc_debug=N
	    sa11xx_core.pc_debug=N

	  The module option is called pc_debug=N

	  In all the above examples, N is the debugging verbosity
	  level.

config YENTA
	tristate "CardBus yenta-compatible bridge support"
	depends on PCMCIA && PCI
	---help---
	  CardBus is a bus mastering architecture for PC-cards, which allows
	  for 32 bit PC-cards (the original PCMCIA standard specifies only
	  a 16 bit wide bus). Many newer PC-cards are actually CardBus cards.

	  This option enables support for CardBus PC Cards, as well as support
	  for CardBus host bridges.  Virtually all modern PCMCIA bridges are
	  CardBus compatible.  A "bridge" is the hardware inside your computer
	  that PCMCIA cards are plugged into.

	  To use your PC-cards, you will need supporting software from David
	  Hinds' pcmcia-cs package (see the file <file:Documentation/Changes>
	  for location).

	  If unsure, say Y.

config CARDBUS
	bool
	depends on YENTA
	default y if YENTA

config I82092
	tristate "i82092 compatible bridge support"
	depends on PCMCIA && PCI
	help
	  This provides support for the Intel I82092AA PCI-to-PCMCIA bridge device,
	  found in some older laptops and more commonly in evaluation boards for the
	  chip.

config I82365
	tristate "i82365 compatible bridge support"
	depends on PCMCIA && ISA
	help
	  Say Y here to include support for ISA-bus PCMCIA host bridges that
	  are register compatible with the Intel i82365.  These are found on
	  older laptops and ISA-bus card readers for desktop systems.  A
	  "bridge" is the hardware inside your computer that PCMCIA cards are
	  plugged into. If unsure, say N.

config TCIC
	tristate "Databook TCIC host bridge support"
	depends on PCMCIA
	help
	  Say Y here to include support for the Databook TCIC family of PCMCIA
	  host bridges. These are only found on a handful of old systems.
	  "Bridge" is the name used for the hardware inside your computer that
	  PCMCIA cards are plugged into. If unsure, say N.

config HD64465_PCMCIA
	tristate "HD64465 host bridge support"
	depends on HD64465 && PCMCIA

config PCMCIA_SA1100
	tristate "SA1100 support"
	depends on ARM && ARCH_SA1100 && PCMCIA
	help
	  Say Y here to include support for SA11x0-based PCMCIA or CF
	  sockets, found on HP iPAQs, Yopy, and other StrongARM(R)/
	  Xscale(R) embedded machines.

	  This driver is also available as a module called sa1100_cs.

config PCMCIA_SA1111
	tristate "SA1111 support"
	depends on ARM && ARCH_SA1100 && SA1111 && PCMCIA
	help
	  Say Y  here to include support for SA1111-based PCMCIA or CF
	  sockets, found on the Jornada 720, Graphicsmaster and other
	  StrongARM(R)/Xscale(R) embedded machines.

	  This driver is also available as a module called sa1111_cs.

config PCMCIA_PXA2XX
	tristate "PXA2xx support"
	depends on ARM && ARCH_PXA && PCMCIA
	help
	  Say Y here to include support for the PXA2xx PCMCIA controller


config PCMCIA_PROBE
	bool
	default y if ISA && !ARCH_SA1100 && !ARCH_CLPS711X

endmenu
```
