## drivers/scsi/qla2xxx/Kconfig
```kconfig
config SCSI_QLA2XXX_CONFIG
	tristate
	default (SCSI && PCI)
	depends on SCSI && PCI

config SCSI_QLA21XX
	tristate "QLogic ISP2100 host adapter family support"
	depends on SCSI_QLA2XXX_CONFIG
	---help---
	This driver supports the QLogic 21xx (ISP2100) host adapter family.

config SCSI_QLA22XX
	tristate "QLogic ISP2200 host adapter family support"
	depends on SCSI_QLA2XXX_CONFIG
	---help---
	This driver supports the QLogic 22xx (ISP2200) host adapter family.

config SCSI_QLA23XX
	tristate "QLogic ISP23xx host adapter family support"
	depends on SCSI_QLA2XXX_CONFIG
	---help---
	This driver supports the QLogic 23xx (ISP2300, ISP2312, ISP2322, 
	ISP6312 and ISP6322) host adapter family.
```

## drivers/scsi/qla4xxx/Kconfig
```kconfig
config SCSI_QLA4XXX
	tristate "QLogic ISP4XXX host adapter family support"
        depends on PCI && SCSI
	---help---
	This driver supports the QLogic 40xx (ISP4XXX) host adapter family.
```
