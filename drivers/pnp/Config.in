## drivers/s390/net/Kconfig
```kconfig
menu "S/390 network device drivers"
	depends on NETDEVICES && ARCH_S390

config LCS
	tristate "Lan Channel Station Interface"
	depends on NETDEVICES && (NET_ETHERNET || TR || FDDI)
	help
	   Select this option if you want to use LCS networking  on IBM S/390
  	   or zSeries. This device driver supports Token Ring (IEEE 802.5),
  	   FDDI (IEEE 802.7) and Ethernet. 
	   This option is also available as a module which will be
	   called lcs.ko. If you do not know what it is, it's safe to say "Y".

config CTC
	tristate "CTC device support"
	depends on NETDEVICES
	help
	  Select this option if you want to use channel-to-channel networking
	  on IBM S/390 or zSeries. This device driver supports real CTC
	  coupling using ESCON. It also supports virtual CTCs when running
	  under VM. It will use the channel device configuration if this is
	  available.  This option is also available as a module which will be
	  called ctc.ko.  If you do not know what it is, it's safe to say "Y".

config IUCV
	tristate "IUCV device support (VM only)"
	depends on NETDEVICES
	help
	  Select this option if you want to use inter-user communication
	  vehicle networking under VM or VIF.  This option is also available
	  as a module which will be called iucv.ko. If unsure, say "Y".


config QETH
	tristate "Gigabit Ethernet device support"
	depends on NETDEVICES && IP_MULTICAST && QDIO
	help
	  This driver supports the IBM S/390 and zSeries OSA Express adapters
	  in QDIO mode (all media types), HiperSockets interfaces and VM GuestLAN
	  interfaces in QDIO and HIPER mode.
	
	  For details please refer to the documentation provided by IBM at   
	  <http://www10.software.ibm.com/developerworks/opensource/linux390>

	  To compile this driver as a module, choose M here: the
	  module will be called qeth.


comment "Gigabit Ethernet default settings"
	depends on QETH

config QETH_IPV6
	bool "IPv6 support for gigabit ethernet"
	depends on (QETH = IPV6) || (QETH && IPV6 = 'y')
	help
	  If CONFIG_QETH is switched on, this option will include IPv6
	  support in the qeth device driver.
	
config QETH_VLAN
	bool "VLAN support for gigabit ethernet"
	depends on (QETH = VLAN_8021Q) || (QETH && VLAN_8021Q = 'y')
	help
	  If CONFIG_QETH is switched on, this option will include IEEE
	  802.1q VLAN support in the qeth device driver.

config QETH_PERF_STATS
	bool "Performance statistics in /proc"
	depends on QETH
	help
	  When switched on, this option will add a file in the proc-fs
	  (/proc/qeth_perf_stats) containing performance statistics. It
	  may slightly impact performance, so this is only recommended for
	  internal tuning of the device driver.

config CCWGROUP
 	tristate
	default (LCS || CTC || QETH)

endmenu
```

## drivers/scsi/aic7xxx/Kconfig
```kconfig
#
# AIC7XXX and AIC79XX 2.5.X Kernel configuration File.
# $Id: //depot/linux-aic79xx-2.5.0/drivers/scsi/aic7xxx/Kconfig#2 $
#
config SCSI_AIC7XXX
	tristate "Adaptec AIC7xxx Fast -> U160 support"
	---help---
	This driver supports all of Adaptec's Fast through Ultra 160 PCI
	based SCSI controllers as well as the aic7770 based EISA and VLB
	SCSI controllers (the 274x and 284x series).  For AAA and ARO based
	configurations, only SCSI functionality is provided.

	If you want to compile the driver as a module ( = code which can be
	inserted in and removed from the running kernel whenever you want),
	say M here and read <file:Documentation/modules.txt>.  The module
	will be called aic7xxx.o.

config AIC7XXX_CMDS_PER_DEVICE
	int "Maximum number of TCQ commands per device"
	depends on SCSI_AIC7XXX
	default "32"
	---help---
	Specify the number of commands you would like to allocate per SCSI
	device when Tagged Command Queueing (TCQ) is enabled on that device.

	This is an upper bound value for the number of tagged transactions
	to be used for any device.  The aic7xxx driver will automatically
	vary this number based on device behavior.  For devices with a
	fixed maximum, the driver will eventually lock to this maximum
	and display a console message inidicating this value.

	Due to resource allocation issues in the Linux SCSI mid-layer, using
	a high number of commands per device may result in memory allocation
	failures when many devices are attached to the system.  For this reason,
	the default is set to 32.  Higher values may result in higer performance
	on some devices.  The upper bound is 253.  0 disables tagged queueing.

	Per device tag depth can be controlled via the kernel command line
	"tag_info" option.  See drivers/scsi/aic7xxx/README.aic7xxx
	for details.

config AIC7XXX_RESET_DELAY_MS
	int "Initial bus reset delay in milli-seconds"
	depends on SCSI_AIC7XXX
	default "15000"
	---help---
	The number of milliseconds to delay after an initial bus reset.
	The bus settle delay following all error recovery actions is
	dictated by the SCSI layer and is not affected by this value.

	Default: 15000 (15 seconds)

config AIC7XXX_PROBE_EISA_VL
	bool "Probe for EISA and VL AIC7XXX Adapters"
	help
	Probe for EISA and VLB Aic7xxx controllers.  In many newer systems,
	the invasive probes necessary to detect these controllers can cause
	other devices to fail.  For this reason, the non-PCI probe code is
	disabled by default.  The current value of this option can be "toggled"
	via the no_probe kernel command line option.

config AIC7XXX_BUILD_FIRMWARE
	bool "Build Adapter Firmware with Kernel Build"
	depends on SCSI_AIC7XXX
	help
	This option should only be enabled if you are modifying the firmware
	source to the aic7xxx driver and wish to have the generated firmware
	include files updated during a normal kernel build.  The assembler
	for the firmware requires lex and yacc or their equivalents, as well
	as the db v1 library.  You may have to install additional packages
	or modify the assembler Makefile or the files it includes if your
	build environment is different than that of the author.

config AIC7XXX_DEBUG_ENABLE
	bool "Compile in Debugging Code"
	depends on SCSI_AIC7XXX
	default y
	help
	Compile in aic7xxx debugging code that can be useful in diagnosing
	driver errors.

config AIC7XXX_DEBUG_MASK
        int "Debug code enable mask (2047 for all debugging)"
        depends on SCSI_AIC7XXX
        default "0"
        help
	Bit mask of debug options that is only valid if the
	CONFIG_AIC7XXX_DEBUG_ENBLE option is enabled.  The bits in this mask
	are defined in the drivers/scsi/aic7xxx/aic7xxx.h - search for the
	variable ahc_debug in that file to find them.

config AIC7XXX_REG_PRETTY_PRINT
        bool "Decode registers during diagnostics"
        depends on SCSI_AIC7XXX
	default y
        help
	Compile in register value tables for the output of expanded register
	contents in diagnostics.  This make it much easier to understand debug
	output without having to refer to a data book and/or the aic7xxx.reg
	file.

config SCSI_AIC79XX
	tristate "Adaptec AIC79xx U320 support"
	help
	This driver supports all of Adaptec's Ultra 320 PCI-X
	based SCSI controllers.

config AIC79XX_CMDS_PER_DEVICE
	int "Maximum number of TCQ commands per device"
	depends on SCSI_AIC79XX
	default "32"
	---help---
	Specify the number of commands you would like to allocate per SCSI
	device when Tagged Command Queueing (TCQ) is enabled on that device.

	This is an upper bound value for the number of tagged transactions
	to be used for any device.  The aic7xxx driver will automatically
	vary this number based on device behavior.  For devices with a
	fixed maximum, the driver will eventually lock to this maximum
	and display a console message inidicating this value.

	Due to resource allocation issues in the Linux SCSI mid-layer, using
	a high number of commands per device may result in memory allocation
	failures when many devices are attached to the system.  For this reason,
	the default is set to 32.  Higher values may result in higer performance
	on some devices.  The upper bound is 253.  0 disables tagged queueing.

	Per device tag depth can be controlled via the kernel command line
	"tag_info" option.  See drivers/scsi/aic7xxx/README.aic79xx
	for details.

config AIC79XX_RESET_DELAY_MS
	int "Initial bus reset delay in milli-seconds"
	depends on SCSI_AIC79XX
	default "15000"
	---help---
	The number of milliseconds to delay after an initial bus reset.
	The bus settle delay following all error recovery actions is
	dictated by the SCSI layer and is not affected by this value.

	Default: 15000 (15 seconds)

config AIC79XX_BUILD_FIRMWARE
	bool "Build Adapter Firmware with Kernel Build"
	depends on SCSI_AIC79XX
	help
	This option should only be enabled if you are modifying the firmware
	source to the aic79xx driver and wish to have the generated firmware
	include files updated during a normal kernel build.  The assembler
	for the firmware requires lex and yacc or their equivalents, as well
	as the db v1 library.  You may have to install additional packages
	or modify the assembler Makefile or the files it includes if your
	build environment is different than that of the author.

config AIC79XX_ENABLE_RD_STRM
	bool "Enable Read Streaming for All Targets"
	depends on SCSI_AIC79XX
	help
	Read Streaming is a U320 protocol option that should enhance
	performance.  Early U320 drive firmware actually performs slower
	with read streaming enabled so it is disabled by default.  Read
	Streaming can be configured in much the same way as tagged queueing
	using the "rd_strm" command line option.  See
	drivers/scsi/aic7xxx/README.aic79xx for details.

config AIC79XX_DEBUG_ENABLE
	bool "Compile in Debugging Code"
	depends on SCSI_AIC79XX
	default y
	help
	Compile in aic79xx debugging code that can be useful in diagnosing
	driver errors.

config AIC79XX_DEBUG_MASK
        int "Debug code enable mask (16383 for all debugging)"
        depends on SCSI_AIC79XX
        default "0"
        help
	Bit mask of debug options that is only valid if the
	CONFIG_AIC79XX_DEBUG_ENBLE option is enabled.  The bits in this mask
	are defined in the drivers/scsi/aic7xxx/aic79xx.h - search for the
	variable ahd_debug in that file to find them.

config AIC79XX_REG_PRETTY_PRINT
        bool "Decode registers during diagnostics"
        depends on SCSI_AIC79XX
	default y
        help
	Compile in register value tables for the output of expanded register
	contents in diagnostics.  This make it much easier to understand debug
	output without having to refer to a data book and/or the aic7xxx.reg
	file.
```

## drivers/scsi/megaraid/Kconfig.megaraid
```kconfig
config MEGARAID_NEWGEN
	bool "LSI Logic New Generation RAID Device Drivers"
	depends on PCI && SCSI
	default y
	help
	LSI Logic RAID Device Drivers

config MEGARAID_MM
	tristate "LSI Logic Management Module (New Driver)"
	depends on PCI && SCSI && MEGARAID_NEWGEN
	default m
	help
	Management Module provides ioctl, sysfs support for LSI Logic
	RAID controllers.
	To compile this driver as a module, choose M here: the
	module will be called megaraid_mm


config MEGARAID_MAILBOX
	tristate "LSI Logic MegaRAID Driver (New Driver)"
	depends on PCI && SCSI && MEGARAID_MM
	default $MEGARAID_MM
	help
	List of supported controllers

	OEM	Product Name		Ser	VID :DID :SVID:SSID
	---	------------		---	---- ---- ---- ----
	Dell	PERC3/Di		N/A	1028:000E:1028:0123
	Dell	PERC4/SC		520	1000:1960:1028:0520
	Dell	PERC4/DC		518	1000:1960:1028:0518
	Dell	PERC4/QC		531	1000:0407:1028:0531
	Dell	PERC4/Di		N/A	1028:000F:1028:014A
	Dell	PERC 4e/Si		N/A	1028:0013:1028:016c
	Dell	PERC 4e/Di		N/A	1028:0013:1028:016d
	Dell	PERC 4e/Di		N/A	1028:0013:1028:016e
	Dell	PERC 4e/Di		N/A	1028:0013:1028:016f
	Dell	PERC 4e/Di		N/A	1028:0013:1028:0170
	Dell	PERC 4e/DC		N/A	1000:0408:1028:0002
	Dell	PERC 4e/SC		N/A	1000:0408:1028:0001

	LSI	MegaRAID SCSI 320-0	520-0	1000:1960:1000:A520
	LSI	MegaRAID SCSI 320-1	520	1000:1960:1000:0520
	LSI	MegaRAID SCSI 320-2	518	1000:1960:1000:0518
	LSI	MegaRAID SCSI 320-0X	EP055	1000:0407:1000:0530
	LSI	MegaRAID SCSI 320-2X	532	1000:0407:1000:0532
	LSI	MegaRAID SCSI 320-4X	531	1000:0407:1000:0531

	LSI	MegaRAID SCSI 320-1E	N/A	1000:0408:1000:0001
	LSI	MegaRAID SCSI 320-2E	EP078	1000:0408:1000:0002
	LSI	MegaRAID SCSI 320-4E

	LSI	MegaRAID SATA 150-2	534	1095:3112:1000:0534
	LSI	MegaRAID SATA 150-4	523	1000:1960:1000:4523
	LSI	MegaRAID SATA 150-6	523	1000:1960:1000:0523
	LSI	MegaRAID SATA 150-4X		1000:0409:1000:1504
	LSI	MegaRAID SATA 150-8X		1000:0409:1000:1508

	To compile this driver as a module, choose M here: the
	module will be called megaraid

config MEGARAID_LEGACY
	tristate "LSI Logic Legacy MegaRAID Driver"
	depends on PCI && SCSI
	default m
	help
	This driver supports the AMI MegaRAID 418, 428, 438, 466, 762, 490
	and 467 SCSI host adapters. This driver also support the all U320
	RAID controllers

	To compile this driver as a module, choose M here: the
	module will be called megaraid-old
```

## drivers/scsi/pcmcia/Kconfig
```kconfig
#
# PCMCIA SCSI adapter configuration
#

menu "PCMCIA SCSI adapter support"
	depends on SCSI!=n && PCMCIA!=n && MODULES

config PCMCIA_AHA152X
	tristate "Adaptec AHA152X PCMCIA support"
	depends on m
	help
	  Say Y here if you intend to attach this type of PCMCIA SCSI host
	  adapter to your computer.

	  This driver is also available as a module called aha152x_cs ( =
	  code which can be inserted in and removed from the running kernel
	  whenever you want). If you want to compile it as a module, say M
	  here and read <file:Documentation/modules.txt>.

config PCMCIA_FDOMAIN
	tristate "Future Domain PCMCIA support"
	depends on m
	help
	  Say Y here if you intend to attach this type of PCMCIA SCSI host
	  adapter to your computer.

	  This driver is also available as a module called fdomain_cs ( =
	  code which can be inserted in and removed from the running kernel
	  whenever you want).  If you want to compile it as a module, say M
	  here and read <file:Documentation/modules.txt>.

config PCMCIA_NINJA_SCSI
	tristate "NinjaSCSI-3 / NinjaSCSI-32Bi (16bit) PCMCIA support"
	depends on m
	help
	  If you intend to attach this type of PCMCIA SCSI host adapter to
	  your computer, say Y here and read
	  <file:Documentation/scsi/NinjaSCSI.txt>.

	  Supported cards:

	  NinjaSCSI-3: (version string: "WBT","NinjaSCSI-3","R1.0")
	    IO-DATA     PCSC-FP
	    ALPHA DATA  AD-PCS201
	    CyQ've      SFC-201  
	    LOGITECH    LPM-SCSI2E
	    Pioneer PCR-PR24's card
	    I-O DATA CDPS-PX24's card (PCSC-F)
	    Panasonic KXL-RW10AN CD-RW's card
	    etc.

	  NinjaSCSI-32Bit (in 16bit mode):
	    [Workbit (version string: "WORKBIT","UltraNinja-16","1")]
	    Jazz SCP050
	    [I-O DATA (OEM) (version string: "IO DATA","CBSC16       ","1")]
	    I-O DATA CBSC-II
	    [Kyusyu Matsushita Kotobuki (OEM)
               (version string: "KME    ","SCSI-CARD-001","1")]
	    KME KXL-820AN's card
	    HP M820e CDRW's card
	    etc.

	  This driver is also available as a module called nsp_cs ( =
	  code which can be inserted in and removed from the running kernel
	  whenever you want). If you want to compile it as a module, say M
	  here and read <file:Documentation/modules.txt>.

config PCMCIA_QLOGIC
	tristate "Qlogic PCMCIA support"
	depends on m
	help
	  Say Y here if you intend to attach this type of PCMCIA SCSI host
	  adapter to your computer.

	  This driver is also available as a module called qlogic_cs ( =
	  code which can be inserted in and removed from the running kernel
	  whenever you want).  If you want to compile it as a module, say M
	  here and read <file:Documentation/modules.txt>.

endmenu
```
