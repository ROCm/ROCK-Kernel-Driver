## drivers/pnp/Kconfig
```kconfig
#
# Plug and Play configuration
#

menu "Plug and Play support"

config PNP
	bool "Plug and Play support"
	---help---
	  Plug and Play (PnP) is a standard for peripherals which allows those
	  peripherals to be configured by software, e.g. assign IRQ's or other
	  parameters. No jumpers on the cards are needed, instead the values
	  are provided to the cards from the BIOS, from the operating system,
	  or using a user-space utility.

	  Say Y here if you would like Linux to configure your Plug and Play
	  devices. You should then also say Y to all of the protocols below.
	  Alternatively, you can say N here and configure your PnP devices
	  using user space utilities such as the isapnptools package.

	  If unsure, say Y.

config PNP_DEBUG
	bool "PnP Debug Messages"
	depends on PNP
	help
	  Say Y if you want the Plug and Play Layer to print debug messages.
	  This is useful if you are developing a PnP driver or troubleshooting.

comment "Protocols"
	depends on PNP

config ISAPNP
	bool "ISA Plug and Play support (EXPERIMENTAL)"
	depends on PNP && EXPERIMENTAL
	help
	  Say Y here if you would like support for ISA Plug and Play devices.
	  Some information is in <file:Documentation/isapnp.txt>.

	  If unsure, say Y.

config PNPBIOS
	bool "Plug and Play BIOS support (EXPERIMENTAL)"
	depends on PNP && EXPERIMENTAL
	---help---
	  Linux uses the PNPBIOS as defined in "Plug and Play BIOS
	  Specification Version 1.0A May 5, 1994" to autodetect built-in
	  mainboard resources (e.g. parallel port resources).

	  Some features (e.g. event notification, docking station information,
	  ISAPNP services) are not used.

	  Note: ACPI is expected to supersede PNPBIOS some day, currently it
	  co-exists nicely.

	  See latest pcmcia-cs (stand-alone package) for a nice "lspnp" tools,
	  or have a look at /proc/bus/pnp.

	  If unsure, say Y.

endmenu
```

## drivers/s390/Config.in
```kconfig
mainmenu_option next_comment
comment 'Block device drivers'

tristate 'Loopback device support' CONFIG_BLK_DEV_LOOP
dep_tristate 'Network block device support' CONFIG_BLK_DEV_NBD $CONFIG_NET
tristate 'RAM disk support' CONFIG_BLK_DEV_RAM
if [ "$CONFIG_BLK_DEV_RAM" = "y" -o "$CONFIG_BLK_DEV_RAM" = "m" ]; then
  int '   Default RAM disk size' CONFIG_BLK_DEV_RAM_SIZE 24576
fi
dep_bool '   Initial RAM disk (initrd) support' CONFIG_BLK_DEV_INITRD
tristate 'XPRAM disk support' CONFIG_BLK_DEV_XPRAM

comment 'S/390 block device drivers'

tristate 'Support for DASD devices' CONFIG_DASD
if [ "$CONFIG_DASD" != "n"  ]; then
  bool '   Support for ECKD Disks' CONFIG_DASD_ECKD
  bool '   Support for FBA  Disks' CONFIG_DASD_FBA
#  bool '   Support for CKD  Disks' CONFIG_DASD_CKD
  if [ "$CONFIG_ARCH_S390" = "y" ]; then
    bool '   Support for DIAG access to CMS reserved Disks' CONFIG_DASD_MDSK
  fi;
fi

endmenu

source drivers/md/Config.in

mainmenu_option next_comment
comment 'Character device drivers'
bool 'Unix98 PTY support' CONFIG_UNIX98_PTYS
if [ "$CONFIG_UNIX98_PTYS" = "y" ]; then
  int 'Maximum number of Unix98 PTYs in use (0-2048)' CONFIG_UNIX98_PTY_COUNT 256
fi

comment 'S/390 character device drivers'

bool 'Support for 3215 line mode terminal' CONFIG_3215
if [ "$CONFIG_3215" = "y" ]; then
  bool 'Support for console on 3215 line mode terminal' CONFIG_3215_CONSOLE
fi
bool 'Support for HWC line mode terminal' CONFIG_HWC
if [ "$CONFIG_HWC" = "y" ]; then
  bool 'console on HWC line mode terminal' CONFIG_HWC_CONSOLE
fi
tristate 'S/390 tape device support' CONFIG_S390_TAPE
if [ "$CONFIG_S390_TAPE" != "n" ]; then
  comment 'S/390 tape interface support'
  bool '   Support for tape character devices' CONFIG_S390_TAPE_CHAR
  bool '   Support for tape block devices' CONFIG_S390_TAPE_BLOCK
  comment 'S/390 tape hardware support'
  bool '   Support for 3490 tape hardware' CONFIG_S390_TAPE_3490
  bool '   Support for 3480 tape hardware' CONFIG_S390_TAPE_3480
fi
endmenu

if [ "$CONFIG_NET" = "y" ]; then
  mainmenu_option next_comment
  comment 'Network device drivers'
  bool 'Network device support' CONFIG_NETDEVICES

  if [ "$CONFIG_NETDEVICES" = "y" ]; then
    tristate 'Dummy net driver support' CONFIG_DUMMY
    bool 'Ethernet (10 or 100Mbit)' CONFIG_NET_ETHERNET
    bool 'Token Ring driver support' CONFIG_TR
    bool 'FDDI driver support' CONFIG_FDDI
    comment 'S/390 network device drivers'
    bool 'Channel Device Configuration (Temporary Option)' CONFIG_CHANDEV
    tristate 'CTC device support' CONFIG_CTC
    tristate 'IUCV device support (VM only)' CONFIG_IUCV
  fi
  endmenu
fi
```
