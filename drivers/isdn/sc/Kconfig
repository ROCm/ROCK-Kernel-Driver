## drivers/message/fusion/Kconfig
```kconfig
menu "Fusion MPT device support"

config FUSION
	tristate "Fusion MPT (base + ScsiHost) drivers"
	depends on PCI && SCSI
	---help---
	  LSI Logic Fusion(TM) Message Passing Technology (MPT) device support
	  provides high performance SCSI host initiator, and LAN [1] interface
	  services to a host system.  The Fusion architecture is capable of
	  duplexing these protocols on high-speed Fibre Channel
	  (up to 2 GHz x 2 ports = 4 GHz) and parallel SCSI (up to Ultra-320)
	  physical medium.

	  [1] LAN is not supported on parallel SCSI medium.

config FUSION_MAX_SGE
	int "Maximum number of scatter gather entries"
	depends on FUSION
	default "40"
	help
	  This option allows you to specify the maximum number of scatter-
	  gather entries per I/O. The driver defaults to 40, a reasonable number
	  for most systems. However, the user may increase this up to 128.
	  Increasing this parameter will require significantly more memory 
	  on a per controller instance. Increasing the parameter is not
	  necessary (or recommended) unless the user will be running 
	  large I/O's via the raw interface.

config FUSION_ISENSE
	tristate "Enhanced SCSI error reporting"
	depends on MODULES && FUSION && m
	---help---
	  The isense module (roughly stands for Interpret SENSE data) is
	  completely optional.  It simply provides extra English readable
	  strings in SCSI Error Report(s) that might be generated from the
	  Fusion MPT SCSI Host driver, for example when a target device
	  returns a SCSI check condition on a I/O.  Without this module
	  loaded you might see:

	  SCSI Error Report =-=-= (ioc0,scsi5:0)
	  SCSI_Status=02h (CHECK_CONDITION)
	  Original_CDB[]: 2A 00 00 00 00 41 00 00 02 00
	  SenseData[12h]: 70 00 02 00 00 00 00 0A 00 00 00 00 04 02 02 00 00 00
	  SenseKey=2h (NOT READY); FRU=02h
	  ASC/ASCQ=29h/00h

	  Where otherwise, if this module had been loaded, you would see:

	  SCSI Error Report =-=-= (ioc0,scsi5:0)
	  SCSI_Status=02h (CHECK_CONDITION)
	  Original_CDB[]: 2A 00 00 00 00 41 00 00 02 00 - "WRITE(10)"
	  SenseData[12h]: 70 00 02 00 00 00 00 0A 00 00 00 00 04 02 02 00 00 00
	  SenseKey=2h (NOT READY); FRU=02h
	  ASC/ASCQ=29h/00h "LOGICAL UNIT NOT READY, INITIALIZING CMD. REQUIRED"

	  Say M for "Enhanced SCSI error reporting" to compile this optional module,
	  creating a driver named: isense.

	  NOTE: Support for building this feature into the kernel is not
	  available, due to kernel size considerations.

config FUSION_CTL
	tristate "Fusion MPT misc device (ioctl) driver"
	depends on MODULES && FUSION && m
	---help---
	  The Fusion MPT misc device driver provides specialized control
	  of MPT adapters via system ioctl calls.  Use of ioctl calls to
	  the MPT driver requires that you create and use a misc device
	  node ala:
	  mknod /dev/mptctl c 10 240

	  One use of this ioctl interface is to perform an upgrade (reflash)
	  of the MPT adapter firmware.  Refer to readme file(s) distributed
	  with the Fusion MPT linux driver for additional details.

	  If enabled by saying M to this, a driver named: mptctl
	  will be compiled.

	  If unsure whether you really want or need this, say N.

config FUSION_LAN
	tristate "Fusion MPT LAN driver"
	depends on FUSION && NET_FC
	---help---
	  This module supports LAN IP traffic over Fibre Channel port(s)
	  on Fusion MPT compatible hardware (LSIFC9xx chips).
	  The physical interface used is defined in RFC 2625.
	  Please refer to that document for details.

	  Installing this driver requires the knowledge to configure and
	  activate a new network interface, "fc0", using standard Linux tools.

	  If enabled by saying M to this, a driver named: mptlan
	  will be compiled.

	  If unsure whether you really want or need this, say N.

endmenu
```

## drivers/misc/Kconfig
```kconfig
#
# Misc strange devices
#

menu "Misc devices"

config IBM_ASM
	tristate "Device driver for IBM RSA service processor"
	depends on X86
	default n
	---help---
	  This option enables device driver support for in-band access to the
	  IBM RSA (Condor) service processor in eServer xSeries systems.
	  The ibmasm device driver allows user space application to access
	  ASM (Advanced Systems Management) functions on the service
	  processor. The driver is meant to be used in conjunction with
	  a user space API.
	  The ibmasm driver also enables the OS to use the UART on the
	  service processor board as a regular serial port. To make use of
	  this feature serial driver support (CONFIG_SERIAL_8250) must be
	  enabled.
	  

	  If unsure, say N.

endmenu
```

## drivers/mmc/Kconfig
```kconfig
#
# MMC subsystem configuration
#

menu "MMC/SD Card support"

config MMC
	tristate "MMC support"
	help
	  MMC is the "multi-media card" bus protocol.

	  If you want MMC support, you should say Y here and also
	  to the specific driver for your MMC interface.

config MMC_DEBUG
	bool "MMC debugging"
	depends on MMC != n
	help
	  This is an option for use by developers; most people should
	  say N here.  This enables MMC core and driver debugging.

config MMC_BLOCK
	tristate "MMC block device driver"
	depends on MMC
	default y
	help
	  Say Y here to enable the MMC block device driver support.
	  This provides a block device driver, which you can use to
	  mount the filesystem. Almost everyone wishing MMC support
	  should say Y or M here.

config MMC_ARMMMCI
	tristate "ARM AMBA Multimedia Card Interface support"
	depends on ARM_AMBA && MMC
	help
	  This selects the ARM(R) AMBA(R) PrimeCell Multimedia Card
	  Interface (PL180 and PL181) support.  If you have an ARM(R)
	  platform with a Multimedia Card slot, say Y or M here.

	  If unsure, say N.

endmenu
```
