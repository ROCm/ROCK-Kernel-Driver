## drivers/isdn/sc/Kconfig
```kconfig
#
# Config.in for Spellcaster ISDN driver
#
config ISDN_DRV_SC
	tristate "Spellcaster support"
	depends on ISDN && ISA
	help
	  This enables support for the Spellcaster BRI ISDN boards.  This
	  driver currently builds only in a modularized version ( = code which
	  can be inserted in and removed from the running kernel whenever you
	  want, details in <file:Documentation/modules.txt>); the module will
	  be called sc.  See <file:Documentation/isdn/README.sc> and
	  <http://www.spellcast.com/> for more information.
```

## drivers/media/Kconfig
```kconfig
#
# Multimedia device configuration
#

menu "Multimedia devices"

config VIDEO_DEV
	tristate "Video For Linux"
	---help---
	  Support for audio/video capture and overlay devices and FM radio
	  cards. The exact capabilities of each device vary. User tools for
	  this are available from
	  <ftp://ftp.uk.linux.org/pub/linux/video4linux/>.

	  This kernel includes support for the new Video for Linux Two API,
	  (V4L2) as well as the original system. Drivers and applications
	  need to be rewritten to use V4L2, but drivers for popular cards
	  and applications for most video capture functions already exist.

	  Documentation for the original API is included in the file
	  Documentation/video4linux/API.html.  Documentation for V4L2 is
	  available on the web at http://bytesex.org/v4l/

	  This driver is also available as a module called videodev.o ( = code
	  which can be inserted in and removed from the running kernel
	  whenever you want). If you want to compile it as a module, say M
	  here and read <file:Documentation/modules.txt>.

source "drivers/media/video/Kconfig"

source "drivers/media/radio/Kconfig"

source "drivers/media/dvb/Kconfig"

endmenu
```

## drivers/media/common/Kconfig
```kconfig
config VIDEO_SAA7146
	def_tristate DVB_AV7110 || DVB_BUDGET || DVB_BUDGET_AV || \
		     VIDEO_MXB || VIDEO_DPC || VIDEO_HEXIUM_ORION || \
		     VIDEO_HEXIUM_GEMINI
        depends on VIDEO_DEV && PCI && I2C
config VIDEO_VIDEOBUF
	def_tristate VIDEO_SAA7134 || VIDEO_BT848 || VIDEO_SAA7146
        depends on VIDEO_DEV
```

## drivers/media/dvb/Config.in
```kconfig
#
# Multimedia device configuration
#
mainmenu_option next_comment
comment 'Digital Video Broadcasting Devices'

bool 'DVB For Linux' CONFIG_DVB

if [ "$CONFIG_DVB" != "n" ]; then
  source drivers/media/dvb/dvb-core/Config.in
  source drivers/media/dvb/frontends/Config.in

  comment 'Supported DVB Adapters'
  source drivers/media/dvb/av7110/Config.in
fi

endmenu
```

## drivers/media/dvb/Kconfig
```kconfig
#
# Multimedia device configuration
#

menu "Digital Video Broadcasting Devices"
	depends on NET && INET 

config DVB
	bool "DVB For Linux"
	---help---
	  Support Digital Video Broadcasting hardware.  Enable this if you 
	  own a DVB adapter and want to use it or if you compile Linux for 
	  a digital SetTopBox.

	  API specs and user tools and are available for example from 
	  <http://www.linuxtv.org/>. 

	  Please report problems regarding this driver to the LinuxDVB 
	  mailing list.

	  You might want add the following lines to your /etc/modules.conf:
	  	
	  	alias char-major-250 dvb
	  	alias dvb dvb-ttpci
	  	below dvb-ttpci alps_bsru6 alps_bsrv2 \
	  			grundig_29504-401 grundig_29504-491 \
	  			ves1820

	  If unsure say N.

source "drivers/media/dvb/dvb-core/Kconfig"

source "drivers/media/dvb/frontends/Kconfig"

comment "Supported SAA7146 based PCI Adapters"
	depends on DVB

source "drivers/media/dvb/ttpci/Kconfig"

endmenu
```

## drivers/media/dvb/av7110/Kconfig
```kconfig
config DVB_AV7110
	tristate "SAA7146 based AV7110 and Nova/budget cards"
	depends on VIDEO_DEV && DVB_CORE
	help
	  Support for SAA7146 and AV7110 based DVB cards as produced 
	  by Fujitsu-Siemens, Technotrend, Hauppauge and others.

	  Simple cards like so called Budget- or Nova-PCI cards are 
	  supported as well as fullfeatured cards with onboard MPEG2 
	  decoder.

	  Say Y if you own such a card and want to use it.

config DVB_AV7110_OSD
	bool "AV7110 OSD support"
	depends on DVB_AV7110
	help
	  The AV7110 firmware provides some code to generate an OnScreenDisplay
	  on the video output. This is kind of nonstandard and not guaranteed to
	  be maintained.

	  Anyway, some popular DVB software like VDR uses this OSD to render
	  its menus, so say Y if you want to use this software.

	  All other people say N.
```

## drivers/media/dvb/b2c2/Kconfig
```kconfig
config DVB_B2C2_SKYSTAR
	tristate "B2C2/Technisat Air/Sky/CableStar 2 PCI"
	depends on DVB_CORE && PCI
	select DVB_STV0299
	select DVB_MT352
	select DVB_MT312
	help
	  Support for the Skystar2 PCI DVB card by Technisat, which
	  is equipped with the FlexCopII chipset by B2C2.

	  Say Y if you own such a device and want to use it.

config DVB_B2C2_USB
	tristate "B2C2/Technisat Air/Sky/Cable2PC USB"
	depends on DVB_CORE && USB && EXPERIMENTAL
	select DVB_STV0299
	select DVB_MT352
	help
	  Support for the Air/Sky/Cable2PC USB DVB device by B2C2. Currently
	  this does nothing, but providing basic function for the used usb
	  protocol.

	  Say Y if you own such a device and want to use it.
```

## drivers/media/dvb/bt8xx/Kconfig
```kconfig
config DVB_BT8XX
	tristate "Nebula/Pinnacle PCTV/Twinhan PCI cards"
	depends on DVB_CORE && PCI && VIDEO_BT848
	select DVB_MT352
	select DVB_SP887X
	help
	  Support for PCI cards based on the Bt8xx PCI bridge. Examples are
	  the Nebula cards, the Pinnacle PCTV cards and Twinhan DST cards.

          Since these cards have no MPEG decoder onboard, they transmit
	  only compressed MPEG data over the PCI bus, so you need
	  an external software decoder to watch TV on your computer.

	  If you have a Twinhan card, don't forget to select
	  "Twinhan DST based DVB-S/-T frontend".

	  Say Y if you own such a device and want to use it.
```

## drivers/media/dvb/cinergyT2/Kconfig
```kconfig
config DVB_CINERGYT2
	tristate "Terratec CinergyT2/qanu USB2 DVB-T receiver"
	depends on DVB_CORE && USB
	help
	  Support for "TerraTec CinergyT2" USB2.0 Highspeed DVB Receivers

	  Say Y if you own such a device and want to use it.


config DVB_CINERGYT2_TUNING
	bool "sophisticated fine-tuning for CinergyT2 cards"
	depends on DVB_CINERGYT2
	help
	  Here you can fine-tune some parameters of the CinergyT2 driver.

	  Normally you don't need to touch this, but in exotic setups you
	  may fine-tune your setup and adjust e.g. DMA buffer sizes for
	  a particular application.


config DVB_CINERGYT2_STREAM_URB_COUNT
	int "Number of queued USB Request Blocks for Highspeed Stream Transfers"
	depends on DVB_CINERGYT2_TUNING
        default "32"
	help
	  USB Request Blocks for Highspeed Stream transfers are queued in a
	  for the Host Controller. Usually the default value is a safe choice.

	  You may increase this number if you are using this device in a 
	  Server Environment with many high-traffic USB Highspeed devices 
	  sharing the same USB bus.


config DVB_CINERGYT2_STREAM_BUF_SIZE
	int "Size of URB Stream Buffers for Highspeed Transfers"
	depends on DVB_CINERGYT2_TUNING
        default "512"
	help
	  Should be a multiple of native buffer size of 512 bytes.
	  Default value is a safe choice.

	  You may increase this number if you are using this device in a 
	  Server Environment with many high-traffic USB Highspeed devices 
	  sharing the same USB bus.


config DVB_CINERGYT2_ENABLE_RC_INPUT_DEVICE
	bool "Register the onboard IR Remote Control Receiver as Input Device"
	depends on DVB_CINERGYT2_TUNING
        default "yes"
	help
	  Enable this option if you want to use the onboard Infrared Remote 
	  Control Receiver as Linux-Input device.

	  Right now only the keycode table for the default Remote Control
	  delivered with the device is supported, please see the driver
	  source code to find out how to add support for other controls.
```

## drivers/media/dvb/dibusb/Kconfig
```kconfig
config DVB_DIBUSB
	tristate "DiBcom USB DVB-T devices (see help for device list)"
	depends on DVB_CORE && USB
	select FW_LOADER
	select DVB_DIB3000MB
	help
	  Support for USB 1.1 and 2.0 DVB-T devices based on reference designs made by
	  DiBcom (http://www.dibcom.fr).

	  Devices supported by this driver:

	    TwinhanDTV USB-Ter (VP7041)
		TwinhanDTV Magic Box (VP7041e)
	    KWorld V-Stream XPERT DTV - DVB-T USB
	    Hama DVB-T USB-Box
	    DiBcom reference device (non-public)
	    Ultima Electronic/Artec T1 USB TVBOX
	    Compro Videomate DVB-U2000 - DVB-T USB
	    Grandtec DVB-T USB
	    Avermedia AverTV DVBT USB
	    Yakumo DVB-T mobile USB2.0

	  The VP7041 seems to be identical to "CTS Portable" (Chinese
	  Television System).

	  These devices can be understood as budget ones, they "only" deliver
	  (a part of) the MPEG2 transport stream.

	  A firmware is needed to get the device working. See Documentation/dvb/README.dibusb
	  details.

	  Say Y if you own such a device and want to use it. You should build it as
	  a module.

config DVB_DIBUSB_MISDESIGNED_AN2235
	bool "Enable support for some Artec T1 device, which identifies as AN2235"
	depends on DVB_DIBUSB
	help
	  Somehow Artec forgot to program the eeprom for some of their T1 devices. So
	  comes that they identify with the default Vendor and Product ID of the Cypress
	  CY7C64613 (AN2235).

	  Say Y if your Artec device has 0x0574 as Vendor ID and 0x2235 as Product ID.

config DVB_DIBCOM_DEBUG
	bool "Enable extended debug support for DiBcom USB device"
	depends on DVB_DIBUSB
	help
	  Say Y if you want to enable debuging. See modinfo dvb-dibusb for
	  debug level.
```

## drivers/media/dvb/dvb-core/Kconfig
```kconfig
config DVB_CORE
	tristate "DVB Core Support"
	depends on DVB
	select CRC32
	help
	  DVB core utility functions for device handling, software fallbacks etc.

	  Say Y when you have a DVB card and want to use it. If unsure say N.
```

## drivers/media/dvb/frontends/Kconfig
```kconfig
comment "DVB-S (satellite) frontends"
	depends on DVB_CORE

config DVB_STV0299
	tristate "ST STV0299 based"
	depends on DVB_CORE
	help
	  A DVB-S tuner module. Say Y when you want to support this frontend.

	  Some examples are the Alps BSRU6, the Philips SU1278 and
	  the LG TDQB-S00x.

	  If you don't know what tuner module is soldered on your 
	  DVB adapter simply enable all supported frontends, the 
	  right one will get autodetected.

config DVB_CX24110
	tristate "Connexant CX24110 based"
 	depends on DVB_CORE
 	help
	  A DVB-S tuner module. Say Y when you want to support this frontend.
 
 	  If you don't know what tuner module is soldered on your
 	  DVB adapter simply enable all supported frontends, the
 	  right one will get autodetected.

config DVB_GRUNDIG_29504_491
	tristate "Grundig 29504-491 based"
	depends on DVB_CORE
	help
	  A DVB-S tuner module. Say Y when you want to support this frontend.

	  If you don't know what tuner module is soldered on your
	  DVB adapter simply enable all supported frontends, the
	  right one will get autodetected.

config DVB_MT312
	tristate "Zarlink MT312 based"
	depends on DVB_CORE
	help
	  A DVB-S tuner module. Say Y when you want to support this frontend.

	  If you don't know what tuner module is soldered on your
	  DVB adapter simply enable all supported frontends, the
	  right one will get autodetected.

config DVB_VES1X93
	tristate "VLSI VES1893 or VES1993 based"
	depends on DVB_CORE
	help
	  A DVB-S tuner module. Say Y when you want to support this frontend.

	  If you don't know what tuner module is soldered on your
	  DVB adapter simply enable all supported frontends, the
	  right one will get autodetected.

comment "DVB-T (terrestrial) frontends"
	depends on DVB_CORE

config DVB_SP887X
 	tristate "Microtune sp887x based (i.e. Microtune DTF7072)"
	depends on DVB_CORE
	help
 	  A DVB-T tuner module. Say Y when you want to support this frontend.

	  This driver needs a copy of the Avermedia firmware. The version tested
	  is part of the Avermedia DVB-T 1.3.26.3 Application. If the software is
	  installed in Windoze the file will be in the /Program Files/AVerTV DVB-T/
	  directory and is called sc_main.mc. Alternatively it can "extracted" from
	  the install cab files.

   	  Copy this file to '/usr/lib/hotplug/firmware/dvb-fe-sp887x.fw'.

	  If you don't know what tuner module is soldered on your 
	  DVB adapter simply enable all supported frontends, the 
	  right one will get autodetected.

config DVB_ALPS_TDLB7
	tristate "Alps TDLB7 based"
	depends on DVB_CORE
	help
	  A DVB-T tuner module. Say Y when you want to support this frontend.

	  This driver needs a copy of the firmware file from the Haupauge
	  Windoze driver. Copy 'Sc_main.mc' to
	  '/usr/lib/hotplug/firmware/dvb-fe-tdlb7.fw'.

	  If you don't know what tuner module is soldered on your 
	  DVB adapter simply enable all supported frontends, the 
	  right one will get autodetected.

config DVB_ALPS_TDMB7
	tristate "Alps TDMB7 based"
	depends on DVB_CORE
	help
	  A DVB-T tuner module. Say Y when you want to support this frontend.

	  If you don't know what tuner module is soldered on your 
	  DVB adapter simply enable all supported frontends, the 
	  right one will get autodetected.

config DVB_GRUNDIG_29504_401
	tristate "Grundig 29504-401 based"
	depends on DVB_CORE
	help
	  A DVB-T tuner module. Say Y when you want to support this frontend.

	  If you don't know what tuner module is soldered on your 
	  DVB adapter simply enable all supported frontends, the 
	  right one will get autodetected.

config DVB_TDA1004X
	tristate "Philips TDA10045H/TDA10046H based"
	depends on DVB_CORE
	help
	  A DVB-T tuner module. Say Y when you want to support this frontend.

	  If you don't know what tuner module is soldered on your 
	  DVB adapter simply enable all supported frontends, the 
	  right one will get autodetected.

config DVB_NXT6000
	tristate "NxtWave Communications NXT6000 based"
	depends on DVB_CORE
	help
	  A DVB-T tuner module. Say Y when you want to support this frontend.

	  If you don't know what tuner module is soldered on your 
	  DVB adapter simply enable all supported frontends, the 
	  right one will get autodetected.

config DVB_MT352
	tristate "Zarlink MT352 based"
	depends on DVB_CORE
	help
	  A DVB-T tuner module. Say Y when you want to support this frontend.

	  If you don't know what tuner module is soldered on your
	  DVB adapter simply enable all supported frontends, the
	  right one will get autodetected.

comment "DVB-C (cable) frontends"
	depends on DVB_CORE

config DVB_ATMEL_AT76C651
	tristate "Atmel AT76C651 based"
	depends on DVB_CORE
        help
 	  A DVB-C tuner module. Say Y when you want to support this frontend.

	  If you don't know what tuner module is soldered on your
	  DVB adapter simply enable all supported frontends, the
	  right one will get autodetected.

config DVB_VES1820
	tristate "VLSI VES1820 based"
	depends on DVB_CORE
	help
 	  A DVB-C tuner module. Say Y when you want to support this frontend.

	  If you don't know what tuner module is soldered on your
	  DVB adapter simply enable all supported frontends, the
	  right one will get autodetected.

comment "Misc. Frontend Modules"
	depends on DVB_CORE

config DVB_TWINHAN_DST
	tristate "Twinhan DST based DVB-S/-T frontend"
	depends on DVB_CORE && DVB_BT8XX
	help
	  Used in such cards as the VP-1020/1030, Twinhan DST,
	  VVmer TV@SAT. Say Y when you want to support frontends
	  using this asic.
```
