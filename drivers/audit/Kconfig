## drivers/audit/Kconfig
```kconfig
config AUDIT
	tristate "Auditing subsystem"
	depends on FSHOOKS
	default y
	---help---
	  //todo.
```

## drivers/base/Kconfig
```kconfig
menu "Generic Driver Options"

config FW_LOADER
	tristate "Hotplug firmware loading support"
	depends on HOTPLUG
	---help---
	  This option is provided for the case where no in-kernel-tree modules
	  require hotplug firmware loading support, but a module built outside
	  the kernel tree does.

config DEBUG_DRIVER
	 bool "Driver Core verbose debug messages"
	depends on DEBUG_KERNEL
	help
	  Say Y here if you want the Driver core to produce a bunch of
	  debug messages to the system log. Select this if you are having a
	  problem with the driver core and want to see more of what is
	  going on.

	  If you are unsure about this, say N here.

endmenu
```

## drivers/block/Kconfig.iosched
```kconfig
config IOSCHED_NOOP
	bool "No-op I/O scheduler" if EMBEDDED
	default y
	---help---
	  The no-op I/O scheduler is a minimal scheduler that does basic merging
	  and sorting. Its main uses include non-disk based block devices like
	  memory devices, and specialised software or hardware environments
	  that do their own scheduling and require only minimal assistance from
	  the kernel.

config IOSCHED_AS
	bool "Anticipatory I/O scheduler" if EMBEDDED
	default y
	---help---
	  The anticipatory I/O scheduler is the default disk scheduler. It is
	  generally a good choice for most environments, but is quite large and
	  complex when compared to the deadline I/O scheduler, it can also be
	  slower in some cases especially some database loads.

config IOSCHED_DEADLINE
	bool "Deadline I/O scheduler" if EMBEDDED
	default y
	---help---
	  The deadline I/O scheduler is simple and compact, and is often as
	  good as the anticipatory I/O scheduler, and in some database
	  workloads, better. In the case of a single process performing I/O to
	  a disk at any one time, its behaviour is almost identical to the
	  anticipatory I/O scheduler and so is a good choice.

config IOSCHED_CFQ
	bool "CFQ I/O scheduler" if EMBEDDED
	default y
	---help---
	  The CFQ I/O scheduler tries to distribute bandwidth equally
	  among all processes in the system. It should provide a fair
	  working environment, suitable for desktop systems.
```

## drivers/bluetooth/Kconfig
```kconfig
menu "Bluetooth device drivers"
	depends on BT

config BT_HCIUSB
	tristate "HCI USB driver"
	depends on BT && USB
	help
	  Bluetooth HCI USB driver.
	  This driver is required if you want to use Bluetooth devices with
	  USB interface.

	  Say Y here to compile support for Bluetooth USB devices into the
	  kernel or say M to compile it as module (hci_usb).

config BT_USB_SCO
	bool "SCO over HCI USB support"
	depends on BT_HCIUSB
	help
	  This option enables the SCO support in the HCI USB driver. You need this
	  to transmit voice data with your Bluetooth USB device. 
	  Say Y here to compile support for SCO over HCI USB.

config BT_USB_ZERO_PACKET
	bool "USB zero packet support"
	depends on BT_HCIUSB
	help
	  This option is provided only as a work around for buggy Bluetooth USB 
	  devices. Do _not_ enable it unless you know for sure that your device 
	  requires zero packets.
	  Most people should say N here.

config BT_HCIUART
	tristate "HCI UART driver"
	depends on BT
	help
	  Bluetooth HCI UART driver.
	  This driver is required if you want to use Bluetooth devices with
	  serial port interface. You will also need this driver if you have 
	  UART based Bluetooth PCMCIA and CF devices like Xircom Credit Card 
	  adapter and BrainBoxes Bluetooth PC Card.

	  Say Y here to compile support for Bluetooth UART devices into the
	  kernel or say M to compile it as module (hci_uart).

config BT_HCIUART_H4
	bool "UART (H4) protocol support"
	depends on BT_HCIUART
	help
	  UART (H4) is serial protocol for communication between Bluetooth 
	  device and host. This protocol is required for most Bluetooth devices 
	  with UART interface, including PCMCIA and CF cards. 

	  Say Y here to compile support for HCI UART (H4) protocol.

config BT_HCIUART_BCSP
	bool "BCSP protocol support"
	depends on BT_HCIUART
	help
	  BCSP (BlueCore Serial Protocol) is serial protocol for communication 
	  between Bluetooth device and host. This protocol is required for non
	  USB Bluetooth devices based on CSR BlueCore chip, including PCMCIA and
	  CF cards.

	  Say Y here to compile support for HCI BCSP protocol.

config BT_HCIUART_BCSP_TXCRC
        bool "Transmit CRC with every BCSP packet"
        depends on BT_HCIUART_BCSP
        help
	  If you say Y here, a 16-bit CRC checksum will be transmitted along with
	  every BCSP (BlueCore Serial Protocol) packet sent to the Bluetooth chip.
	  This increases reliability, but slightly reduces efficiency.

config BT_HCIDTL1
	tristate "HCI DTL1 (PC Card) driver"
	depends on PCMCIA && BT
	help
	  Bluetooth HCI DTL1 (PC Card) driver.
	  This driver provides support for Bluetooth PCMCIA devices with
	  Nokia DTL1 interface:
	     Nokia Bluetooth Card
	     Socket Bluetooth CF Card

	  Say Y here to compile support for HCI DTL1 devices into the
	  kernel or say M to compile it as module (dtl1_cs).

config BT_HCIBT3C
	tristate "HCI BT3C (PC Card) driver"
	depends on PCMCIA && BT
	help
	  Bluetooth HCI BT3C (PC Card) driver.
	  This driver provides support for Bluetooth PCMCIA devices with
	  3Com BT3C interface:
	     3Com Bluetooth Card (3CRWB6096)
	     HP Bluetooth Card

	  The HCI BT3C driver uses external firmware loader program provided in
	  the BlueFW package. For more information, see <http://bluez.sf.net>.

	  Say Y here to compile support for HCI BT3C devices into the
	  kernel or say M to compile it as module (bt3c_cs).

config BT_HCIBLUECARD
	tristate "HCI BlueCard (PC Card) driver"
	depends on PCMCIA && BT
	help
	  Bluetooth HCI BlueCard (PC Card) driver.
	  This driver provides support for Bluetooth PCMCIA devices with
	  Anycom BlueCard interface:
	     Anycom Bluetooth PC Card
	     Anycom Bluetooth CF Card

	  Say Y here to compile support for HCI BlueCard devices into the
	  kernel or say M to compile it as module (bluecard_cs.o).

config BT_HCIBTUART
	tristate "HCI UART (PC Card) device driver"
	depends on PCMCIA && BT
	help
	  Bluetooth HCI UART (PC Card) driver.
	  This driver provides support for Bluetooth PCMCIA devices with
	  an UART interface:
	     Xircom CreditCard Bluetooth Adapter
	     Xircom RealPort2 Bluetooth Adapter
	     Sphinx PICO Card
	     H-Soft blue+Card
	     Cyber-blue Compact Flash Card

	  Say Y here to compile support for HCI UART devices into the
	  kernel or say M to compile it as module (bluecard_cs).

config BT_HCIVHCI
	tristate "HCI VHCI (Virtual HCI device) driver"
	depends on BT
	help
	  Bluetooth Virtual HCI device driver.
	  This driver is required if you want to use HCI Emulation software.

	  Say Y here to compile support for virtual HCI devices into the
	  kernel or say M to compile it as module (hci_vhci).

endmenu
```

## drivers/char/Config.in
```kconfig
#
# Character device configuration
#
mainmenu_option next_comment
comment 'Character devices'

bool 'Virtual terminal' CONFIG_VT
if [ "$CONFIG_VT" = "y" ]; then
   bool '  Support for console on virtual terminal' CONFIG_VT_CONSOLE
fi
if [ "$CONFIG_VT" = "y" -a "$CONFIG_S390" != "y" -a "$CONFIG_UM" != "y" ]; then
   define_bool CONFIG_HW_CONSOLE y
fi
bool 'Non-standard serial port support' CONFIG_SERIAL_NONSTANDARD
if [ "$CONFIG_SERIAL_NONSTANDARD" = "y" ]; then
   tristate '  Computone IntelliPort Plus serial support' CONFIG_COMPUTONE
   tristate '  Comtrol Rocketport support' CONFIG_ROCKETPORT
   tristate '  Cyclades async mux support' CONFIG_CYCLADES
   if [ "$CONFIG_EXPERIMENTAL" = "y" -a "$CONFIG_CYCLADES" != "n" ]; then
      bool '    Cyclades-Z interrupt mode operation (EXPERIMENTAL)' CONFIG_CYZ_INTR
   fi
   tristate '  Digiboard Intelligent Async Support' CONFIG_DIGIEPCA
   if [ "$CONFIG_DIGIEPCA" = "n" ]; then
      tristate '  Digiboard PC/Xx Support' CONFIG_DIGI
   fi
   dep_tristate '  Hayes ESP serial port support' CONFIG_ESPSERIAL $CONFIG_ISA
   tristate '  Moxa Intellio support' CONFIG_MOXA_INTELLIO
   tristate '  Moxa SmartIO support' CONFIG_MOXA_SMARTIO
   if [ "$CONFIG_EXPERIMENTAL" = "y" ]; then
      dep_tristate '  Multi-Tech multiport card support (EXPERIMENTAL)' CONFIG_ISI m
   fi
   tristate '  Microgate SyncLink card support' CONFIG_SYNCLINK
   tristate '  SyncLink Multiport support' CONFIG_SYNCLINKMP
   tristate '  HDLC line discipline support' CONFIG_N_HDLC
   tristate '  SDL RISCom/8 card support' CONFIG_RISCOM8
   tristate '  Specialix IO8+ card support' CONFIG_SPECIALIX
   if [ "$CONFIG_SPECIALIX" != "n" ]; then
      bool '  Specialix DTR/RTS pin is RTS' CONFIG_SPECIALIX_RTSCTS
   fi 
   tristate '  Specialix SX (and SI) card support' CONFIG_SX
   tristate '  Specialix RIO system support' CONFIG_RIO
   if [ "$CONFIG_RIO" != "n" ]; then
     bool '    Support really old RIO/PCI cards' CONFIG_RIO_OLDPCI
   fi
   bool '  Stallion multiport serial support' CONFIG_STALDRV
   if [ "$CONFIG_STALDRV" = "y" ]; then
     tristate '    Stallion EasyIO or EC8/32 support' CONFIG_STALLION
     tristate '    Stallion EC8/64, ONboard, Brumby support' CONFIG_ISTALLION
   fi
   if [ "$CONFIG_MIPS" = "y" ]; then
     bool '  TMPTX3912/PR31700 serial port support' CONFIG_SERIAL_TX3912
     dep_bool '     Console on TMPTX3912/PR31700 serial port' CONFIG_SERIAL_TX3912_CONSOLE $CONFIG_SERIAL_TX3912
     bool '  Enable Au1000 UART Support' CONFIG_AU1000_UART
     if [ "$CONFIG_AU1000_UART" = "y" ]; then
         bool '        Enable Au1000 serial console' CONFIG_AU1000_SERIAL_CONSOLE
     fi
   fi
fi
if [ "$CONFIG_IT8712" = "y" ]; then
   bool 'Enable Qtronix 990P Keyboard Support' CONFIG_QTRONIX_KEYBOARD
   if [ "$CONFIG_QTRONIX_KEYBOARD" = "y" ]; then
     define_bool CONFIG_IT8172_CIR y
   fi
   bool 'Enable Smart Card Reader 0 Support ' CONFIG_IT8172_SCR0
   bool 'Enable Smart Card Reader 1 Support ' CONFIG_IT8172_SCR1
fi
if [ "$CONFIG_EXPERIMENTAL" = "y" -a "$CONFIG_ZORRO" = "y" ]; then
   tristate 'Commodore A2232 serial support (EXPERIMENTAL)' CONFIG_A2232
fi

source drivers/serial/Config.in

bool 'Unix98 PTY support' CONFIG_UNIX98_PTYS
if [ "$CONFIG_UNIX98_PTYS" = "y" ]; then
   int 'Maximum number of Unix98 PTYs in use (0-2048)' CONFIG_UNIX98_PTY_COUNT 256
fi
if [ "$CONFIG_PARPORT" != "n" ]; then
   dep_tristate 'Parallel printer support' CONFIG_PRINTER $CONFIG_PARPORT
   if [ "$CONFIG_PRINTER" != "n" ]; then
      bool '  Support for console on line printer' CONFIG_LP_CONSOLE
   fi
   dep_tristate 'Support for user-space parallel port device drivers' CONFIG_PPDEV $CONFIG_PARPORT
fi
if [ "$CONFIG_PPC_PSERIES" = "y" ]; then
   bool 'pSeries Hypervisor Virtual Console support' CONFIG_HVC_CONSOLE
fi

source drivers/i2c/Config.in

mainmenu_option next_comment
comment 'Mice'
   tristate 'Bus Mouse Support' CONFIG_BUSMOUSE
endmenu

tristate 'QIC-02 tape support' CONFIG_QIC02_TAPE
if [ "$CONFIG_QIC02_TAPE" != "n" ]; then
   bool '  Do you want runtime configuration for QIC-02' CONFIG_QIC02_DYNCONF
   if [ "$CONFIG_QIC02_DYNCONF" != "y" ]; then
      comment '  Edit configuration parameters in ./include/linux/tpqic02.h!'
   else
      comment '  Setting runtime QIC-02 configuration is done with qic02conf'
      comment '  from the tpqic02-support package.  It is available at'
      comment '  metalab.unc.edu or ftp://titus.cfw.com/pub/Linux/util/'
   fi
fi

mainmenu_option next_comment
comment 'Watchdog Cards'
bool 'Watchdog Timer Support'	CONFIG_WATCHDOG
if [ "$CONFIG_WATCHDOG" != "n" ]; then
   bool '  Disable watchdog shutdown on close' CONFIG_WATCHDOG_NOWAYOUT
   tristate '  Software watchdog' CONFIG_SOFT_WATCHDOG
   tristate '  WDT Watchdog timer' CONFIG_WDT
   tristate '  WDT PCI Watchdog timer' CONFIG_WDTPCI
   if [ "$CONFIG_WDT" != "n" ]; then
      bool '    WDT501 features' CONFIG_WDT_501
      if [ "$CONFIG_WDT_501" = "y" ]; then
         bool '      Fan Tachometer' CONFIG_WDT_501_FAN
      fi
   fi
   tristate '  Berkshire Products PC Watchdog' CONFIG_PCWATCHDOG
   tristate '  Acquire SBC Watchdog Timer' CONFIG_ACQUIRE_WDT
   tristate '  Advantech SBC Watchdog Timer' CONFIG_ADVANTECH_WDT
   if [ "$CONFIG_FOOTBRIDGE" = "y" ]; then
      tristate '  DC21285 watchdog' CONFIG_21285_WATCHDOG
      if [ "$CONFIG_ARCH_NETWINDER" = "y" ]; then
         tristate '  NetWinder WB83C977 watchdog' CONFIG_977_WATCHDOG
      fi
   fi
   tristate '  Eurotech CPU-1220/1410 Watchdog Timer' CONFIG_EUROTECH_WDT
   tristate '  IB700 SBC Watchdog Timer' CONFIG_IB700_WDT
   tristate '  Intel i810 TCO timer / Watchdog' CONFIG_I810_TCO
   tristate '  Mixcom Watchdog' CONFIG_MIXCOMWD 
   tristate '  NatSemi SCx200 Watchdog' CONFIG_SCx200_WDT
   tristate '  SBC-60XX Watchdog Timer' CONFIG_60XX_WDT
   tristate '  W83877F (EMACS) Watchdog Timer' CONFIG_W83877F_WDT
   tristate '  ZF MachZ Watchdog' CONFIG_MACHZ_WDT
fi
endmenu

if [ "$CONFIG_ARCH_NETWINDER" = "y" ]; then
   tristate 'NetWinder thermometer support' CONFIG_DS1620
   tristate 'NetWinder Button' CONFIG_NWBUTTON
   if [ "$CONFIG_NWBUTTON" != "n" ]; then
      bool '  Reboot Using Button' CONFIG_NWBUTTON_REBOOT
   fi
   tristate 'NetWinder flash support' CONFIG_NWFLASH
fi

if [ "$CONFIG_X86" = "y" -o "$CONFIG_IA64" = "y" ]; then
   dep_tristate 'Intel i8x0 Random Number Generator support' CONFIG_INTEL_RNG $CONFIG_PCI
fi
if [ "$CONFIG_X86" = "y" ]; then
   dep_tristate 'AMD 768 Random Number Generator support' CONFIG_AMD_RNG $CONFIG_PCI
fi
tristate '/dev/nvram support' CONFIG_NVRAM
tristate 'Enhanced Real Time Clock Support' CONFIG_RTC
if [ "$CONFIG_RTC" != "y" ]; then
   tristate 'Generic /dev/rtc emulation' CONFIG_GEN_RTC      
   if [ "$CONFIG_GEN_RTC" != "n" ]; then
      bool '   Extended RTC operation' CONFIG_GEN_RTC_X
   fi
fi
if [ "$CONFIG_IA64" = "y" ]; then
   bool 'EFI Real Time Clock Services' CONFIG_EFI_RTC
fi
if [ "$CONFIG_OBSOLETE" = "y" -a "$CONFIG_ALPHA_BOOK1" = "y" ]; then
   bool 'Tadpole ANA H8 Support (OBSOLETE)'  CONFIG_H8
fi

tristate 'Double Talk PC internal speech card support' CONFIG_DTLK
tristate 'Siemens R3964 line discipline' CONFIG_R3964
tristate 'Applicom intelligent fieldbus card support' CONFIG_APPLICOM
if [ "$CONFIG_EXPERIMENTAL" = "y" -a "$CONFIG_X86" = "y" ]; then
   dep_tristate 'Sony Vaio Programmable I/O Control Device support (EXPERIMENTAL)' CONFIG_SONYPI $CONFIG_PCI
fi

mainmenu_option next_comment
comment 'Ftape, the floppy tape device driver'
tristate 'Ftape (QIC-80/Travan) support' CONFIG_FTAPE
if [ "$CONFIG_FTAPE" != "n" ]; then
   source drivers/char/ftape/Config.in
fi
endmenu

source drivers/char/agp/Config.in
source drivers/char/drm/Config.in

if [ "$CONFIG_HOTPLUG" = "y" -a "$CONFIG_PCMCIA" != "n" ]; then
   source drivers/char/pcmcia/Config.in
fi

if [ "$CONFIG_X86" = "y" ]; then
   tristate 'ACP Modem (Mwave) support' CONFIG_MWAVE
fi

dep_tristate 'NatSemi SCx200 GPIO Support' CONFIG_SCx200_GPIO $CONFIG_SCx200

tristate '  RAW driver (/dev/raw/rawN)' CONFIG_RAW_DRIVER

endmenu
```

## drivers/char/Kconfig.raw
```kconfig
config RAW_DRIVER
	tristate "RAW driver (/dev/raw/rawN) (OBSOLETE)"
	help
	  The raw driver permits block devices to be bound to /dev/raw/rawN. 
	  Once bound, I/O against /dev/raw/rawN uses efficient zero-copy I/O. 
	  See the raw(8) manpage for more details.

          The raw driver is deprecated and may be removed from 2.7
          kernels.  Applications should simply open the device (eg /dev/hda1)
          with the O_DIRECT flag.

config MAX_RAW_DEVS
	int "Maximum number of RAW devices to support (1-8192)"
	depends on RAW_DRIVER
	default "256"
	help
	  The maximum number of RAW devices that are supported.
	  Default is 256. Increase this number in case you need lots of
	  raw devices.
```
