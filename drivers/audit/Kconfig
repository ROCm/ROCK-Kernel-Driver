## drivers/cpufreq/Kconfig
```kconfig
config CPU_FREQ
	bool "CPU Frequency scaling"
	help
	  CPU Frequency scaling allows you to change the clock speed of 
	  CPUs on the fly. This is a nice method to save power, because 
	  the lower the CPU clock speed, the less power the CPU consumes.

	  Note that this driver doesn't automatically change the CPU
	  clock speed, you need to either enable a dynamic cpufreq governor
	  (see below) after boot, or use a userspace tool.

	  For details, take a look at <file:Documentation/cpu-freq>.

	  If in doubt, say N.

config CPU_FREQ_DEBUG
	bool "Enable CPUfreq debugging"
	depends on CPU_FREQ
	help
	  Say Y here to enable CPUfreq subsystem (including drivers)
	  debugging. You will need to activate it via the kernel
	  command line by passing
	     cpufreq.debug=<value>

	  To get <value>, add 
	       1 to activate CPUfreq core debugging,
	       2 to activate CPUfreq drivers debugging, and
	       4 to activate CPUfreq governor debugging

config CPU_FREQ_PROC_INTF
	tristate "/proc/cpufreq interface (deprecated)"
	depends on CPU_FREQ && PROC_FS
	help
	  This enables the /proc/cpufreq interface for controlling
	  CPUFreq. Please note that it is recommended to use the sysfs
	  interface instead (which is built automatically). 
	  
	  For details, take a look at <file:Documentation/cpu-freq/>.
	  
	  If in doubt, say N.

choice
	prompt "Default CPUFreq governor"
	depends on CPU_FREQ
	default CPU_FREQ_DEFAULT_GOV_PERFORMANCE if !CPU_FREQ_SA1100 && !CPU_FREQ_SA1110
	default CPU_FREQ_DEFAULT_GOV_USERSPACE if CPU_FREQ_SA1100 || CPU_FREQ_SA1110
	help
	  This option sets which CPUFreq governor shall be loaded at
	  startup. If in doubt, select 'performance'.

config CPU_FREQ_DEFAULT_GOV_PERFORMANCE
	bool "performance"
	select CPU_FREQ_GOV_PERFORMANCE
	help
	  Use the CPUFreq governor 'performance' as default. This sets
	  the frequency statically to the highest frequency supported by
	  the CPU.

config CPU_FREQ_DEFAULT_GOV_USERSPACE
	bool "userspace"
	select CPU_FREQ_GOV_USERSPACE
	help
	  Use the CPUFreq governor 'userspace' as default. This allows
	  you to set the CPU frequency manually or when an userspace 
	  program shall be able to set the CPU dynamically without having
	  to enable the userspace governor manually.

endchoice

config CPU_FREQ_GOV_PERFORMANCE
       tristate "'performance' governor"
       depends on CPU_FREQ
       help
	  This cpufreq governor sets the frequency statically to the
	  highest available CPU frequency.

	  If in doubt, say Y.

config CPU_FREQ_GOV_POWERSAVE
       tristate "'powersave' governor"
       depends on CPU_FREQ
       help
	  This cpufreq governor sets the frequency statically to the
	  lowest available CPU frequency.

	  If in doubt, say Y.

config CPU_FREQ_GOV_USERSPACE
       tristate "'userspace' governor for userspace frequency scaling"
       depends on CPU_FREQ 
       help
	  Enable this cpufreq governor when you either want to set the
	  CPU frequency manually or when an userspace program shall
	  be able to set the CPU dynamically, like on LART 
	  <http://www.lart.tudelft.nl/>

	  For details, take a look at <file:Documentation/cpu-freq/>.

	  If in doubt, say Y.

config CPU_FREQ_24_API
	bool "/proc/sys/cpu/ interface (2.4. / OLD)"
	depends on CPU_FREQ_GOV_USERSPACE
	depends on SYSCTL
	help
	  This enables the /proc/sys/cpu/ sysctl interface for controlling
	  the CPUFreq,"userspace" governor. This is the same interface
	  as known from the 2.4.-kernel patches for CPUFreq, and offers
	  the same functionality as long as "userspace" is the
	  selected governor for the specified CPU.
	
	  For details, take a look at <file:Documentation/cpu-freq/>.

	  If in doubt, say N.

config CPU_FREQ_GOV_ONDEMAND
	tristate "'ondemand' cpufreq policy governor"
	depends on CPU_FREQ
	help
	  'ondemand' - This driver adds a dynamic cpufreq policy governor.
	  The governor does a periodic polling and 
	  changes frequency based on the CPU utilization.
	  The support for this governor depends on CPU capability to
	  do fast frequency switching (i.e, very low latency frequency
	  transitions). 

	  For details, take a look at linux/Documentation/cpu-freq.

	  If in doubt, say N.
```

## drivers/dma/Kconfig
```kconfig
#
# DMA engine configuration
#

menu "DMA Engine support"

config DMA_ENGINE
	bool "Support for DMA engines"
	---help---
	  DMA engines offload copy operations from the CPU to dedicated
	  hardware, allowing the copies to happen asynchronously.

comment "DMA Clients"

config NET_DMA
	bool "Network: TCP receive copy offload"
	depends on DMA_ENGINE && NET
	default y
	---help---
	  This enables the use of DMA engines in the network stack to
	  offload receive copy-to-user operations, freeing CPU cycles.
	  Since this is the main user of the DMA engine, it should be enabled;
	  say Y here.

config DMA_TESTCLIENT
	tristate "Test DMA client"
	depends on DMA_ENGINE
	---help---
	  The test client driver performs a DMA-assisted memcpy on module
	  load, and prints the result when unloaded. It is pretty simple, but
	  perhaps is useful as a demonstration of the DMA subsystem API.

comment "DMA Devices"

config INTEL_IOATDMA
	tristate "Intel I/OAT DMA support"
	depends on DMA_ENGINE && PCI
	default m
	---help---
	  Enable support for the Intel(R) I/OAT DMA engine.

endmenu
```

## drivers/eisa/Kconfig
```kconfig
#
# EISA configuration
#
config EISA_PCI_EISA
	bool "Generic PCI/EISA bridge"
	depends on PCI && EISA
	default y
	---help---
	  Activate this option if your system contains a PCI to EISA
	  bridge. If your system have both PCI and EISA slots, you
	  certainly need this option.

	  When in doubt, say Y.

config EISA_VIRTUAL_ROOT
	bool "EISA virtual root device"
	depends on EISA
	default y
	---help---
	  Activate this option if your system only have EISA bus
	  (no PCI slots). The Alpha Jensen is an example of such
	  a system.

	  When in doubt, say Y.

config EISA_NAMES
	bool "EISA device name database"
	depends on EISA
	default y
	---help---
	  By default, the kernel contains a database of all known EISA
	  device names to make the information in sysfs comprehensible
	  to the user. This database increases size of the kernel
	  image by about 40KB, but it gets freed after the system
	  boots up, so it doesn't take up kernel memory. Anyway, if
	  you are building an installation floppy or kernel for an
	  embedded system where kernel image size really matters, you
	  can disable this feature and you'll get device ID instead of
	  names.

	  When in doubt, say Y.
```

## drivers/firmware/Kconfig
```kconfig
#
# For a description of the syntax of this configuration file,
# see Documentation/kbuild/kconfig-language.txt.
#

menu "Firmware Drivers"

config EDD
	tristate "BIOS Enhanced Disk Drive calls determine boot disk (EXPERIMENTAL)"
	depends on EXPERIMENTAL
	depends on !IA64
	help
	  Say Y or M here if you want to enable BIOS Enhanced Disk Drive
	  Services real mode BIOS calls to determine which disk
	  BIOS tries boot from.  This information is then exported via sysfs.

	  This option is experimental, but believed to be safe,
	  and most disk controller BIOS vendors do not yet implement this feature.

config EFI_VARS
	tristate "EFI Variable Support via sysfs"
	depends on EFI
	default n
	help
	  If you say Y here, you are able to get EFI (Extensible Firmware
	  Interface) variable information via sysfs.  You may read,
	  write, create, and destroy EFI variables through this interface.

	  Note that using this driver in concert with efibootmgr requires
	  at least test release version 0.5.0-test3 or later, which is
	  available from Matt Domsch's website located at:
	  http://linux.dell.com/efibootmgr/testing/efibootmgr-0.5.0-test3.tar.gz

	  Subsequent efibootmgr releases may be found at:
	  http://linux.dell.com/efibootmgr

endmenu
```

## drivers/gpu/drm/amd/acp/Kconfig
```kconfig
menu "ACP Configuration"

config DRM_AMD_ACP
       bool "Enable ACP IP support"
       default y
       help
	Choose this option to enable ACP IP support for AMD SOCs.

endmenu
```

## drivers/gpu/drm/amd/amdkfd/Kconfig
```kconfig
#
# Heterogenous system architecture configuration
#

config HSA_AMD
	tristate "HSA kernel driver for AMD GPU devices"
	depends on (DRM_RADEON || DRM_AMDGPU) && (X86_64 || PPC64 || ARM64)
	select DRM_AMDGPU_USERPTR
	imply AMD_IOMMU_V2
	help
	  Enable this if you want to use HSA features on AMD GPU devices.
```

## drivers/gpu/drm/amd/bus/Kconfig
```kconfig
menu "AMD GNB BUS"
	visible if 0

config DRM_AMD_GNB_BUS
	tristate "AMD GNB bus - used for GNB IPs such as ACP and ISP"

endmenu
```

## drivers/gpu/drm/amd/dal/Kconfig
```kconfig
menu "Display Engine Configuration"
	depends on DRM && (DRM_AMDSOC || DRM_AMDGPU)

config DRM_AMD_DAL
        bool "AMD DAL - Enable new display engine (will be deprecated when the development is done)"
        help
          Choose this option if you want to use the new display engine
          support for AMD SOC.

          Will be deprecated when the DAL component becomes stable and
          AMDSOC will fully switch to it.

config DRM_AMD_DAL_VBIOS_PRESENT
        bool "Video Bios available on board"
        depends on DRM_AMD_DAL
        help
         This option is needed to allow a full range of feature
	 support when working on
	 x86 platforms and there is a VBIOS
	 present in the system

config DRM_AMD_DAL_DCE11_0
        bool "Carrizo family"
        depends on DRM_AMD_DAL
        help
         Choose this option
	 if you want to have
	 CZ family
	 for display engine

config DRM_AMD_DAL_DCE10_0
        bool "VI family"
        depends on DRM_AMD_DAL
        help
         Choose this option
	 if you want to have
	 VI family for display
	 engine.

config DEBUG_KERNEL_DAL
        bool "Enable kgdb break in DAL"
        depends on DRM_AMD_DAL
        help
         Choose this option
         if you want to hit
         kdgb_break in assert.

endmenu
```
