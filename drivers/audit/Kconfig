## drivers/char/agp/Kconfig
```kconfig
config AGP
	tristate "/dev/agpgart (AGP Support)" if !GART_IOMMU
	default AGP_GART if GART_IOMMU
	---help---
	  AGP (Accelerated Graphics Port) is a bus system mainly used to
	  connect graphics cards to the rest of the system.

	  If you have an AGP system and you say Y here, it will be possible to
	  use the AGP features of your 3D rendering video card. This code acts
	  as a sort of "AGP driver" for the motherboard's chipset.

	  If you need more texture memory than you can get with the AGP GART
	  (theoretically up to 256 MB, but in practice usually 64 or 128 MB
	  due to kernel allocation issues), you could use PCI accesses
	  and have up to a couple gigs of texture space.

	  Note that this is the only means to have XFree4/GLX use
	  write-combining with MTRR support on the AGP bus. Without it, OpenGL
	  direct rendering will be a lot slower but still faster than PIO.

	  You should say Y here if you use XFree86 3.3.6 or 4.x and want to
	  use GLX or DRI.  If unsure, say N.

	  This driver is available as a module.  If you want to compile it as
	  a module, say M here and read <file:Documentation/modules.txt>.  The
	  module will be called agpgart.

config AGP_GART
	bool "/dev/agpgart (AGP Support)"
	depends on GART_IOMMU

config AGP_INTEL
	tristate "Intel 440LX/BX/GX, I8xx and E7x05 support"
	depends on AGP && X86 && !X86_64
	help
	  This option gives you AGP support for the GLX component of the
	  XFree86 4.x on Intel 440LX/BX/GX, 815, 820, 830, 840, 845, 850, 860
	  E7205 and E7505 chipsets and full support for the 810, 815, 830M, 845G,
	  852GM, 855GM and 865G integrated graphics chipsets.

	  You should say Y here if you use XFree86 3.3.6 or 4.x and want to
	  use GLX or DRI, or if you have any Intel integrated graphics
	  chipsets.  If unsure, say Y.

#config AGP_I810
#	tristate "Intel I810/I815/I830M (on-board) support"
#	depends on AGP && X86 && !X86_64
#	help
#	  This option gives you AGP support for the Xserver on the Intel 810
#	  815 and 830m chipset boards for their on-board integrated graphics. This
#	  is required to do any useful video modes with these boards.

config AGP_VIA
	tristate "VIA chipset support"
	depends on AGP && X86 && !X86_64
	help
	  This option gives you AGP support for the GLX component of the
	  XFree86 4.x on VIA MPV3/Apollo Pro chipsets.

	  You should say Y here if you use XFree86 3.3.6 or 4.x and want to
	  use GLX or DRI.  If unsure, say N.

config AGP_AMD
	tristate "AMD Irongate, 761, and 762 support"
	depends on AGP && X86 && !X86_64
	help
	  This option gives you AGP support for the GLX component of the
	  XFree86 4.x on AMD Irongate, 761, and 762 chipsets.

	  You should say Y here if you use XFree86 3.3.6 or 4.x and want to
	  use GLX or DRI.  If unsure, say N.

config AGP_SIS
	tristate "Generic SiS support"
	depends on AGP && X86 && !X86_64
	help
	  This option gives you AGP support for the GLX component of the "soon
	  to be released" XFree86 4.x on Silicon Integrated Systems [SiS]
	  chipsets.

	  Note that 5591/5592 AGP chipsets are NOT supported.

	  You should say Y here if you use XFree86 3.3.6 or 4.x and want to
	  use GLX or DRI.  If unsure, say N.

config AGP_ALI
	tristate "ALI chipset support"
	depends on AGP && X86 && !X86_64
	---help---
	  This option gives you AGP support for the GLX component of the
	  XFree86 4.x on the following ALi chipsets.  The supported chipsets
	  include M1541, M1621, M1631, M1632, M1641,M1647,and M1651.
	  For the ALi-chipset question, ALi suggests you refer to
	  <http://www.ali.com.tw/eng/support/index.shtml>.

	  The M1541 chipset can do AGP 1x and 2x, but note that there is an
	  acknowledged incompatibility with Matrox G200 cards. Due to
	  timing issues, this chipset cannot do AGP 2x with the G200.
	  This is a hardware limitation. AGP 1x seems to be fine, though.

	  You should say Y here if you use XFree86 3.3.6 or 4.x and want to
	  use GLX or DRI.  If unsure, say N.

config AGP_SWORKS
	tristate "Serverworks LE/HE support"
	depends on AGP && X86 && !X86_64
	help
	  Say Y here to support the Serverworks AGP card.  See 
	  <http://www.serverworks.com/> for product descriptions and images.

config AGP_NVIDIA
	tristate "NVIDIA nForce/nForce2 chipset support"
	depends on AGP && X86 && !X86_64
	help
	  This option gives you AGP support for the GLX component of the
	  XFree86 4.x on the following NVIDIA chipsets.  The supported chipsets
	  include nForce and nForce2

config AGP_AMD_8151
	tristate "AMD 8151 support"
	depends on AGP && X86
	default GART_IOMMU
	help
	  Say Y here to support the AMD 8151 AGP bridge and the builtin
	  GART on the AMD Athlon64/Opteron ("Hammer") CPUs.

config AGP_I460
	tristate "Intel 460GX support"
	depends on AGP && IA64
	help
	  This option gives you AGP GART support for the Intel 460GX chipset
	  for IA64 processors.

config AGP_HP_ZX1
	tristate "HP ZX1 AGP support"
	depends on AGP && IA64
	help
	  This option gives you AGP GART support for the HP ZX1 chipset
	  for IA64 processors.

config AGP_ALPHA_CORE
	tristate
	depends on AGP && (ALPHA_GENERIC || ALPHA_TITAN || ALPHA_MARVEL)
	default AGP
```

## drivers/char/drm/Kconfig
```kconfig
#
# Drm device configuration
#
# This driver provides support for the
# Direct Rendering Infrastructure (DRI) in XFree86 4.1.0 and higher.
#
config DRM
	bool "Direct Rendering Manager (XFree86 4.1.0 and higher DRI support)"
	help
	  Kernel-level support for the Direct Rendering Infrastructure (DRI)
	  introduced in XFree86 4.0. If you say Y here, you need to select
	  the module that's right for your graphics card from the list below.
	  These modules provide support for synchronization, security, and
	  DMA transfers. Please see <http://dri.sourceforge.net/> for more
	  details.  You should also select and configure AGP
	  (/dev/agpgart) support.

config DRM_TDFX
	tristate "3dfx Banshee/Voodoo3+"
	depends on DRM
	help
	  Choose this option if you have a 3dfx Banshee or Voodoo3 (or later),
	  graphics card.  If M is selected, the module will be called tdfx.

config DRM_GAMMA
	tristate "3dlabs GMX 2000"
	depends on DRM && n
	help
	  This is the old gamma driver, disabled for now unless somebody
	  tells me it actually might work.

config DRM_R128
	tristate "ATI Rage 128"
	depends on DRM
	help
	  Choose this option if you have an ATI Rage 128 graphics card.  If M
	  is selected, the module will be called r128.  AGP support for
	  this card is strongly suggested (unless you have a PCI version).

config DRM_RADEON
	tristate "ATI Radeon"
	depends on DRM && AGP
	help
	  Choose this option if you have an ATI Radeon graphics card.  There
	  are both PCI and AGP versions.  You don't need to choose this to
	  run the Radeon in plain VGA mode.  There is a product page at
	  <http://www.ati.com/na/pages/products/pc/radeon32/index.html>.
	  If M is selected, the module will be called radeon.

config DRM_I810
	tristate "Intel I810"
	depends on DRM && AGP
	help
	  Choose this option if you have an Intel I810 graphics card.  If M is
	  selected, the module will be called i810.  AGP support is required
	  for this driver to work.

config DRM_I830
	tristate "Intel 830M"
	depends on DRM && AGP

config DRM_MGA
	tristate "Matrox g200/g400"
	depends on DRM && AGP
	help
	  Choose this option if you have a Matrox G200, G400 or G450 graphics
	  card.  If M is selected, the module will be called mga.  AGP
	  support is required for this driver to work.
```

## drivers/char/ipmi/Kconfig
```kconfig
#
# IPMI device configuration
#

menu "IPMI"
config IPMI_HANDLER
       tristate 'IPMI top-level message handler'
       help
         This enables the central IPMI message handler, required for IPMI
	 to work.

         IPMI is a standard for managing sensors (temperature,
         voltage, etc.) in a system.

         See Documentation/IPMI.txt for more details on the driver.

	 If unsure, say N.

config IPMI_PANIC_EVENT
       bool 'Generate a panic event to all BMCs on a panic'
       depends on IPMI_HANDLER
       help
         When a panic occurs, this will cause the IPMI message handler to
	 generate an IPMI event describing the panic to each interface
	 registered with the message handler.

config IPMI_DEVICE_INTERFACE
       tristate 'Device interface for IPMI'
       depends on IPMI_HANDLER
       help
         This provides an IOCTL interface to the IPMI message handler so
	 userland processes may use IPMI.  It supports poll() and select().

config IPMI_KCS
       tristate 'IPMI KCS handler'
       depends on IPMI_HANDLER
       help
         Provides a driver for a KCS-style interface to a BMC.

config IPMI_WATCHDOG
       tristate 'IPMI Watchdog Timer'
       depends on IPMI_HANDLER
       help
         This enables the IPMI watchdog timer.

endmenu
```

## drivers/char/lirc/Kconfig
```kconfig
# LIRC http://lirc.sf.net/
# Kernel patch by Flameeyes <dgp85@users.sf.net>
# Check for new patch at http://flameeyes.web.ctonet.it
#
# Thanks to Koos Vriezen <koos.vriezen@xs4all.nl> for the Homebrew support.
# Thanks to Jeff Clark <jeff@tmtrading.com> for support when I wasn't able
# to update it and for his patch (found at http://www.clarkmania.com/~jclark/
# Thanks to Bernhard Rosenkraenzer <bero@arklinux.org> for SMP patch.
# Thanks to Vince <fuzzy77@free.fr> for the temporary lirc_atiusb driver.
# Thanks to Paul Miller <pmiller9@users.sourceforge.net> for the new working
# lirc_atiusb driver.

config LIRC_SUPPORT
	tristate "Linux InfraRed Controller"

config LIRC_MAX_DEV
	int
	depends on LIRC_SUPPORT
	default "2"

config LIRC_I2C
	tristate "I2C Driver"
	depends on LIRC_SUPPORT && VIDEO_BT848 && I2C && I2C_ALGOBIT

config LIRC_GPIO
	tristate "GPIO Driver"
	depends on LIRC_SUPPORT && VIDEO_BT848

config LIRC_PARALLEL
	tristate "Parallel Driver"
	depends on LIRC_SUPPORT && !SMP && PARPORT

config LIRC_SERIAL
	tristate "Serial Driver"
	depends on LIRC_SUPPORT && SERIAL_8250
```
