## drivers/input/keyboard/Kconfig
```kconfig
#
# Input core configuration
#
config INPUT_KEYBOARD
	bool "Keyboards"
	default y
	depends on INPUT
	help
	  Say Y here, and a list of supported keyboards will be displayed.
	  This option doesn't affect the kernel.

	  If unsure, say Y.

config KEYBOARD_ATKBD
	tristate "AT keyboard support"
	default y
	depends on INPUT && INPUT_KEYBOARD && SERIO
	help
	  Say Y here if you want to use a standard AT or PS/2 keyboard. Usually
	  you'll need this, unless you have a different type keyboard (USB, ADB
	  or other). This also works for AT and PS/2 keyboards connected over a
	  PS/2 to serial converter.

	  If unsure, say Y.

	  This driver is also available as a module ( = code which can be
	  inserted in and removed from the running kernel whenever you want).
	  The module will be called atkbd. If you want to compile it as a
	  module, say M here and read <file:Documentation/modules.txt>.

config KEYBOARD_SUNKBD
	tristate "Sun Type 4 and Type 5 keyboard support"
	depends on INPUT && INPUT_KEYBOARD && SERIO
	help
	  Say Y here if you want to use a Sun Type 4 or Type 5 keyboard,
	  connected either to the Sun keyboard connector or to an serial
	  (RS-232) port via a simple adapter.

	  This driver is also available as a module ( = code which can be
	  inserted in and removed from the running kernel whenever you want).
	  The module will be called sunkbd. If you want to compile it as a
	  module, say M here and read <file:Documentation/modules.txt>.

config KEYBOARD_XTKBD
	tristate "XT Keyboard support"
	depends on INPUT && INPUT_KEYBOARD && SERIO
	help
	  Say Y here if you want to use the old IBM PC/XT keyboard (or
	  compatible) on your system. This is only possible with a
	  parallel port keyboard adapter, you cannot connect it to the
	  keyboard port on a PC that runs Linux. 

	  This driver is also available as a module ( = code which can be
	  inserted in and removed from the running kernel whenever you want).
	  The module will be called xtkbd. If you want to compile it as a
	  module, say M here and read <file:Documentation/modules.txt>.

config KEYBOARD_NEWTON
	tristate "Newton keyboard"
	depends on INPUT && INPUT_KEYBOARD && SERIO
	help
	  Say Y here if you have a Newton keyboard on a serial port.

	  This driver is also available as a module ( = code which can be
	  inserted in and removed from the running kernel whenever you want).
	  The module will be called maple_keyb. If you want to compile it as a
	  module, say M here and read <file:Documentation/modules.txt>.

config KEYBOARD_MAPLE
	tristate "Maple bus keyboard support"
	depends on SH_DREAMCAST && INPUT && INPUT_KEYBOARD && MAPLE
	help
	  Say Y here if you have a DreamCast console running Linux and have
	  a keyboard attached to its Maple bus.

	  This driver is also available as a module ( = code which can be
	  inserted in and removed from the running kernel whenever you want).
	  The module will be called maple_keyb. If you want to compile it as a
	  module, say M here and read <file:Documentation/modules.txt>.

config KEYBOARD_AMIGA
	tristate "Amiga keyboard"
	depends on AMIGA && INPUT && INPUT_KEYBOARD
	help
	  Say Y here if you are running Linux on any AMIGA and have a keyboard
	  attached.	

	  This driver is also available as a module ( = code which can be
	  inserted in and removed from the running kernel whenever you want).
	  The module will be called amikbd. If you want to compile it as a
	  module, say M here and read <file:Documentation/modules.txt>.

config KEYBOARD_98KBD
	tristate "NEC PC-9800 Keyboard support"
	depends on X86_PC9800 && INPUT && INPUT_KEYBOARD && SERIO
	help
	  Say Y here if you want to use the NEC PC-9801/PC-9821 keyboard (or
	  compatible) on your system. 

	  This driver is also available as a module ( = code which can be
	  inserted in and removed from the running kernel whenever you want).
	  The module will be called xtkbd.o. If you want to compile it as a
	  module, say M here and read <file:Documentation/modules.txt>.
```

## drivers/input/misc/Kconfig
```kconfig
#
# Input misc drivers configuration
#
config INPUT_MISC
	bool "Misc"
	depends on INPUT
	help

	  Say Y here, and a list of miscellaneous input drivers will be displayed.
	  Everything that didn't fit into the other categories is here. This option
	  doesn't affect the kernel.

	  If unsure, say Y.

config INPUT_PCSPKR
	tristate "PC Speaker support"
	depends on INPUT && INPUT_MISC
	help
	  Say Y here if you want the standard PC Speaker to be used for
	  bells and whistles.

	  If unsure, say Y.

	  To compile this driver as a module, choose M here: the
	  module will be called pcspkr.

config INPUT_SPARCSPKR
	tristate "SPARC Speaker support"
	depends on (SPARC32 || SPARC64) && INPUT && INPUT_MISC && PCI
	help
	  Say Y here if you want the standard Speaker on Sparc PCI systems
	  to be used for bells and whistles.

	  If unsure, say Y.

	  To compile this driver as a module, choose M here: the
	  module will be called sparcspkr.

config INPUT_M68K_BEEP
	tristate "M68k Beeper support"
	depends on M68K && INPUT && INPUT_MISC

config INPUT_98SPKR
	tristate "PC-9800 Speaker support"
	depends on X86_PC9800 && INPUT && INPUT_MISC

config INPUT_UINPUT
	tristate "User level driver support"
	depends on INPUT && INPUT_MISC
	help
	  Say Y here if you want to support user level drivers for input
	  subsystem accessible under char device 10:223 - /dev/input/uinput.

	  To compile this driver as a module, choose M here: the
	  module will be called uinput.

config INPUT_GSC
	tristate "PA-RISC GSC PS/2 keyboard/mouse support"
	depends on GSC && INPUT && INPUT_MISC
	help
	  Say Y here if you have a PS/2 keyboard and/or mouse attached
	  to your PA-RISC box.	HP run the keyboard in AT mode rather than
	  XT mode like everyone else, so we need our own driver.
	  Furthermore, the GSC PS/2 controller shares IRQ between mouse and
	  keyboard.
```

## drivers/input/mouse/Kconfig
```kconfig
#
# Mouse driver configuration
#
config INPUT_MOUSE
	bool "Mice"
	default y
	depends on INPUT
	help
	  Say Y here, and a list of supported mice will be displayed.
	  This option doesn't affect the kernel.

	  If unsure, say Y.

config MOUSE_PS2
	tristate "PS/2 mouse"
	default y
	depends on INPUT && INPUT_MOUSE
	select SERIO
	select SERIO_I8042 if PC
	---help---
	  Say Y here if you have a PS/2 mouse connected to your system. This
	  includes the standard 2 or 3-button PS/2 mouse, as well as PS/2
	  mice with wheels and extra buttons, Microsoft, Logitech or Genius
	  compatible.

	  If unsure, say Y.

	  To compile this driver as a module, choose M here: the
	  module will be called psmouse.

config MOUSE_PS2_SYNAPTICS
	bool "Synaptics TouchPad"
	default n
	depends on INPUT && INPUT_MOUSE && MOUSE_PS2
	---help---
	  Say Y here if you have a Synaptics TouchPad connected to your system.
	  This touchpad is found on many modern laptop computers.

	  Note that you also need a user space driver to interpret the data
	  generated by the kernel. A compatible driver for XFree86 is available
	  from http://w1.894.telia.com/~u89404340/touchpad/index.html

	  The gpm program is not yet able to interpret the data from this
	  driver, so if you need to use the touchpad in the console, you have to
	  say N for now.

config MOUSE_SERIAL
	tristate "Serial mouse"
	depends on INPUT && INPUT_MOUSE
	select SERIO
	---help---
	  Say Y here if you have a serial (RS-232, COM port) mouse connected
	  to your system. This includes Sun, MouseSystems, Microsoft,
	  Logitech and all other compatible serial mice.

	  If unsure, say N.

	  To compile this driver as a module, choose M here: the
	  module will be called sermouse.

config MOUSE_INPORT
	tristate "InPort/MS/ATIXL busmouse"
	depends on INPUT && INPUT_MOUSE && ISA
	help
	  Say Y here if you have an InPort, Microsoft or ATI XL busmouse.
	  They are rather rare these days.

	  To compile this driver as a module, choose M here: the
	  module will be called inport.

config MOUSE_ATIXL
	bool "ATI XL variant"
	depends on MOUSE_INPORT
	help
	  Say Y here if your mouse is of the ATI XL variety.

config MOUSE_LOGIBM
	tristate "Logitech busmouse"
	depends on INPUT && INPUT_MOUSE && ISA
	help
	  Say Y here if you have a Logitech busmouse.
	  They are rather rare these days.

	  To compile this driver as a module, choose M here: the
	  module will be called logibm.

config MOUSE_PC110PAD
	tristate "IBM PC110 touchpad"
	depends on INPUT && INPUT_MOUSE && ISA
	help
	  Say Y if you have the IBM PC-110 micro-notebook and want its
	  touchpad supported.

	  To compile this driver as a module, choose M here: the
	  module will be called pc110pad.

config MOUSE_MAPLE
	tristate "Maple bus mouse"
	depends on SH_DREAMCAST && INPUT && INPUT_MOUSE && MAPLE
	help
	  Say Y if you have a DreamCast console and a mouse attached to
	  its Maple bus.

	  To compile this driver as a module, choose M here: the
	  module will be called maplemouse.

config MOUSE_AMIGA
	tristate "Amiga mouse"
	depends on AMIGA && INPUT && INPUT_MOUSE
	help
	  Say Y here if you have an Amiga and want its native mouse
	  supported by the kernel.

	  To compile this driver as a module, choose M here: the
	  module will be called amimouse.

config MOUSE_RISCPC
	tristate "Acorn RiscPC mouse"
	depends on ARCH_ACORN && INPUT && INPUT_MOUSE
	help
	  Say Y here if you have the Acorn RiscPC computer and want its
	  native mouse supported.

	  To compile this driver as a module, choose M here: the
	  module will be called rpcmouse.

config MOUSE_PC9800
	tristate "NEC PC-9800 busmouse"
	depends on X86_PC9800 && INPUT && INPUT_MOUSE && ISA
	help
	  Say Y here if you have NEC PC-9801/PC-9821 computer and want its
	  native mouse supported.

	  To compile this driver as a module, choose M here: the
	  module will be called 98busmouse.
```

## drivers/input/serio/Kconfig
```kconfig
#
# Input core configuration
#
config SERIO
	tristate "Serial i/o support (needed for keyboard and mouse)"
	default y
	---help---
	  Say Yes here if you have any input device that uses serial I/O to
	  communicate with the system. This includes the 
	  		* standard AT keyboard and PS/2 mouse *
	  as well as serial mice, Sun keyboards, some joysticks and 6dof
	  devices and more.

	  If unsure, say Y.

	  This driver is also available as a module ( = code which can be
	  inserted in and removed from the running kernel whenever you want).
	  The module will be called serio. If you want to compile it
	  as a module, say M here and read <file:Documentation/modules.txt>.

config SERIO_I8042
	tristate "i8042 PC Keyboard controller"
	default y
	depends on SERIO
	---help---
	  i8042 is the chip over which the standard AT keyboard and PS/2
	  mouse are connected to the computer. If you use these devices,
	  you'll need to say Y here.

	  If unsure, say Y.

	  This driver is also available as a module ( = code which can be
	  inserted in and removed from the running kernel whenever you want).
	  The module will be called i8042. If you want to compile it
	  as a module, say M here and read <file:Documentation/modules.txt>.

config SERIO_SERPORT
	tristate "Serial port line discipline"
	default y
	depends on SERIO
	---help---
	  Say Y here if you plan to use an input device (mouse, joystick,
	  tablet, 6dof) that communicates over the RS232 serial (COM) port.

	  More information is available: <file:Documentation/input/input.txt>

	  If unsure, say Y.

	  This driver is also available as a module ( = code which can be
	  inserted in and removed from the running kernel whenever you want).
	  The module will be called serport. If you want to compile it as a
	  module, say M here and read <file:Documentation/modules.txt>.

config SERIO_CT82C710
	tristate "ct82c710 Aux port controller"
	depends on SERIO
	---help---
	  Say Y here if you have a Texas Instruments TravelMate notebook
	  equipped with the ct82c710 chip and want to use a mouse connected
	  to the "QuickPort".

	  If unsure, say N.

	  This driver is also available as a module ( = code which can be
	  inserted in and removed from the running kernel whenever you want).
	  The module will be called ct82c710. If you want to compile it as a
	  module, say M here and read <file:Documentation/modules.txt>.

config SERIO_Q40KBD
	tristate "Q40 keyboard controller"
	depends on Q40 && SERIO

config SERIO_PARKBD
	tristate "Parallel port keyboard adapter"
	depends on SERIO && PARPORT
	---help---
	  Say Y here if you built a simple parallel port adapter to attach
	  an additional AT keyboard, XT keyboard or PS/2 mouse.

	  More information is available: <file:Documentation/input/input.txt>

	  If unsure, say N.

	  This driver is also available as a module ( = code which can be
	  inserted in and removed from the running kernel whenever you want).
	  The module will be called parkbd. If you want to compile it as a
	  module, say M here and read <file:Documentation/modules.txt>.

config SERIO_RPCKBD
	tristate "Acorn RiscPC keyboard controller"
	depends on ARCH_ACORN && SERIO
	default y
	help
	  Say Y here if you have the Acorn RiscPC and want to use an AT
	  keyboard connected to its keyboard controller.

	  This driver is also available as a module ( = code which can be
	  inserted in and removed from the running kernel whenever you want).
	  The module will be called rpckbd. If you want to compile it as a
	  module, say M here and read <file:Documentation/modules.txt>.

config SERIO_AMBAKMI
	tristate "AMBA KMI keyboard controller"
	depends on ARCH_INTEGRATOR && SERIO

config SERIO_SA1111
	tristate "Intel SA1111 keyboard controller"
	depends on SA1111 && SERIO

config SERIO_98KBD
	tristate "NEC PC-9800 keyboard controller"
	depends on X86_PC9800 && SERIO
	help
	  Say Y here if you have the NEC PC-9801/PC-9821 and want to use its
	  standard keyboard connected to its keyboard controller.

	  This driver is also available as a module ( = code which can be
	  inserted in and removed from the running kernel whenever you want).
	  The module will be called rpckbd.o. If you want to compile it as a
	  module, say M here and read <file:Documentation/modules.txt>.
```

## drivers/input/touchscreen/Kconfig
```kconfig
#
# Mouse driver configuration
#
menuconfig INPUT_TOUCHSCREEN
	bool "Touchscreens"
	help
	  Say Y here, and a list of supported touchscreens will be displayed.
	  This option doesn't affect the kernel.

	  If unsure, say Y.

if INPUT_TOUCHSCREEN

config TOUCHSCREEN_BITSY
	tristate "Compaq iPAQ H3600 (Bitsy) touchscreen"
	depends on SA1100_BITSY
	select SERIO
	help
	  Say Y here if you have the h3600 (Bitsy) touchscreen.

	  If unsure, say N.

	  To compile this driver as a module, choose M here: the
	  module will be called h3600_ts_input.

config TOUCHSCREEN_CORGI
	tristate "Corgi touchscreen (for Sharp SL-C7xx)"
	depends on PXA_SHARPSL
	default y	
	help
	  Say Y here to enable the driver for the touchscreen on the 
	  Sharp SL-C7xx series of PDAs.

	  If unsure, say N.

	  To compile this driver as a module, choose M here: the
	  module will be called ads7846_ts.

config TOUCHSCREEN_GUNZE
	tristate "Gunze AHL-51S touchscreen"
	select SERIO
	help
	  Say Y here if you have the Gunze AHL-51 touchscreen connected to
	  your system.

	  If unsure, say N.

	  To compile this driver as a module, choose M here: the
	  module will be called gunze.

config TOUCHSCREEN_ELO
	tristate "Elo serial touchscreens"
	select SERIO
	help
	  Say Y here if you have an Elo serial touchscreen connected to
	  your system.

	  If unsure, say N.

	  To compile this driver as a module, choose M here: the
	  module will be called gunze.


config TOUCHSCREEN_MK712
	tristate "ICS MicroClock MK712 touchscreen"
	help
	  Say Y here if you have the ICS MicroClock MK712 touchscreen
	  controller chip in your system.

	  If unsure, say N.

	  To compile this driver as a module, choose M here: the
	  module will be called mk712.

endif
```
