## drivers/isdn/Config.in
```kconfig
#
# ISDN device configuration
#

mainmenu_option next_comment
comment 'ISDN subsystem'
if [ "$CONFIG_NET" != "n" ]; then
   bool 'ISDN support' CONFIG_ISDN_BOOL

   if [ "$CONFIG_ISDN_BOOL" = "y" ]; then
      mainmenu_option next_comment
      comment 'Old ISDN4Linux'

      tristate 'Old ISDN4Linux (obsolete)' CONFIG_ISDN
      if [ "$CONFIG_ISDN" != "n" ]; then
         source drivers/isdn/i4l/Config.in
      fi
      endmenu

      comment 'CAPI subsystem'

      tristate 'CAPI2.0 support' CONFIG_ISDN_CAPI
      if [ "$CONFIG_ISDN_CAPI" != "n" ]; then
         source drivers/isdn/capi/Config.in
         source drivers/isdn/hardware/Config.in
      fi
   fi
fi
endmenu
```

## drivers/isdn/eicon/Kconfig
```kconfig
#
# Config.in for Eicon active ISDN support
#
config ISDN_DRV_EICON
	bool "Eicon active card support"
	help
	  Say Y here if you have an Eicon active ISDN card. In order to use
	  this card, additional firmware is necessary, which has to be loaded
	  into the card using the eiconctrl utility which is part of the
	  latest isdn4k-utils package. Please read the file
	  <file:Documentation/isdn/README.eicon> for more information.

choice
	prompt "Eicon active card support"
	optional
	depends on ISDN_DRV_EICON && ISDN

config ISDN_DRV_EICON_DIVAS
	tristate "Eicon driver"
	depends on PCI
	help
	  Enable this option if you want the eicon driver as standalone
	  version with no interface to the ISDN4Linux isdn module. If you
	  say Y here, the eicon module only supports the Diva Server PCI
	  cards and will provide its own IDI interface. You should say N
	  here.

config ISDN_DRV_EICON_OLD
	tristate "Legacy driver"
	help
	  Say Y here to use your Eicon active ISDN card with ISDN4Linux
	  isdn module.

config ISDN_DRV_EICON_PCI
	bool "Eicon PCI DIVA Server BRI/PRI/4BRI support"
	depends on ISDN_DRV_EICON_OLD && PCI
	help
	  Say Y here if you have an Eicon Diva Server (BRI/PRI/4BRI) ISDN
	  card.  Please read <file:Documentation/isdn/README.eicon> for more
	  information.

config ISDN_DRV_EICON_ISA
	bool "Eicon S,SX,SCOM,Quadro,S2M support"
	depends on ISDN_DRV_EICON_OLD
	help
	  Say Y here if you have an old-type Eicon active ISDN card. In order
	  to use this card, additional firmware is necessary, which has to be
	  loaded into the card using the eiconctrl utility which is part of
	  the latest isdn4k-utils package. Please read the file
	  <file:Documentation/isdn/README.eicon> for more information.

endchoice
```

## drivers/isdn/hardware/Config.in
```kconfig
#
# ISDN hardware drivers
#

if [ "$CONFIG_ISDN_CAPI" != "n" ]; then
  comment 'CAPI hardware drivers'
  source drivers/isdn/hardware/avm/Config.in
fi

if [ "$CONFIG_ISDN" != "n" ]; then
  comment 'ISDN4Linux hardware drivers'

  source drivers/isdn/hisax/Config.in

  mainmenu_option next_comment
  comment 'Active cards'

  source drivers/isdn/icn/Config.in
  source drivers/isdn/pcbit/Config.in
  source drivers/isdn/sc/Config.in
  source drivers/isdn/act2000/Config.in
  source drivers/isdn/eicon/Config.in
  source drivers/isdn/tpam/Config.in
  source drivers/isdn/hysdn/Config.in
  endmenu
fi
```

## drivers/isdn/hardware/Kconfig
```kconfig
#
# ISDN hardware drivers
#
comment "CAPI hardware drivers"
	depends on NET && ISDN_BOOL && ISDN_CAPI

source "drivers/isdn/hardware/avm/Kconfig"

source "drivers/isdn/hardware/eicon/Kconfig"

comment "ISDN4Linux hardware drivers"
	depends on NET && ISDN_BOOL && ISDN

source "drivers/isdn/hisax/Kconfig"


menu "Active cards"
	depends on NET && ISDN_BOOL && ISDN!=n

source "drivers/isdn/icn/Kconfig"

source "drivers/isdn/pcbit/Kconfig"

source "drivers/isdn/sc/Kconfig"

source "drivers/isdn/act2000/Kconfig"

source "drivers/isdn/eicon/Kconfig"

source "drivers/isdn/tpam/Kconfig"

source "drivers/isdn/hysdn/Kconfig"

endmenu
```

## drivers/isdn/i4l/Config.in
```kconfig
#
# Old ISDN4Linux config
#

if [ "$CONFIG_INET" != "n" ]; then
   bool '  Support synchronous PPP' CONFIG_ISDN_PPP
   if [ "$CONFIG_ISDN_PPP" != "n" ]; then
      bool         '    Use VJ-compression with synchronous PPP' CONFIG_ISDN_PPP_VJ
      bool         '    Support generic MP (RFC 1717)' CONFIG_ISDN_MPP
      dep_tristate '    Support BSD compression' CONFIG_ISDN_PPP_BSDCOMP $CONFIG_ISDN
   fi
fi
bool '  Support audio via ISDN' CONFIG_ISDN_AUDIO
if [ "$CONFIG_ISDN_AUDIO" != "n" ]; then
   bool '    Support AT-Fax Class 1 and 2 commands' CONFIG_ISDN_TTY_FAX
fi
if [ "$CONFIG_X25" != "n" ]; then
   bool '  X.25 PLP on top of ISDN' CONFIG_ISDN_X25
fi

mainmenu_option next_comment
comment 'ISDN feature submodules'
   dep_tristate 'isdnloop support' CONFIG_ISDN_DRV_LOOP $CONFIG_ISDN
   dep_tristate 'Support isdn diversion services' CONFIG_ISDN_DIVERSION $CONFIG_ISDN
endmenu

comment 'low-level hardware drivers'

source drivers/isdn/hisax/Config.in

### Active ISDN cards

mainmenu_option next_comment
comment 'Active ISDN cards'

source drivers/isdn/icn/Config.in
source drivers/isdn/pcbit/Config.in
source drivers/isdn/sc/Config.in
source drivers/isdn/act2000/Config.in
source drivers/isdn/eicon/Config.in
source drivers/isdn/tpam/Config.in
source drivers/isdn/hysdn/Config.in

endmenu
```
