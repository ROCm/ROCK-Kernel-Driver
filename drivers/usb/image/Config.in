## init/Kconfig
```kconfig
menu "Code maturity level options"

config EXPERIMENTAL
	bool "Prompt for development and/or incomplete code/drivers"
	---help---
	  Some of the various things that Linux supports (such as network
	  drivers, file systems, network protocols, etc.) can be in a state
	  of development where the functionality, stability, or the level of
	  testing is not yet high enough for general use. This is usually
	  known as the "alpha-test" phase among developers. If a feature is
	  currently in alpha-test, then the developers usually discourage
	  uninformed widespread use of this feature by the general public to
	  avoid "Why doesn't this work?" type mail messages. However, active
	  testing and use of these systems is welcomed. Just be aware that it
	  may not meet the normal level of reliability or it may fail to work
	  in some special cases. Detailed bug reports from people familiar
	  with the kernel internals are usually welcomed by the developers
	  (before submitting bug reports, please read the documents
	  <file:README>, <file:MAINTAINERS>, <file:REPORTING-BUGS>,
	  <file:Documentation/BUG-HUNTING>, and
	  <file:Documentation/oops-tracing.txt> in the kernel source).

	  This option will also make obsoleted drivers available. These are
	  drivers that have been replaced by something else, and/or are
	  scheduled to be removed in a future kernel release.

	  Unless you intend to help test and develop a feature or driver that
	  falls into this category, or you have a situation that requires
	  using these features, you should probably say N here, which will
	  cause the configurator to present you with fewer choices. If
	  you say Y here, you will be offered the choice of using features or
	  drivers that are currently considered to be in the alpha-test phase.

config CLEAN_COMPILE
	bool "Select only drivers expected to compile cleanly" if EXPERIMENTAL
	default y
	help
	  Select this option if you don't even want to see the option
	  to configure known-broken drivers.

	  If unsure, say Y

config STANDALONE
	bool "Select only drivers that don't need compile-time external firmware" if EXPERIMENTAL
	default y
	help
	  Select this option if you don't have magic firmware for drivers that
	  need it.

	  If unsure, say Y.

config BROKEN
	bool
	depends on !CLEAN_COMPILE
	default y

config BROKEN_ON_SMP
	bool
	depends on BROKEN || !SMP
	default y

endmenu


menu "General setup"

config SWAP
	bool "Support for paging of anonymous memory"
	depends on MMU
	default y
	help
	  This option allows you to choose whether you want to have support
	  for socalled swap devices or swap files in your kernel that are
	  used to provide more virtual memory than the actual RAM present
	  in your computer.  If unsure say Y.

config SYSVIPC
	bool "System V IPC"
	---help---
	  Inter Process Communication is a suite of library functions and
	  system calls which let processes (running programs) synchronize and
	  exchange information. It is generally considered to be a good thing,
	  and some programs won't run unless you say Y here. In particular, if
	  you want to run the DOS emulator dosemu under Linux (read the
	  DOSEMU-HOWTO, available from
	  <http://www.tldp.org/docs.html#howto>), you'll need to say Y
	  here.

	  You can find documentation about IPC with "info ipc" and also in
	  section 6.4 of the Linux Programmer's Guide, available from
	  <http://www.tldp.org/docs.html#guide>.

config BSD_PROCESS_ACCT
	bool "BSD Process Accounting"
	help
	  If you say Y here, a user level program will be able to instruct the
	  kernel (via a special system call) to write process accounting
	  information to a file: whenever a process exits, information about
	  that process will be appended to the file by the kernel.  The
	  information includes things such as creation time, owning user,
	  command name, memory usage, controlling terminal etc. (the complete
	  list is in the struct acct in <file:include/linux/acct.h>).  It is
	  up to the user level program to do useful things with this
	  information.  This is generally a good idea, so say Y.

config SYSCTL
	bool "Sysctl support"
	---help---
	  The sysctl interface provides a means of dynamically changing
	  certain kernel parameters and variables on the fly without requiring
	  a recompile of the kernel or reboot of the system.  The primary
	  interface consists of a system call, but if you say Y to "/proc
	  file system support", a tree of modifiable sysctl entries will be
	  generated beneath the /proc/sys directory. They are explained in the
	  files in <file:Documentation/sysctl/>.  Note that enabling this
	  option will enlarge the kernel by at least 8 KB.

	  As it is generally a good thing, you should say Y here unless
	  building a kernel for install/rescue disks or your system is very
	  limited in memory.

config LOG_BUF_SHIFT
	int "Kernel log buffer size (16 => 64KB, 17 => 128KB)" if DEBUG_KERNEL
	range 12 20
	default 17 if ARCH_S390
	default 16 if X86_NUMAQ || IA64
	default 15 if SMP
	default 14
	help
	  Select kernel log buffer size as a power of 2.
	  Defaults and Examples:
	  	     17 => 128 KB for S/390
		     16 => 64 KB for x86 NUMAQ or IA-64
	             15 => 32 KB for SMP
	             14 => 16 KB for uniprocessor
		     13 =>  8 KB
		     12 =>  4 KB

config IKCONFIG
	bool "Kernel .config support"
	---help---
	  This option enables the complete Linux kernel ".config" file
	  contents, information on compiler used to build the kernel,
	  kernel running when this kernel was built and kernel version
	  from Makefile to be saved in the kernel. It provides documentation
	  of which kernel options are used in a running kernel or in an
	  on-disk kernel.  This information can be extracted from the kernel
	  image file with the script scripts/extract-ikconfig and used as
	  input to rebuild the current kernel or to build another kernel.
	  It can also be extracted from a running kernel by reading
	  /proc/config.gz and /proc/config_built_with, if enabled (below).
	  /proc/config.gz will list the configuration that was used
	  to build the kernel and /proc/config_built_with will list
	  information on the compiler and host machine that was used to
	  build the kernel.

config IKCONFIG_PROC
	bool "Enable access to .config through /proc/config.gz"
	depends on IKCONFIG && PROC_FS
	---help---
	  This option enables access to kernel configuration file and build
	  information through /proc/config.gz.


menuconfig EMBEDDED
	bool "Remove kernel features (for embedded systems)"
	help
	  This option allows certain base kernel features to be removed from
	  the build.  This is for specialized environments which can tolerate
	  a "non-standard" kernel.  Only use this if you really know what you
	  are doing.

config KALLSYMS
	 bool "Load all symbols for debugging/kksymoops" if EMBEDDED
	 default y
	 help
	   Say Y here to let the kernel print out symbolic crash information and
	   symbolic stack backtraces. This increases the size of the kernel
	   somewhat, as all symbols have to be loaded into the kernel image.

config FUTEX
	bool "Enable futex support" if EMBEDDED
	default y
	help
	  Disabling this option will cause the kernel to be built without
	  support for "fast userspace mutexes".  The resulting kernel may not
	  run glibc-based applications correctly.

config EPOLL
	bool "Enable eventpoll support" if EMBEDDED
	default y
	help
	  Disabling this option will cause the kernel to be built without
	  support for epoll family of system calls.

source "drivers/block/Kconfig.iosched"

endmenu		# General setup


menu "Loadable module support"

config MODULES
	bool "Enable loadable module support"
	help
	  Kernel modules are small pieces of compiled code which can
	  be inserted in the running kernel, rather than being
	  permanently built into the kernel.  You use the "modprobe"
	  tool to add (and sometimes remove) them.  If you say Y here,
	  many parts of the kernel can be built as modules (by
	  answering M instead of Y where indicated): this is most
	  useful for infrequently used options which are not required
	  for booting.  For more information, see the man pages for
	  modprobe, lsmod, modinfo, insmod and rmmod.

	  If you say Y here, you will need to run "make
	  modules_install" to put the modules under /lib/modules/
	  where modprobe can find them (you may need to be root to do
	  this).

	  If unsure, say Y.

config MODULE_UNLOAD
	bool "Module unloading"
	depends on MODULES
	help
	  Without this option you will not be able to unload any
	  modules (note that some modules may not be unloadable
	  anyway), which makes your kernel slightly smaller and
	  simpler.  If unsure, say Y.

config MODULE_FORCE_UNLOAD
	bool "Forced module unloading"
	depends on MODULE_UNLOAD && EXPERIMENTAL
	help
	  This option allows you to force a module to unload, even if the
	  kernel believes it is unsafe: the kernel will remove the module
	  without waiting for anyone to stop using it (using the -f option to
	  rmmod).  This is mainly for kernel developers and desperate users.
	  If unsure, say N.

config OBSOLETE_MODPARM
	bool
	default y
	depends on MODULES
	help
	  You need this option to use module parameters on modules which
	  have not been converted to the new module parameter system yet.
	  If unsure, say Y.

config MODVERSIONS
	bool "Module versioning support (EXPERIMENTAL)"
	depends on MODULES && EXPERIMENTAL
	help
	  Usually, you have to use modules compiled with your kernel.
	  Saying Y here makes it sometimes possible to use modules
	  compiled for different kernels, by adding enough information
	  to the modules to (hopefully) spot any changes which would
	  make them incompatible with the kernel you are running.  If
	  unsure, say N.

config KMOD
	bool "Automatic kernel module loading"
	depends on MODULES
	help
	  Normally when you have selected some parts of the kernel to
	  be created as kernel modules, you must load them (using the
	  "modprobe" command) before you can use them. If you say Y
	  here, some parts of the kernel will be able to load modules
	  automatically: when a part of the kernel needs a module, it
	  runs modprobe with the appropriate arguments, thereby
	  loading the module if it is available.  If unsure, say Y.

endmenu
```

## init/Kconfig.suse
```kconfig
config SUSE_KERNEL
	def_bool y

menu "SUSE Release Details"
choice SUSE_PRODUCT_CODE
	prompt "SUSE Product Family"
	default SUSE_PRODUCT_SLE
	depends on SUSE_KERNEL
	help
	  This option defines the SUSE product family that owns this
	  kernel release.

config SUSE_PRODUCT_SLE
	bool "SUSE Linux Enteprise"

config SUSE_PRODUCT_OPENSUSE_LEAP
	bool "openSUSE Leap"

config SUSE_PRODUCT_OPENSUSE_TUMBLEWEED
	bool "openSUSE Tumbleweed"
endchoice

config SUSE_PRODUCT_CODE
	int
	range 1 3
	default 1 if SUSE_PRODUCT_SLE
	default 2 if SUSE_PRODUCT_OPENSUSE_LEAP
	default 3 if SUSE_PRODUCT_OPENSUSE_TUMBLEWEED

if SUSE_PRODUCT_SLE
config SUSE_VERSION
	int "Release Version"
	range 0 255
	default 255

config SUSE_PATCHLEVEL
	int "Service Pack Version"
	range 0 255
	default 255
endif

if SUSE_PRODUCT_OPENSUSE_LEAP
config SUSE_VERSION
	int "Release Major Version"
	range 0 255
	default 255

config SUSE_PATCHLEVEL
	int "Release Minor Version"
	range 0 255
	default 255
endif

# Tumbleweed doesn't currently use version information, but we should
# still have the values defined even if zeroed out.
if SUSE_PRODUCT_OPENSUSE_TUMBLEWEED
config SUSE_VERSION
	int
	range 0 255
	default 0

config SUSE_PATCHLEVEL
	int
	range 0 255
	default 0
endif

config SUSE_AUXRELEASE
	int
	range 0 255
	default 0

config SUSE_KERNEL_SUPPORTED
	bool "Enable enterprise support facility"
	depends on SUSE_KERNEL
	help
	  This feature enables the handling of the "supported" module flag.
	  This flag can be used to report unsupported module loads or even
	  refuse them entirely. It is useful when ensuring that the kernel
	  remains in a state that SUSE, or its technical partners, is
	  prepared to support.

	  Modules in the list of supported modules will be marked supported
	  on build. The default enforcement mode is to report, but not
	  deny, loading of unsupported modules.

	  If you aren't building a kernel for an enterprise distribution,
	  say n.

config SUSE_KERNEL_RELEASE
	bool "Release kernel"
	default n
	help
	  This kernel is built for release through official channels.

endmenu
```
