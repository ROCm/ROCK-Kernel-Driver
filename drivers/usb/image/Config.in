## drivers/video/Config.in
```kconfig
#
# Video configuration
#

mainmenu_option next_comment
comment 'Graphics support'

bool 'Support for frame buffer devices ' CONFIG_FB

if [ "$CONFIG_FB" = "y" ]; then
   if [ "$CONFIG_EXPERIMENTAL" = "y" ]; then
      if [ "$CONFIG_AMIGA" = "y" -o "$CONFIG_PCI" = "y" ]; then
	 tristate '  Cirrus Logic support (EXPERIMENTAL)' CONFIG_FB_CLGEN
	 tristate '  Permedia2 support (EXPERIMENTAL)' CONFIG_FB_PM2
	 if [ "$CONFIG_FB_PM2" = "y" -o "$CONFIG_FB_PM2" = "m" ]; then
	    if [ "$CONFIG_PCI" = "y" ]; then
	       bool '    enable FIFO disconnect feature' CONFIG_FB_PM2_FIFO_DISCONNECT
	       bool '    generic Permedia2 PCI board support' CONFIG_FB_PM2_PCI
	    fi
	    if [ "$CONFIG_AMIGA" = "y" ]; then
	       bool '    Phase5 CVisionPPC/BVisionPPC support' CONFIG_FB_PM2_CVPPC
	    fi
	 fi
      fi
   fi
   if [ "$CONFIG_ARM" = "y" ]; then
      dep_bool '  Acorn VIDC support' CONFIG_FB_ACORN $CONFIG_ARCH_ACORN
      dep_bool '  Anakin LCD support' CONFIG_FB_ANAKIN $CONFIG_ARCH_ANAKIN
      dep_bool '  CLPS711X LCD support' CONFIG_FB_CLPS711X $CONFIG_ARCH_CLPS711X
      dep_bool '  SA-1100 LCD support' CONFIG_FB_SA1100 $CONFIG_ARCH_SA1100
      if [ "$CONFIG_FB_SA1100" = "y" -a "$CONFIG_SA1100_CERF" = "y" ]; then
         choice 'CerfBoard LCD Display Size' \
		"3.8_Color		CONFIG_CERF_LCD_38_A \
		 3.8_Mono		CONFIG_CERF_LCD_38_B \
		 5.7		CONFIG_CERF_LCD_57_A \
		 7.2		CONFIG_CERF_LCD_72_A" 5.7
      fi
      if [ "$CONFIG_FB_SA1100" = "y" -a "$CONFIG_SA1100_CERF_CPLD" = "y" ]; then
         bool 'Cerfboard Backlight (CerfPDA)' CONFIG_SA1100_CERF_LCD_BACKLIGHT
      fi
   fi
   dep_tristate '  CyberPro 2000/2010/5000 support' CONFIG_FB_CYBER2000 $CONFIG_PCI
   if [ "$CONFIG_APOLLO" = "y" ]; then
      define_bool CONFIG_FB_APOLLO y
   fi
   if [ "$CONFIG_Q40" = "y" ]; then
      define_bool CONFIG_FB_Q40 y
   fi
   if [ "$CONFIG_AMIGA" = "y" ]; then
      tristate '  Amiga native chipset support' CONFIG_FB_AMIGA
      if [ "$CONFIG_FB_AMIGA" != "n" ]; then
	 bool '    Amiga OCS chipset support' CONFIG_FB_AMIGA_OCS
	 bool '    Amiga ECS chipset support' CONFIG_FB_AMIGA_ECS
	 bool '    Amiga AGA chipset support' CONFIG_FB_AMIGA_AGA
      fi
   fi
   if [ "$CONFIG_ZORRO" = "y" ]; then
      tristate '  Amiga CyberVision support' CONFIG_FB_CYBER
      if [ "$CONFIG_EXPERIMENTAL" = "y" ]; then
	 bool '  Amiga CyberVision3D support (EXPERIMENTAL)' CONFIG_FB_VIRGE
	 tristate '  Amiga RetinaZ3 support (EXPERIMENTAL)' CONFIG_FB_RETINAZ3
	 bool '  Amiga FrameMaster II/Rainbow II support (EXPERIMENTAL)' CONFIG_FB_FM2
      fi
   fi
   if [ "$CONFIG_ATARI" = "y" ]; then
      bool '  Atari native chipset support' CONFIG_FB_ATARI
      tristate '  ATI Mach64 display support' CONFIG_FB_ATY
      if [ "$CONFIG_FB_ATY" != "n" ]; then
	 define_bool CONFIG_FB_ATY_GX y
      fi
   fi
   if [ "$CONFIG_PPC" = "y" ]; then
      dep_bool '  Open Firmware frame buffer device support' CONFIG_FB_OF $CONFIG_ALL_PPC
      dep_bool '  Apple "control" display support' CONFIG_FB_CONTROL $CONFIG_ALL_PPC
      dep_bool '  Apple "platinum" display support' CONFIG_FB_PLATINUM $CONFIG_ALL_PPC
      dep_bool '  Apple "valkyrie" display support' CONFIG_FB_VALKYRIE $CONFIG_ALL_PPC
      bool '  Chips 65550 display support' CONFIG_FB_CT65550
      bool '  IMS Twin Turbo display support' CONFIG_FB_IMSTT
      bool '  S3 Trio display support' CONFIG_FB_S3TRIO
      tristate '  VGA 16-color graphics support' CONFIG_FB_VGA16
   fi
   if [ "$CONFIG_PARISC" = "y" ]; then
      bool '  Generic STI frame buffer device support' CONFIG_FB_STI
   fi
   if [ "$CONFIG_MAC" = "y" ]; then
      define_bool CONFIG_FB_MAC y
      bool '  Apple "valkyrie" display support' CONFIG_FB_VALKYRIE
#      bool '  Apple DAFB display support' CONFIG_FB_DAFB
   fi
   if [ "$CONFIG_HP300" = "y" ]; then
      define_bool CONFIG_FB_HP300 y
   fi
   if [ "$CONFIG_ALPHA" = "y" ]; then
      tristate '  TGA framebuffer support' CONFIG_FB_TGA
   fi
   if [ "$CONFIG_X86" = "y" ]; then
      bool '  VESA VGA graphics support' CONFIG_FB_VESA
      tristate '  VGA 16-color graphics support' CONFIG_FB_VGA16
      tristate '  Hercules mono graphics support ' CONFIG_FB_HGA
      define_bool CONFIG_VIDEO_SELECT y
   fi
   if [ "$CONFIG_VISWS" = "y" ]; then
      tristate '  SGI Visual Workstation framebuffer support' CONFIG_FB_SGIVW
      define_bool CONFIG_BUS_I2C y
   fi
   if [ "$CONFIG_SUN3" = "y" -o "$CONFIG_SUN3X" = "y" ]; then
      bool '  Sun3 framebuffer support' CONFIG_FB_SUN3
      if [ "$CONFIG_FB_SUN3" != "n" ]; then
         bool '    BWtwo support' CONFIG_FB_BWTWO
         bool '    CGthree support' CONFIG_FB_CGTHREE
         bool '    CGsix (GX,TurboGX) support' CONFIG_FB_CGSIX
      fi
   fi
   if [ "$CONFIG_SH_DREAMCAST" = "y" ]; then
      tristate '  NEC PowerVR 2 display support' CONFIG_FB_PVR2
      dep_bool '    Debug pvr2fb' CONFIG_FB_PVR2_DEBUG $CONFIG_FB_PVR2
   fi
   if [ "$CONFIG_SUPERH" = "y" ]; then
      bool '  Epson 1355 framebuffer support' CONFIG_FB_E1355
      if [ "$CONFIG_FB_E1355" = "y" ]; then
         hex '    Register Base Address' CONFIG_E1355_REG_BASE a8000000
         hex '    Framebuffer Base Address' CONFIG_E1355_FB_BASE a8200000
      fi
   fi
   if [ "$CONFIG_PCI" != "n" ]; then
      tristate '  nVidia Riva support ' CONFIG_FB_RIVA
      tristate '  Matrox acceleration ' CONFIG_FB_MATROX
      if [ "$CONFIG_FB_MATROX" != "n" ]; then
	 bool '    Millennium I/II support' CONFIG_FB_MATROX_MILLENIUM
	 bool '    Mystique support' CONFIG_FB_MATROX_MYSTIQUE
	 bool '    G100/G200/G400/G450/G550 support' CONFIG_FB_MATROX_G450
	 if [ "$CONFIG_FB_MATROX_G450" = "n" ]; then
	    bool '    G100/G200/G400 support' CONFIG_FB_MATROX_G100A
	 fi
	 if [ "$CONFIG_FB_MATROX_G450" = "y" -o "$CONFIG_FB_MATROX_G100A" = "y" ]; then
	    define_bool CONFIG_FB_MATROX_G100 y
	 fi
	 if [ "$CONFIG_I2C" != "n" ]; then
	    dep_tristate '      Matrox I2C support' CONFIG_FB_MATROX_I2C $CONFIG_FB_MATROX $CONFIG_I2C_ALGOBIT
	    if [ "$CONFIG_FB_MATROX_G100" = "y" ]; then
	       dep_tristate '      G400 second head support' CONFIG_FB_MATROX_MAVEN $CONFIG_FB_MATROX_I2C
	    fi
	 fi
	 bool '    Multihead support' CONFIG_FB_MATROX_MULTIHEAD
      fi
      tristate '  ATI Mach64 display support ' CONFIG_FB_ATY
      if [ "$CONFIG_FB_ATY" != "n" ]; then
	 bool '    Mach64 GX support ' CONFIG_FB_ATY_GX
	 bool '    Mach64 CT/VT/GT/LT (incl. 3D RAGE) support' CONFIG_FB_ATY_CT
      fi
      tristate '  ATI Radeon display support ' CONFIG_FB_RADEON
      tristate '  ATI Rage128 display support ' CONFIG_FB_ATY128
      tristate '  SIS acceleration ' CONFIG_FB_SIS
      if [ "$CONFIG_FB_SIS" != "n" ]; then
	 bool '    SIS 630/540/730 support' CONFIG_FB_SIS_300
	 bool '    SIS 315H/315 support' CONFIG_FB_SIS_315
      fi
      tristate '  NeoMagic display support ' CONFIG_FB_NEOMAGIC
      tristate '  3Dfx Banshee/Voodoo3 display support ' CONFIG_FB_3DFX
      tristate '  3Dfx Voodoo Graphics (sst1) support ' CONFIG_FB_VOODOO1
      tristate '  Trident support ' CONFIG_FB_TRIDENT
      tristate '  Permedia3 support ' CONFIG_FB_PM3
   fi	
   if [ "$CONFIG_SPARC32" = "y" -o "$CONFIG_SPARC64" = "y" ]; then
      bool '  SBUS and UPA framebuffers' CONFIG_FB_SBUS
      if [ "$CONFIG_FB_SBUS" != "n" ]; then
	 if [ "$CONFIG_SPARC64" = "y" ]; then
	    bool '    Creator/Creator3D support' CONFIG_FB_CREATOR
	 fi
	 bool '    CGsix (GX,TurboGX) support' CONFIG_FB_CGSIX
	 bool '    BWtwo support' CONFIG_FB_BWTWO
	 bool '    CGthree support' CONFIG_FB_CGTHREE
	 if [ "$CONFIG_SPARC32" = "y" ]; then
	    bool '    TCX (SS4/SS5 only) support' CONFIG_FB_TCX
	    bool '    CGfourteen (SX) support' CONFIG_FB_CGFOURTEEN
	    bool '    P9100 (Sparcbook 3 only) support' CONFIG_FB_P9100
	 fi
	 bool '    Leo (ZX) support' CONFIG_FB_LEO
      fi
   fi
   if [ "$CONFIG_SPARC32" = "y" ]; then
      if [ "$CONFIG_PCI" != "n" ]; then
	 bool '  PCI framebuffers' CONFIG_FB_PCI
	 if [ "$CONFIG_FB_PCI" != "n" ]; then
	    bool '    IGA 168x display support' CONFIG_FB_IGA
	 fi
      fi
   fi
   if [ "$CONFIG_SPARC64" = "y" ]; then
      if [ "$CONFIG_PCI" != "n" ]; then
	 bool '  PCI framebuffers' CONFIG_FB_PCI
	 if [ "$CONFIG_FB_PCI" != "n" ]; then
	    tristate '    ATI Mach64 display support' CONFIG_FB_ATY
	    if [ "$CONFIG_FB_ATY" != "n" ]; then
	       define_bool CONFIG_FB_ATY_CT y
	    fi
	 fi
      fi
   fi
   if [ "$CONFIG_HD64461" = "y" ]; then
      tristate '  HD64461 Frame Buffer support' CONFIG_FB_HIT
   fi
   if [ "$CONFIG_DECSTATION" = "y" ]; then
     if [ "$CONFIG_TC" = "y" ]; then
       bool '  PMAG-BA TURBOchannel framebuffer support' CONFIG_FB_PMAG_BA
       bool '  PMAGB-B TURBOchannel framebuffer spport' CONFIG_FB_PMAGB_B
       bool '  Maxine (Personal DECstation) onboard framebuffer spport' CONFIG_FB_MAXINE
     fi
   fi
   if [ "$CONFIG_NINO" = "y" ]; then
      bool '  TMPTX3912/PR31700 frame buffer support' CONFIG_FB_TX3912
   fi
   if [ "$CONFIG_EXPERIMENTAL" = "y" ]; then
      tristate '  Virtual Frame Buffer support (ONLY FOR TESTING!) (EXPERIMENTAL)' CONFIG_FB_VIRTUAL
   fi
fi

source drivers/video/console/Config.in

endmenu
```
