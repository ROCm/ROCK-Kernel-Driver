## drivers/usb/misc/Kconfig
```kconfig
#
# USB Miscellaneous driver configuration
#
comment "USB Miscellaneous drivers"
	depends on USB

config USB_EMI26
	tristate "EMI 2|6 USB Audio interface support"
	depends on USB_AUDIO
	---help---
	  This driver loads firmware to Emagic EMI 2|6 low latency USB
	  Audio interface.

	  After firmware load the device is handled with standard linux
	  USB Audio driver.

	  To compile this driver as a module, choose M here: the
	  module will be called emi26.

config USB_TIGL
	tristate "Texas Instruments Graph Link USB (aka SilverLink) cable support"
	depends on USB
	---help---
	  If you own a Texas Instruments graphing calculator and use a 
	  TI-GRAPH LINK USB cable (aka SilverLink), then you might be 
	  interested in this driver.

	  If you enable this driver, you will be able to communicate with
	  your calculator through a set of device nodes under /dev.

	  To compile this driver as a module, choose M here: the
	  module will be called tiglusb.

	  If you don't know what the SilverLink cable is or what a Texas
	  Instruments graphing calculator is, then you probably don't need this
	  driver.

	  If unsure, say N.

config USB_AUERSWALD
	tristate "USB Auerswald ISDN support (EXPERIMENTAL)"
	depends on USB && EXPERIMENTAL
	help
	  Say Y here if you want to connect an Auerswald USB ISDN Device
	  to your computer's USB port.

	  To compile this driver as a module, choose M here: the
	  module will be called auerswald.

config USB_RIO500
	tristate "USB Diamond Rio500 support (EXPERIMENTAL)"
	depends on USB && EXPERIMENTAL
	help
	  Say Y here if you want to connect a USB Rio500 mp3 player to your
	  computer's USB port. Please read <file:Documentation/usb/rio.txt>
	  for more information.

	  To compile this driver as a module, choose M here: the
	  module will be called rio500.

config USB_BRLVGER
	tristate "Tieman Voyager USB Braille display support (EXPERIMENTAL)"
	depends on USB && EXPERIMENTAL
	help
	  Say Y here if you want to use the Voyager USB Braille display from
	  Tieman. See <file:Documentation/usb/brlvger.txt> for more
	  information.

	  To compile this driver as a module, choose M here: the
	  module will be called brlvger.

config USB_LCD
	tristate "USB LCD driver support"
	depends on USB
	help
	  Say Y here if you want to connect an USBLCD to your computer's
	  USB port. The USBLCD is a small USB interface board for
	  alphanumeric LCD modules. See <http://www.usblcd.de> for more
	  information.

	  To compile this driver as a module, choose M here: the
	  module will be called usblcd.

config USB_SPEEDTOUCH
	tristate "Alcatel Speedtouch USB support"
	depends on USB && ATM
	select CRC32
	help
	  Say Y here if you have an Alcatel SpeedTouch USB or SpeedTouch 330
	  modem.  In order to use your modem you will need to install some user
	  space tools, see <http://www.linux-usb.org/SpeedTouch/> for details.

	  To compile this driver as a module, choose M here: the
	  module will be called speedtch.

config USB_TEST
	tristate "USB testing driver (DEVELOPMENT)"
	depends on USB && USB_DEVICEFS && EXPERIMENTAL
	help

	  This driver is for testing host controller software.  It is used
	  with specialized device firmware for regression and stress testing,
	  to help prevent problems from cropping up with "real" drivers.

	  See <http://www.linux-usb.org/usbtest> for more information,
	  including sample test device firmware and "how to use it".
```

## drivers/usb/net/Kconfig
```kconfig
#
# USB Network devices configuration
#
comment "USB Network adaptors"
	depends on USB

comment "Networking support is needed for USB Networking device support"
	depends on USB && !NET

config USB_CATC
	tristate "USB CATC NetMate-based Ethernet device support (EXPERIMENTAL)"
	depends on USB && NET && EXPERIMENTAL
	---help---
	  Say Y if you want to use one of the following 10Mbps USB Ethernet
	  device based on the EL1210A chip. Supported devices are:
	  Belkin F5U011
	  Belkin F5U111
	  CATC NetMate
	  CATC NetMate II
	  smartBridges smartNIC

	  This driver makes the adapter appear as a normal Ethernet interface,
	  typically on eth0, if it is the only ethernet device, or perhaps on
	  eth1, if you have a PCI or ISA ethernet card installed.

	  This code is also available as a module ( = code which can be
	  inserted in and removed from the running kernel whenever you want).
	  The module will be called catc. If you want to compile it as a
	  module, say M here and read <file:Documentation/modules.txt>.

config USB_CDCETHER
	tristate "USB CDC Ethernet support (EXPERIMENTAL)"
	depends on USB && NET && EXPERIMENTAL
	---help---
	  This driver supports devices conforming to the Communication Device
	  Class Ethernet Control Model.  This is used in some cable modems.
	  For more details on the specification, get the Communication Device
	  Class specification from <http://www.usb.org/>.

	  This driver should work with the following devices:
	  * Ericsson PipeRider (all variants)
	  * Motorola (DM100 and SB4100)
	  * Broadcom Cable Modem (reference design)
	  * Toshiba PCX1100U and possibly other cable modems

	  The device creates a network device (ethX, where X depends on what
	  other networking devices you have in use), as for a normal PCI
	  or ISA based ethernet network card.

	  This code is also available as a module ( = code which can be
	  inserted in and removed from the running kernel whenever you want).
	  The module will be called cdc-ether.  If you want to compile it 
	  as a module, say M here and read <file:Documentation/modules.txt>.

config USB_KAWETH
	tristate "USB KLSI KL5USB101-based ethernet device support"
	depends on USB && NET
	---help---
	  Say Y here if you want to use one of the following 10Mbps only
	  USB Ethernet adapters based on the KLSI KL5KUSB101B chipset:
	  3Com 3C19250
	  ADS USB-10BT
	  ATEN USB Ethernet
	  ASANTE USB To Ethernet Adapter
	  AOX Endpoints USB Ethernet
	  Correga K.K.
	  D-Link DSB-650C and DU-E10
	  Entrega / Portgear E45
	  I-O DATA USB-ET/T
	  Jaton USB Ethernet Device Adapter
	  Kingston Technology USB Ethernet Adapter
	  Linksys USB10T
	  Mobility USB-Ethernet Adapter
	  NetGear EA-101
	  Peracom Enet and Enet2
	  Portsmith Express Ethernet Adapter
	  Shark Pocket Adapter
	  SMC 2202USB
	  Sony Vaio port extender

	  This driver is likely to work with most 10Mbps only USB Ethernet
	  adapters, including some "no brand" devices. It does NOT work on
	  SmartBridges smartNIC or on Belkin F5U111 devices - you should use
	  the CATC NetMate driver for those. If you are not sure which one
	  you need, select both, and the correct one should be selected for
	  you.

	  This driver makes the adapter appear as a normal Ethernet interface,
	  typically on eth0, if it is the only ethernet device, or perhaps on
	  eth1, if you have a PCI or ISA ethernet card installed.

	  This code is also available as a module ( = code which can be
	  inserted in and removed from the running kernel whenever you want).
	  The module will be called kaweth. If you want to compile it as a
	  module, say M here and read <file:Documentation/modules.txt>.

config USB_PEGASUS
	tristate "USB Pegasus/Pegasus-II based ethernet device support"
	depends on USB && NET
	---help---
	  Say Y here if you know you have Pegasus or Pegasus-II based adapter.
	  If in doubt then look at linux/drivers/usb/pegasus.h for the complete
	  list of supported devices.
	  If your particular adapter is not in the list and you are _sure_ it
	  is Pegasus or Pegasus II based then send me (petkan@users.sourceforge.net)
	  vendor and device IDs.

	  This code is also available as a module ( = code which can be
	  inserted in and removed from the running kernel whenever you want).
	  The module will be called pegasus. If you want to compile it as a
	  module, say M here and read <file:Documentation/modules.txt>.

config USB_RTL8150
	tristate "USB RTL8150 based ethernet device support (EXPERIMENTAL)"
	depends on USB && NET && EXPERIMENTAL
	help
	  Say Y here if you have RTL8150 based usb-ethernet adapter.
	  Send me (petkan@users.sourceforge.net) any comments you may have.
	  You can also check for updates at http://pegasus2.sourceforge.net/

	  This code is also available as a module ( = code which can be
	  inserted in and removed from the running kernel whenever you want).
	  The module will be called rtl8150. If you want to compile it as a
	  module, say M here and read <file:Documentation/modules.txt>.

config USB_USBNET
	tristate "USB-to-USB Networking for cables, PDAs and other devices"
	depends on USB && NET
	---help---
	  This driver supports network links over USB with USB "Network"
	  or "data transfer" cables, often used to network laptops to PCs.
	  Such cables have chips from suppliers such as Belkin/eTEK, GeneSys
	  (GeneLink), NetChip and Prolific.  Some motherboards with USB PC2PC
	  support include such chips.
	  
	  Intelligent USB devices, such as PDAs running Linux (like Yopy
	  and Zaurus, or iPaqs after upgrading to Linux) can use the same
	  approach to provide Internet access.

	  These links will have names like "usb0", "usb1", etc.  They act
	  like two-node Ethernets, so you can use 802.1d Ethernet Bridging
	  (CONFIG_BRIDGE) to simplify your network routing.  For more
	  information see <http://www.linux-usb.org/usbnet/>.

	  This code is also available as a kernel module (code which can be
	  inserted in and removed from the running kernel whenever you want).
	  The module will be called usbnet. If you want to compile it as a
	  module, say M here and read <file:Documentation/modules.txt>.
```
