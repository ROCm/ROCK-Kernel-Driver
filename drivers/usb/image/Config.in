## fs/Config.in
```kconfig
#
# File system configuration
#
mainmenu_option next_comment
comment 'File systems'

bool 'Quota support' CONFIG_QUOTA
tristate 'Kernel automounter support' CONFIG_AUTOFS_FS
tristate 'Kernel automounter version 4 support (also supports v3)' CONFIG_AUTOFS4_FS


dep_tristate 'ADFS file system support' CONFIG_ADFS_FS $CONFIG_EXPERIMENTAL
dep_mbool '  ADFS write support (DANGEROUS)' CONFIG_ADFS_FS_RW $CONFIG_ADFS_FS $CONFIG_EXPERIMENTAL

dep_tristate 'Amiga FFS file system support (EXPERIMENTAL)' CONFIG_AFFS_FS $CONFIG_EXPERIMENTAL

dep_tristate 'Apple Macintosh file system support (EXPERIMENTAL)' CONFIG_HFS_FS $CONFIG_EXPERIMENTAL

dep_tristate 'BFS file system support (EXPERIMENTAL)' CONFIG_BFS_FS $CONFIG_EXPERIMENTAL

# msdos file systems
tristate 'DOS FAT fs support' CONFIG_FAT_FS
dep_tristate '  MSDOS fs support' CONFIG_MSDOS_FS $CONFIG_FAT_FS
dep_tristate '    UMSDOS: Unix-like file system on top of standard MSDOS fs' CONFIG_UMSDOS_FS $CONFIG_MSDOS_FS
dep_tristate '  VFAT (Windows-95) fs support' CONFIG_VFAT_FS $CONFIG_FAT_FS
dep_tristate 'EFS file system support (read only) (EXPERIMENTAL)' CONFIG_EFS_FS $CONFIG_EXPERIMENTAL
dep_tristate 'Journalling Flash File System (JFFS) support (EXPERIMENTAL)' CONFIG_JFFS_FS $CONFIG_EXPERIMENTAL $CONFIG_MTD
if [ "$CONFIG_JFFS_FS" != "n" ] ; then
	int 'JFFS debugging verbosity (0 = quiet, 3 = noisy)' CONFIG_JFFS_FS_VERBOSE 0
fi
tristate 'Compressed ROM file system support' CONFIG_CRAMFS
tristate 'Simple RAM-based file system support' CONFIG_RAMFS

tristate 'ISO 9660 CDROM file system support' CONFIG_ISO9660_FS
dep_mbool '  Microsoft Joliet CDROM extensions' CONFIG_JOLIET $CONFIG_ISO9660_FS

tristate 'Minix fs support' CONFIG_MINIX_FS

tristate 'NTFS file system support (read only)' CONFIG_NTFS_FS
dep_mbool '  NTFS write support (DANGEROUS)' CONFIG_NTFS_RW $CONFIG_NTFS_FS $CONFIG_EXPERIMENTAL

tristate 'OS/2 HPFS file system support' CONFIG_HPFS_FS

bool '/proc file system support' CONFIG_PROC_FS

dep_bool '/dev file system support (EXPERIMENTAL)' CONFIG_DEVFS_FS $CONFIG_EXPERIMENTAL
dep_bool '  Automatically mount at boot' CONFIG_DEVFS_MOUNT $CONFIG_DEVFS_FS
dep_bool '  Debug devfs' CONFIG_DEVFS_DEBUG $CONFIG_DEVFS_FS

# It compiles as a module for testing only.  It should not be used
# as a module in general.  If we make this "tristate", a bunch of people
# who don't know what they are doing turn it on and complain when it
# breaks.
dep_bool '/dev/pts file system for Unix98 PTYs' CONFIG_DEVPTS_FS $CONFIG_UNIX98_PTYS

dep_tristate 'QNX4 file system support (read only) (EXPERIMENTAL)' CONFIG_QNX4FS_FS $CONFIG_EXPERIMENTAL
dep_mbool '  QNX4FS write support (DANGEROUS)' CONFIG_QNX4FS_RW $CONFIG_QNX4FS_FS $CONFIG_EXPERIMENTAL

tristate 'ROM file system support' CONFIG_ROMFS_FS

tristate 'Second extended fs support' CONFIG_EXT2_FS

tristate 'System V and Coherent file system support (read only)' CONFIG_SYSV_FS
dep_mbool '  SYSV file system write support (DANGEROUS)' CONFIG_SYSV_FS_WRITE $CONFIG_SYSV_FS $CONFIG_EXPERIMENTAL

tristate 'UDF file system support (read only)' CONFIG_UDF_FS
dep_mbool '  UDF write support (DANGEROUS)' CONFIG_UDF_RW $CONFIG_UDF_FS $CONFIG_EXPERIMENTAL

tristate 'UFS file system support (read only)' CONFIG_UFS_FS
dep_mbool '  UFS file system write support (DANGEROUS)' CONFIG_UFS_FS_WRITE $CONFIG_UFS_FS $CONFIG_EXPERIMENTAL

if [ "$CONFIG_NET" = "y" ]; then

   mainmenu_option next_comment
   comment 'Network File Systems'

   dep_tristate 'Coda file system support (advanced network fs)' CONFIG_CODA_FS $CONFIG_INET
   dep_tristate 'NFS file system support' CONFIG_NFS_FS $CONFIG_INET
   dep_mbool '  Provide NFSv3 client support' CONFIG_NFS_V3 $CONFIG_NFS_FS
   dep_bool '  Root file system on NFS' CONFIG_ROOT_NFS $CONFIG_NFS_FS $CONFIG_IP_PNP

   dep_tristate 'NFS server support' CONFIG_NFSD $CONFIG_INET
   dep_mbool '  Provide NFSv3 server support' CONFIG_NFSD_V3 $CONFIG_NFSD

   if [ "$CONFIG_NFS_FS" = "y" -o "$CONFIG_NFSD" = "y" ]; then
      define_tristate CONFIG_SUNRPC y
      define_tristate CONFIG_LOCKD y
   else
      if [ "$CONFIG_NFS_FS" = "m" -o "$CONFIG_NFSD" = "m" ]; then
	 define_tristate CONFIG_SUNRPC m
	 define_tristate CONFIG_LOCKD m
   else
	 define_tristate CONFIG_SUNRPC n
	 define_tristate CONFIG_LOCKD n
      fi
   fi
   if [ "$CONFIG_NFSD_V3" = "y" -o "$CONFIG_NFS_V3" = "y" ]; then
     define_bool CONFIG_LOCKD_V4 y
   fi

   dep_tristate 'SMB file system support (to mount Windows shares etc.)' CONFIG_SMB_FS $CONFIG_INET
   if [ "$CONFIG_SMB_FS" != "n" ]; then
      bool '   Use a default NLS' CONFIG_SMB_NLS_DEFAULT
      if [ "$CONFIG_SMB_NLS_DEFAULT" = "y" ]; then
         string '  Default Remote NLS Option' CONFIG_SMB_NLS_REMOTE "cp437"
      fi
   fi
   if [ "$CONFIG_IPX" != "n" -o "$CONFIG_INET" != "n" ]; then
      tristate 'NCP file system support (to mount NetWare volumes)' CONFIG_NCP_FS
      source fs/ncpfs/Config.in
   else
      # for fs/nls/Config.in
      define_bool CONFIG_NCPFS_NLS n
   fi
   endmenu

else
   # for fs/nls/Config.in
   define_bool CONFIG_NCPFS_NLS n
   define_bool CONFIG_SMB_FS n
fi

mainmenu_option next_comment
comment 'Partition Types'
source fs/partitions/Config.in
endmenu
source fs/nls/Config.in
endmenu
```

## fs/Kconfig.reiser4
```kconfig
config REISER4_FS
	tristate "Reiser4 (EXPERIMENTAL very fast general purpose filesystem)"
	depends on EXPERIMENTAL && !4KSTACKS
	---help---
	  Reiser4 is more than twice as fast for both reads and writes as
	  ReiserFS V3, and is the fastest Linux filesystem, by a lot,
	  for typical IO intensive workloads.  [It is slow at fsync
	  intensive workloads as it is not yet optimized for fsync
	  (sponsors are welcome for that work), and it is instead
	  optimized for atomicity, see below.]  Benchmarks that define
	  "a lot" are at http://www.namesys.com/benchmarks.html.

	  It is the storage layer of what will become a general purpose naming
	  system --- like what Microsoft wants WinFS to be except designed with a
	  clean new semantic layer rather than being SQL based like WinFS.
	  For details read http://www.namesys.com/whitepaper.html

	  It performs all filesystem operations as atomic transactions, which
	  means that it either performs a write, or it does not, and in the
	  event of a crash it does not partially perform it or corrupt it.
	  Many applications that currently use fsync don't need to if they use
	  reiser4, and that means a lot for performance.  An API for performing
	  multiple file system operations as one high performance atomic write
	  is almost finished.

	  It stores files in dancing trees, which are like balanced trees but
	  faster.  It packs small files together so that they share blocks
	  without wasting space.  This means you can use it to store really
	  small files.  It also means that it saves you disk space.  It avoids
	  hassling you with anachronisms like having a maximum number of
	  inodes, and wasting space if you use less than that number.

	  It can handle really large directories, because its search
	  algorithms are logarithmic with size not linear.  With Reiser4 you
	  should use subdirectories because they help YOU, not because they
	  help your filesystem's performance, or because your filesystem won't
	  be able to shrink a directory once you have let it grow.  For squid
	  and similar applications, everything in one directory should perform
	  better.

	  It has a plugin-based infrastructure, which means that you can easily
	  invent new kinds of files, and so can other people, so it will evolve
	  rapidly.

	  We will be adding a variety of security features to it that DARPA has
	  funded us to write.

	  "reiser4" is a distinct filesystem mount type from "reiserfs" (V3),
	  which means that "reiserfs" filesystems will be unaffected by any
	  reiser4 bugs.

	  ReiserFS V3 is the stablest Linux filesystem, and V4 is the fastest.

	  In regards to claims by ext2 that they are the de facto
	  standard Linux filesystem, the most polite thing to say is that
          many persons disagree, and it is interesting that those persons
	  seem to include the distros that are growing in market share.
	  See http://www.namesys.com/benchmarks.html for why many disagree.

          If you'd like to upgrade from reiserfs to reiser4, use tar to a
	  temporary disk, maybe using NFS/ssh/SFS to get to that disk, or ask
	  your favorite distro to sponsor writing a conversion program.

	  Sponsored by the Defensed Advanced Research Projects Agency (DARPA)
	  of the United States Government.  DARPA does not endorse this
	  project, it merely sponsors it.
	  See http://www.darpa.mil/ato/programs/chats.htm

	  If you would like to learn about our plans to add
	  military grade security to reiser4, please read
	  http://www.namesys.com/blackbox_security.html.

	  To learn more about reiser4, go to http://www.namesys.com

config REISER4_LARGE_KEY
	bool "Use larger keys on reiser4 tree"
	depends on REISER4_FS
	default y
	---help---
      Make keys larger and use additional bits to order bodies of files within
      a directory in the order of their names, which is what you want
      normally. If you turn this off, file bodies will be ordered by creation
      time, which is not optimal for most users.

      Warning: flipping this option makes your file system binary
      incompatible.

config REISER4_CHECK
	bool "Enable reiser4 debug options"
	depends on REISER4_FS
	---help---
	  Don't use this unless you are a developer debugging reiser4.  If
	  using a kernel made by a distro that thinks they are our competitor
	  (sigh) rather than made by Linus, always check each release to make
	  sure they have not turned this on to make us look slow as was done
	  once in the past.  This checks everything imaginable while reiser4
	  runs.

	  When adding features to reiser4 you should set this, and then
	  extensively test the code, and then send to us and we will test it
	  again.  Include a description of what you did to test it.  All
	  reiser4 code must be tested, reviewed, and signed off on by two
	  persons before it will be accepted into a stable kernel by Hans.

config REISER4_DEBUG
	bool "Assertions"
	depends on REISER4_CHECK && REISER4_FS!=m
	help
	  Turns on assertions checks. Eats a lot of CPU.

config REISER4_DEBUG_MODIFY
	bool "Dirtying"
	depends on REISER4_CHECK
	help
	  Check that node is marked dirty each time it's modified. This is done
	  through maintaining checksum of node content. CPU hog.

config REISER4_DEBUG_MEMCPY
	bool "Memory copying"
	depends on REISER4_CHECK
	help
	  Use special non-inlined versions on memcpy, memset, and memmove in
	  reiser4 to estimate amount of CPU time spent in data copying.

config REISER4_DEBUG_NODE
	bool "Node consistency"
	depends on REISER4_CHECK
	help
	  Run consistency checks on nodes in balanced tree. CPU hog.

config REISER4_ZERO_NEW_NODE
	bool "Node zeroing"
	depends on REISER4_CHECK
	help
	  Zero new node before use.

config REISER4_TRACE
	bool "Tracing"
	depends on REISER4_CHECK
	help
	  Turn on tracing facility. This enables trace_flags mount option.

config REISER4_EVENT_LOG
	bool "Log events"
	depends on REISER4_CHECK
	help
	  Log events into user supplied file. This enables trace_file mount option.

config REISER4_STATS
	bool "Statistics"
	depends on REISER4_CHECK
	help
	  Turn on statistics collection. This increases size of in-memory super
	  block considerably.

config REISER4_DEBUG_OUTPUT
	bool "Printing"
	depends on REISER4_CHECK
	help
	  Enable compilation of functions that print internal kernel data
	  structures in human readable form. Useful for debugging.
```

## fs/novfs/Kconfig
```kconfig
config NOVFS
	tristate "Novell Netware Filesystem support (novfs) (EXPERIMENTAL)"
	depends on INET && EXPERIMENTAL
	help
	  If you say Y here, you will get an experimental Novell Netware
	  filesystem driver.

	  If unsure, say N.
```
