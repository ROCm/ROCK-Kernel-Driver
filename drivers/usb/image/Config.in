## drivers/video/Kconfig
```kconfig
#
# Video configuration
#

menu "Graphics support"

config FB
	bool "Support for frame buffer devices"
	---help---
	  The frame buffer device provides an abstraction for the graphics
	  hardware. It represents the frame buffer of some video hardware and
	  allows application software to access the graphics hardware through
	  a well-defined interface, so the software doesn't need to know
	  anything about the low-level (hardware register) stuff.

	  Frame buffer devices work identically across the different
	  architectures supported by Linux and make the implementation of
	  application programs easier and more portable; at this point, an X
	  server exists which uses the frame buffer device exclusively.
	  On several non-X86 architectures, the frame buffer device is the
	  only way to use the graphics hardware.

	  The device is accessed through special device nodes, usually located
	  in the /dev directory, i.e. /dev/fb*.

	  You need an utility program called fbset to make full use of frame
	  buffer devices. Please read <file:Documentation/fb/framebuffer.txt>
	  and the Framebuffer-HOWTO at
	  <http://www.tahallah.demon.co.uk/programming/prog.html> for more
	  information.

	  Say Y here and to the driver for your graphics board below if you
	  are compiling a kernel for a non-x86 architecture.

	  If you are compiling for the x86 architecture, you can say Y if you
	  want to play with it, but it is not essential. Please note that
	  running graphical applications that directly touch the hardware
	  (e.g. an accelerated X server) and that are not frame buffer
	  device-aware may cause unexpected results. If unsure, say N.

config FB_CLGEN
	tristate "Cirrus Logic support"
	depends on FB && (AMIGA || PCI)
	---help---
	  This enables support for Cirrus Logic GD542x/543x based boards on
	  Amiga: SD64, Piccolo, Picasso II/II+, Picasso IV, or EGS Spectrum.

	  If you have a PCI-based system, this enables support for these
	  chips: GD-543x, GD-544x, GD-5480.

	  Please read the file <file:Documentation/fb/clgenfb.txt>.

	  Say N unless you have such a graphics board or plan to get one
	  before you next recompile the kernel.

config FB_PM2
	tristate "Permedia2 support"
	depends on FB && (AMIGA || PCI)
	help
	  This is the frame buffer device driver for the Permedia2 AGP frame
	  buffer card from ASK, aka `Graphic Blaster Exxtreme'.  There is a
	  product page at
	  <http://www.ask.com.hk/product/Permedia%202/permedia2.htm>.

config FB_PM2_FIFO_DISCONNECT
	bool "enable FIFO disconnect feature"
	depends on FB_PM2 && PCI
	help
	  Support the Permedia2 FIFOI disconnect feature (see CONFIG_FB_PM2).

config FB_PM2_PCI
	bool "generic Permedia2 PCI board support"
	depends on FB_PM2 && PCI
	help
	  Say Y to enable support for Permedia2 AGP frame buffer card from
	  3Dlabs (aka `Graphic Blaster Exxtreme') on the PCI bus.

config FB_PM2_CVPPC
	bool "Phase5 CVisionPPC/BVisionPPC support"
	depends on FB_PM2 && AMIGA
	help
	  Say Y to enable support for the Amiga Phase 5 CVisionPPC BVisionPPC
	  framebuffer cards.  Phase 5 is no longer with us, alas.

config FB_ACORN
	bool "Acorn VIDC support"
	depends on FB && ARM && ARCH_ACORN
	help
	  This is the frame buffer device driver for the Acorn VIDC graphics
	  hardware found in Acorn RISC PCs and other ARM-based machines.  If
	  unsure, say N.

config FB_ANAKIN
	bool "Anakin LCD support"
	depends on FB && ARM && ARCH_ANAKIN

config FB_CLPS711X
	bool "CLPS711X LCD support"
	depends on FB && ARM && ARCH_CLPS711X

config FB_SA1100
	bool "SA-1100 LCD support"
	depends on FB && ARM && ARCH_SA1100
	help
	  This is a framebuffer device for the SA-1100 LCD Controller.
	  See <http://www.linux-fbdev.org/> for information on framebuffer
	  devices.

	  If you plan to use the LCD display with your SA-1100 system, say
	  Y here.

choice
	prompt "CerfBoard LCD Display Size"
	depends on FB_SA1100 && SA1100_CERF
	default CERF_LCD_57_A

config CERF_LCD_38_A
	bool "3.8_Color"

config CERF_LCD_38_B
	bool "3.8_Mono"

config CERF_LCD_57_A
	bool "5.7"

config CERF_LCD_72_A
	bool "7.2"

endchoice

config SA1100_CERF_LCD_BACKLIGHT
	bool "Cerfboard Backlight (CerfPDA)"
	depends on FB_SA1100 && SA1100_CERF_CPLD

config FB_CYBER2000
	tristate "CyberPro 2000/2010/5000 support"
	depends on FB && PCI
	help
	  This enables support for the Integraphics CyberPro 20x0 and 5000
	  VGA chips used in the Rebel.com Netwinder and other machines.
	  Say Y if you have a NetWinder or a graphics card containing this
	  device, otherwise say N.

config FB_APOLLO
	bool
	depends on FB && APOLLO
	default y

config FB_Q40
	bool
	depends on FB && Q40
	default y

config FB_AMIGA
	tristate "Amiga native chipset support"
	depends on FB && AMIGA
	help
	  This is the frame buffer device driver for the builtin graphics
	  chipset found in Amigas.

	  The driver is also available as a module ( = code which can be
	  inserted and removed from the running kernel whenever you want). The
	  module will be called amifb.o. If you want to compile it as a
	  module, say M here and read <file:Documentation/modules.txt>.

config FB_AMIGA_OCS
	bool "Amiga OCS chipset support"
	depends on FB_AMIGA
	help
	  This enables support for the original Agnus and Denise video chips,
	  found in the Amiga 1000 and most A500's and A2000's. If you intend
	  to run Linux on any of these systems, say Y; otherwise say N.

config FB_AMIGA_ECS
	bool "Amiga ECS chipset support"
	depends on FB_AMIGA
	help
	  This enables support for the Enhanced Chip Set, found in later
	  A500's, later A2000's, the A600, the A3000, the A3000T and CDTV. If
	  you intend to run Linux on any of these systems, say Y; otherwise
	  say N.

config FB_AMIGA_AGA
	bool "Amiga AGA chipset support"
	depends on FB_AMIGA
	help
	  This enables support for the Advanced Graphics Architecture (also
	  known as the AGA or AA) Chip Set, found in the A1200, A4000, A4000T
	  and CD32. If you intend to run Linux on any of these systems, say Y;
	  otherwise say N.

config FB_CYBER
	tristate "Amiga CyberVision support"
	depends on FB && ZORRO
	help
	  This enables support for the Cybervision 64 graphics card from
	  Phase5. Please note that its use is not all that intuitive (i.e. if
	  you have any questions, be sure to ask!). Say N unless you have a
	  Cybervision 64 or plan to get one before you next recompile the
	  kernel. Please note that this driver DOES NOT support the
	  Cybervision 64 3D card, as they use incompatible video chips.

config FB_VIRGE
	bool "Amiga CyberVision3D support "
	depends on FB && ZORRO
	help
	  This enables support for the Cybervision 64/3D graphics card from
	  Phase5. Please note that its use is not all that intuitive (i.e. if
	  you have any questions, be sure to ask!). Say N unless you have a
	  Cybervision 64/3D or plan to get one before you next recompile the
	  kernel. Please note that this driver DOES NOT support the older
	  Cybervision 64 card, as they use incompatible video chips.

config FB_RETINAZ3
	tristate "Amiga RetinaZ3 support"
	depends on FB && ZORRO
	help
	  This enables support for the Retina Z3 graphics card. Say N unless
	  you have a Retina Z3 or plan to get one before you next recompile
	  the kernel.

config FB_FM2
	bool "Amiga FrameMaster II/Rainbow II support"
	depends on FB && ZORRO
	help
	  This is the frame buffer device driver for the Amiga FrameMaster
	  card from BSC (exhibited 1992 but not shipped as a CBM product).

config FB_ATARI
	bool "Atari native chipset support"
	depends on FB && ATARI
	help
	  This is the frame buffer device driver for the builtin graphics
	  chipset found in Ataris.

config FB_ATY
	tristate "ATI Mach64 display support" if PCI
	depends on FB
	help
	  This driver supports graphics boards with the ATI Mach64 chips.
	  Say Y if you have such a graphics board.

	  The driver is also available as a module ( = code which can be
	  inserted and removed from the running kernel whenever you want). The
	  module will be called atyfb.o. If you want to compile it as a
	  module, say M here and read <file:Documentation/modules.txt>.

config FB_ATY
	prompt "ATI Mach64 display support"
	depends on FB && (SPARC64 && PCI && FB_PCI || ATARI)

config FB_ATY_GX
	bool "Mach64 GX support" if PCI
	depends on FB_ATY
	default y if ATARI
	help
	  Say Y here to support use of the ATI Mach64 Graphics Expression
	  board (or other boards based on the Mach64 GX chipset) as a
	  framebuffer device.  The ATI product support page for these boards
	  is at
	  <http://support.ati.com/products/pc/mach64/graphics_xpression.html>.

config FB_OF
	bool "Open Firmware frame buffer device support"
	depends on FB && PPC && ALL_PPC
	help
	  Say Y if you want support with Open Firmware for your graphics
	  board.

config FB_CONTROL
	bool "Apple \"control\" display support"
	depends on FB && PPC && ALL_PPC
	help
	  This driver supports a frame buffer for the graphics adapter in the
	  Power Macintosh 7300 and others.

config FB_PLATINUM
	bool "Apple \"platinum\" display support"
	depends on FB && PPC && ALL_PPC
	help
	  This driver supports a frame buffer for the "platinum" graphics
	  adapter in some Power Macintoshes.

config FB_VALKYRIE
	bool "Apple \"valkyrie\" display support"
	depends on FB && (MAC || PPC && ALL_PPC)
	help
	  This driver supports a frame buffer for the "valkyrie" graphics
	  adapter in some Power Macintoshes.

config FB_CT65550
	bool "Chips 65550 display support"
	depends on FB && PPC
	help
	  This is the frame buffer device driver for the Chips & Technologies
	  65550 graphics chip in PowerBooks.

config FB_IMSTT
	bool "IMS Twin Turbo display support"
	depends on FB && PCI
	help
	  The IMS Twin Turbo is a PCI-based frame buffer card bundled with
	  many Macintosh and compatible computers.

config FB_S3TRIO
	bool "S3 Trio display support"
	depends on FB && PPC
	help
	  If you have a S3 Trio say Y. Say N for S3 Virge.

config FB_VGA16
	tristate "VGA 16-color graphics console"
	depends on FB && (X86 || PPC)
	help
	  This is the frame buffer device driver for VGA 16 color graphic
	  cards. Say Y if you have such a card.

	  This code is also available as a module. If you want to compile it
	  as a module ( = code which can be inserted in and removed from the
	  running kernel whenever you want), say M here and read
	  <file:Documentation/modules.txt>.  The module will be called
	  vga16fb.o.

config FB_STI
	bool "Generic STI frame buffer device support"
	depends on FB && PARISC
	---help---
	  STI refers to the HP "Standard Text Interface" which is a set of
	  BIOS routines contained in a ROM chip in HP PA-RISC based machines.
	  Enabling this option will implement the linux framebuffer device and
	  an fbcon color text console using calls to the STI BIOS routines.
	  The HP framebuffer device is usually planar, uses a strange memory
	  layout, and changing the plane mask to create colored pixels
	  requires a call to the STI routines, so do not expect /dev/fb to
	  actually be useful.  However, it is the best we have as far as
	  graphics on the HP chipsets due to lack of hardware level
	  documentation for the various on-board HP chipsets used in these
	  systems.  It is sufficient for basic text console functions,
	  including fonts.

	  You should probably enable this option, unless you are having
	  trouble getting video when booting the kernel (make sure it isn't
	  just that you are running the console on the serial port, though).
	  Really old HP boxes may not have STI, and must use the PDC BIOS
	  console or the IODC BIOS.

config FB_MAC
	bool "Generic Macintosh display support"
	depends on FB && MAC

#      bool '  Apple DAFB display support' CONFIG_FB_DAFB
config FB_HP300
	bool
	depends on FB && HP300
	default y

config FB_TGA
	tristate "TGA framebuffer support"
	depends on FB && ALPHA
	help
	  This is the frame buffer device driver for generic TGA graphic
	  cards. Say Y if you have one of those.

config FB_VESA
	bool "VESA VGA graphics console"
	depends on FB && X86
	help
	  This is the frame buffer device driver for generic VESA 2.0
	  compliant graphic cards. The older VESA 1.2 cards are not supported.
	  You will get a boot time penguin logo at no additional cost. Please
	  read <file:Documentation/fb/vesafb.txt>. If unsure, say Y.

config FB_HGA
	tristate "Hercules mono graphics console"
	depends on FB && X86
	help
	  Say Y here if you have a Hercules mono graphics card.

	  This driver is also available as a module ( = code which can be
	  inserted and removed from the running kernel whenever you want).
	  The module will be called hgafb.o. If you want to compile it as
	  a module, say M here and read <file:Documentation/modules.txt>.

	  As this card technology is 15 years old, most people will answer N
	  here.

config VIDEO_SELECT
	bool
	depends on FB && X86
	default y

config FB_SGIVW
	tristate "SGI Visual Workstation framebuffer support"
	depends on FB && VISWS
	help
	  SGI Visual Workstation support for framebuffer graphics.

config BUS_I2C
	bool
	depends on FB && VISWS
	default y

config FB_SUN3
	bool "Sun3 framebuffer support"
	depends on FB && (SUN3 || SUN3X)

config FB_BWTWO
	bool "BWtwo support"
	depends on FB && ((SPARC32 || SPARC64) && FB_SBUS || (SUN3 || SUN3X) && FB_SUN3)
	help
	  This is the frame buffer device driver for the BWtwo frame buffer.

config FB_CGTHREE
	bool "CGthree support"
	depends on FB && ((SPARC32 || SPARC64) && FB_SBUS || (SUN3 || SUN3X) && FB_SUN3)
	help
	  This is the frame buffer device driver for the CGthree frame buffer.

config FB_CGSIX
	bool "CGsix (GX,TurboGX) support"
	depends on FB && ((SPARC32 || SPARC64) && FB_SBUS || (SUN3 || SUN3X) && FB_SUN3)
	help
	  This is the frame buffer device driver for the CGsix (GX, TurboGX)
	  frame buffer.

config FB_PVR2
	tristate "NEC PowerVR 2 display support"
	depends on FB && SH_DREAMCAST
	---help---
	  Say Y here if you have a PowerVR 2 card in your box.  If you plan to
	  run linux on your Dreamcast, you will have to say Y here.
	  This driver may or may not work on other PowerVR 2 cards, but is
	  totally untested.  Use at your own risk.  If unsure, say N.

	  This driver is also available as a module ( = code which can be
	  inserted and removed from the running kernel whenever you want).
	  The module will be called pvr2fb.o.  If you want to compile it as
	  a module, say M here and read <file:Documentation/modules.txt>.

	  You can pass several parameters to the driver at boot time or at
	  module load time.  The parameters look like "video=pvr2:XXX", where
	  the meaning of XXX can be found at the end of the main source file
	  (<file:drivers/video/pvr2fb.c>). Please see the file
	  <file:Documentation/fb/pvr2fb.txt>.

config FB_PVR2_DEBUG
	bool "Debug pvr2fb"
	depends on FB_PVR2=y
	help
	  Say Y here if you wish for the pvr2fb driver to print out debugging
	  messages. Most people will want to say N here. If unsure, you will
	  also want to say N.

config FB_E1355
	bool "Epson 1355 framebuffer support"
	depends on FB && SUPERH
	help
	  Build in support for the SED1355 Epson Research Embedded RAMDAC
	  LCD/CRT Controller (since redesignated as the S1D13505) as a
	  framebuffer.  Product specs at
	  <http://www.erd.epson.com/vdc/html/products.htm>.

config E1355_REG_BASE
	hex "Register Base Address"
	depends on FB_E1355
	default "a8000000"
	help
	  Epson SED1355/S1D13505 LCD/CRT controller register base address.
	  See the manuals at
	  <http://www.erd.epson.com/vdc/html/contents/S1D13505.htm> for
	  discussion.

config E1355_FB_BASE
	hex "Framebuffer Base Address"
	depends on FB_E1355
	default "a8200000"
	help
	  Epson SED1355/S1D13505 LCD/CRT controller memory base address.  See
	  the manuals at
	  <http://www.erd.epson.com/vdc/html/contents/S1D13505.htm> for
	  discussion.

config FB_RIVA
	tristate "nVidia Riva support"
	depends on FB && PCI
	help
	  This driver supports graphics boards with the nVidia Riva/Geforce
	  chips.
	  Say Y if you have such a graphics board.

	  The driver is also available as a module ( = code which can be
	  inserted and removed from the running kernel whenever you want). The
	  module will be called rivafb.o. If you want to compile it as a
	  module, say M here and read <file:Documentation/modules.txt>.

config FB_MATROX
	tristate "Matrox acceleration"
	depends on FB && PCI
	---help---
	  Say Y here if you have a Matrox Millennium, Matrox Millennium II,
	  Matrox Mystique, Matrox Mystique 220, Matrox Productiva G100, Matrox
	  Mystique G200, Matrox Millennium G200, Matrox Marvel G200 video,
	  Matrox G400, G450 or G550 card in your box.

	  This driver is also available as a module ( = code which can be
	  inserted and removed from the running kernel whenever you want).
	  The module will be called matroxfb.o. If you want to compile it as
	  a module, say M here and read <file:Documentation/modules.txt>.

	  You can pass several parameters to the driver at boot time or at
	  module load time. The parameters look like "video=matrox:XXX", and
	  are described in <file:Documentation/fb/matroxfb.txt>.

config FB_MATROX_MILLENIUM
	bool "Millennium I/II support"
	depends on FB_MATROX
	help
	  Say Y here if you have a Matrox Millennium or Matrox Millennium II
	  video card. If you select "Advanced lowlevel driver options" below,
	  you should check 4 bpp packed pixel, 8 bpp packed pixel, 16 bpp
	  packed pixel, 24 bpp packed pixel and 32 bpp packed pixel. You can
	  also use font widths different from 8.

config FB_MATROX_MYSTIQUE
	bool "Mystique support"
	depends on FB_MATROX
	help
	  Say Y here if you have a Matrox Mystique or Matrox Mystique 220
	  video card. If you select "Advanced lowlevel driver options" below,
	  you should check 8 bpp packed pixel, 16 bpp packed pixel, 24 bpp
	  packed pixel and 32 bpp packed pixel. You can also use font widths
	  different from 8.

config FB_MATROX_G450
	bool "G100/G200/G400/G450/G550 support"
	depends on FB_MATROX
	---help---
	  Say Y here if you have a Matrox G100, G200, G400, G450 or G550 based
	  video card. If you select "Advanced lowlevel driver options", you
	  should check 8 bpp packed pixel, 16 bpp packed pixel, 24 bpp packed
	  pixel and 32 bpp packed pixel. You can also use font widths
	  different from 8.

	  If you need support for G400 secondary head, you must first say Y to
	  "I2C support" and "I2C bit-banging support" in the character devices
	  section, and then to "Matrox I2C support" and "G400 second head
	  support" here in the framebuffer section. G450/G550 secondary head
	  and digital output are supported without additional modules.

	  The driver starts in monitor mode. You must use the matroxset tool 
	  (available at <ftp://platan.vc.cvut.cz/pub/linux/matrox-latest/>) to 
	  swap primary and secondary head outputs, or to change output mode.  
	  Secondary head driver always start in 640x480 resolution and you 
	  must use fbset to change it.

	  Do not forget that second head supports only 16 and 32 bpp
	  packed pixels, so it is a good idea to compile them into the kernel
	  too. You can use only some font widths, as the driver uses generic
	  painting procedures (the secondary head does not use acceleration
	  engine).

	  G450/G550 hardware can display TV picture only from secondary CRTC,
	  and it performs no scaling, so picture must have 525 or 625 lines.

config FB_MATROX_G100A
	bool "G100/G200/G400 support"
	depends on FB_MATROX && !FB_MATROX_G450
	---help---
	  Say Y here if you have a Matrox G100, G200 or G400 based
	  video card. If you select "Advanced lowlevel driver options", you
	  should check 8 bpp packed pixel, 16 bpp packed pixel, 24 bpp packed
	  pixel and 32 bpp packed pixel. You can also use font widths
	  different from 8.

	  If you need support for G400 secondary head, you must first say Y to
	  "I2C support" and "I2C bit-banging support" in the character devices
	  section, and then to "Matrox I2C support" and "G400 second head
	  support" here in the framebuffer section.

config FB_MATROX_G100
	bool
	depends on FB_MATROX && (FB_MATROX_G450 || FB_MATROX_G100A)
	default y

config FB_MATROX_I2C
	tristate "Matrox I2C support"
	depends on FB_MATROX && I2C_ALGOBIT
	---help---
	  This drivers creates I2C buses which are needed for accessing the
	  DDC (I2C) bus present on all Matroxes, an I2C bus which
	  interconnects Matrox optional devices, like MGA-TVO on G200 and
	  G400, and the secondary head DDC bus, present on G400 only.

	  You can say Y or M here if you want to experiment with monitor
	  detection code. You must say Y or M here if you want to use either
	  second head of G400 or MGA-TVO on G200 or G400.

	  If you compile it as module, it will create a module named
	  i2c-matroxfb.o.

config FB_MATROX_MAVEN
	tristate "G400 second head support"
	depends on FB_MATROX_G100 && FB_MATROX_I2C
	---help---
	  WARNING !!! This support does not work with G450 !!!

	  Say Y or M here if you want to use a secondary head (meaning two
	  monitors in parallel) on G400 or MGA-TVO add-on on G200. Secondary
	  head is not compatible with accelerated XFree 3.3.x SVGA servers -
	  secondary head output is blanked while you are in X. With XFree
	  3.9.17 preview you can use both heads if you use SVGA over fbdev or
	  the fbdev driver on first head and the fbdev driver on second head.

	  If you compile it as module, two modules are created,
	  matroxfb_crtc2.o and matroxfb_maven.o. Matroxfb_maven is needed for
	  both G200 and G400, matroxfb_crtc2 is needed only by G400. You must
	  also load i2c-matroxfb to get it to run.

	  The driver starts in monitor mode and you must use the matroxset
	  tool (available at
	  <ftp://platan.vc.cvut.cz/pub/linux/matrox-latest/>) to switch it to
	  PAL or NTSC or to swap primary and secondary head outputs.
	  Secondary head driver also always start in 640x480 resolution, you
	  must use fbset to change it.

	  Also do not forget that second head supports only 16 and 32 bpp
	  packed pixels, so it is a good idea to compile them into the kernel
	  too.  You can use only some font widths, as the driver uses generic
	  painting procedures (the secondary head does not use acceleration
	  engine).

config FB_MATROX_MULTIHEAD
	bool "Multihead support"
	depends on FB_MATROX
	---help---
	  Say Y here if you have more than one (supported) Matrox device in
	  your computer and you want to use all of them for different monitors
	  ("multihead"). If you have only one device, you should say N because
	  the driver compiled with Y is larger and a bit slower, especially on
	  ia32 (ix86).

	  If you said M to "Matrox unified accelerated driver" and N here, you
	  will still be able to use several Matrox devices simultaneously:
	  insert several instances of the module matroxfb.o into the kernel
	  with insmod, supplying the parameter "dev=N" where N is 0, 1, etc.
	  for the different Matrox devices. This method is slightly faster but
	  uses 40 KB of kernel memory per Matrox card.

	  There is no need for enabling 'Matrox multihead support' if you have
	  only one Matrox card in the box.

config FB_ATY_CT
	bool "Mach64 CT/VT/GT/LT (incl. 3D RAGE) support"
	depends on PCI && FB_ATY
	default y if SPARC64 && FB_PCI
	help
	  Say Y here to support use of ATI's 64-bit Rage boards (or other
	  boards based on the Mach64 CT, VT, GT, and LT chipsets) as a
	  framebuffer device.  The ATI product support page for these boards
	  is at <http://support.ati.com/products/pc/mach64/>.

config FB_RADEON
	tristate "ATI Radeon display support"
	depends on FB && PCI
	help
	  Choose this option if you want to use an ATI Radeon graphics card as
	  a framebuffer device.  There are both PCI and AGP versions.  You
	  don't need to choose this to run the Radeon in plain VGA mode.
	  There is a product page at
	  <http://www.ati.com/na/pages/products/pc/radeon32/index.html>.

config FB_ATY128
	tristate "ATI Rage128 display support"
	depends on FB && PCI
	help
	  This driver supports graphics boards with the ATI Rage128 chips.
	  Say Y if you have such a graphics board and read
	  <file:Documentation/fb/aty128fb.txt>.

	  The driver is also available as a module ( = code which can be
	  inserted and removed from the running kernel whenever you want). The
	  module will be called aty128fb.o. If you want to compile it as a
	  module, say M here and read <file:Documentation/modules.txt>.

config FB_SIS
	tristate "SIS acceleration"
	depends on FB && PCI
	help
	  This is the frame buffer device driver for the SiS 630 and 640 Super
	  Socket 7 UMA cards.  Specs available at <http://www.sis.com.tw/>.

config FB_SIS_300
	bool "SIS 630/540/730 support"
	depends on FB_SIS
	help
	  This is the frame buffer device driver for the SiS 630 and related
	  Super Socket 7 UMA cards.  Specs available at
	  <http://www.sis.com.tw/>.

config FB_SIS_315
	bool "SIS 315H/315 support"
	depends on FB_SIS
	help
	  This is the frame buffer device driver for the SiS 315 graphics
	  card.  Specs available at <http://www.sis.com.tw/>.

config FB_NEOMAGIC
	tristate "NeoMagic display support"
	depends on FB && PCI
	help
	  This driver supports notebooks with NeoMagic PCI chips.
	  Say Y if you have such a graphics card. 

	  The driver is also available as a module ( = code which can be
	  inserted and removed from the running kernel whenever you want). The
	  module will be called neofb.o. If you want to compile it as a
	  module, say M here and read Documentation/modules.txt.

config FB_3DFX
	tristate "3Dfx Banshee/Voodoo3 display support"
	depends on FB && PCI
	help
	  This driver supports graphics boards with the 3Dfx Banshee/Voodoo3
	  chips. Say Y if you have such a graphics board.

	  The driver is also available as a module ( = code which can be
	  inserted and removed from the running kernel whenever you want). The
	  module will be called tdfxfb.o. If you want to compile it as a
	  module, say M here and read <file:Documentation/modules.txt>.

config FB_VOODOO1
	tristate "3Dfx Voodoo Graphics (sst1) support"
	depends on FB && PCI
	---help---
	  Say Y here if you have a 3Dfx Voodoo Graphics (Voodoo1/sst1) or 
	  Voodoo2 (cvg) based graphics card.

	  This driver is also available as a module ( = code which can be 
	  inserted and removed from the running kernel whenever you want).
	  The module will be called sstfb.o. If you want to compile it as
	  a module, say M here and read Documentation/modules.txt.

	  WARNING: Do not use any application that uses the 3D engine
	  (namely glide) while using this driver.
	  Please read the file Documentation/fb/README-sstfb.txt for supported
	  options and other important info  support.

config FB_TRIDENT
	tristate "Trident support"
	depends on FB && PCI
	---help---
	  This driver is supposed to support graphics boards with the
	  Trident CyberXXXX/Image/CyberBlade chips mostly found in laptops
	  but also on some motherboards. For more information, read
	  <file:Documentation/fb/tridentfb.txt>

	  Say Y if you have such a graphics board.

	  The driver is also available as a module ( = code which can be
	  inserted and removed from the running kernel whenever you want). The
	  module will be called rivafb.o. If you want to compile it as a
	  module, say M here and read <file:Documentation/modules.txt>.

config FB_PM3
	tristate "Permedia3 support"
	depends on FB && PCI
	help
	  This is the frame buffer device driver for the 3DLabs Permedia3
	  chipset, used in Formac ProFormance III, 3DLabs Oxygen VX1 &
	  similar boards, 3DLabs Permedia3 Create!, Appian Jeronimo 2000
	  and maybe other boards.

config FB_SBUS
	bool "SBUS and UPA framebuffers"
	depends on FB && (SPARC32 || SPARC64)
	help
	  Say Y if you want support for SBUS or UPA based frame buffer device.

config FB_CREATOR
	bool "Creator/Creator3D support"
	depends on FB_SBUS && SPARC64
	help
	  This is the frame buffer device driver for the Creator and Creator3D
	  graphics boards.

config FB_TCX
	bool "TCX (SS4/SS5 only) support"
	depends on FB_SBUS && SPARC32
	help
	  This is the frame buffer device driver for the TCX 24/8bit frame
	  buffer.

config FB_CGFOURTEEN
	bool "CGfourteen (SX) support"
	depends on FB_SBUS && SPARC32
	help
	  This is the frame buffer device driver for the CGfourteen frame
	  buffer on Desktop SPARCsystems with the SX graphics option.

config FB_P9100
	bool "P9100 (Sparcbook 3 only) support"
	depends on FB_SBUS && SPARC32
	help
	  This is the frame buffer device driver for the P9100 card
	  supported on Sparcbook 3 machines.

config FB_LEO
	bool "Leo (ZX) support"
	depends on FB_SBUS
	help
	  This is the frame buffer device driver for the SBUS-based Sun ZX
	  (leo) frame buffer cards.

config FB_PCI
	bool "PCI framebuffers"
	depends on FB && PCI && (SPARC64 || SPARC32)

config FB_IGA
	bool "IGA 168x display support"
	depends on SPARC32 && FB_PCI
	help
	  This is the framebuffer device for the INTERGRAPHICS 1680 and
	  successor frame buffer cards.

config FB_HIT
	tristate "HD64461 Frame Buffer support"
	depends on FB && HD64461
	help
	  This is the frame buffer device driver for the Hitachi HD64461 LCD
	  frame buffer card.

config FB_PMAG_BA
	bool "PMAG-BA TURBOchannel framebuffer support"
	depends on FB && DECSTATION && TC
	help
	  Say Y here to directly support the on-board PMAG-BA framebuffer in
	  the 5000/1xx versions of the DECstation.  There is a page dedicated
	  to Linux on DECstations at <http://decstation.unix-ag.org/>.

config FB_PMAGB_B
	bool "PMAGB-B TURBOchannel framebuffer spport"
	depends on FB && DECSTATION && TC
	help
	  Say Y here to directly support the on-board PMAGB-B framebuffer in
	  the 5000/1xx versions of the DECstation.  There is a page dedicated
	  to Linux on DECstations at <http://decstation.unix-ag.org/>.

config FB_MAXINE
	bool "Maxine (Personal DECstation) onboard framebuffer spport"
	depends on FB && DECSTATION && TC
	help
	  Say Y here to directly support the on-board framebuffer in the
	  Maxine (5000/20, /25, /33) version of the DECstation.  There is a
	  page dedicated to Linux on DECstations at <http://decstation.unix-ag.org/>.

config FB_TX3912
	bool "TMPTX3912/PR31700 frame buffer support"
	depends on FB && NINO
	help
	  The TX3912 is a Toshiba RISC processor based on the MIPS 3900 core
	  see <http://www.toshiba.com/taec/components/Generic/risc/tx3912.htm>.

	  Say Y here to enable kernel support for the on-board framebuffer.

config FB_VIRTUAL
	tristate "Virtual Frame Buffer support (ONLY FOR TESTING!)"
	depends on FB
	---help---
	  This is a `virtual' frame buffer device. It operates on a chunk of
	  unswappable kernel memory instead of on the memory of a graphics
	  board. This means you cannot see any output sent to this frame
	  buffer device, while it does consume precious memory. The main use
	  of this frame buffer device is testing and debugging the frame
	  buffer subsystem. Do NOT enable it for normal systems! To protect
	  the innocent, it has to be enabled explicitly at boot time using the
	  kernel option `video=vfb:'.

	  This driver is also available as a module ( = code which can be
	  inserted and removed from the running kernel whenever you want). The
	  module will be called vfb.o. If you want to compile it as a module,
	  say M here and read <file:Documentation/modules.txt>.

	  If unsure, say N.

source "drivers/video/console/Kconfig"

endmenu
```
