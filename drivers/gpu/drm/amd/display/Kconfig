## drivers/input/joystick/Kconfig
```kconfig
#
# Joystick driver configuration
#
config INPUT_JOYSTICK
	bool "Joysticks"
	depends on INPUT
	help
	  If you have a joystick, 6dof controller, gamepad, steering wheel,
	  weapon control system or something like that you can say Y here
	  and the list of supported devices will be displayed. This option
	  doesn't affect the kernel.

	  Please read the file <file:Documentation/input/joystick.txt> which
	  contains more information.

config JOYSTICK_ANALOG
	tristate "Classic PC analog joysticks and gamepads"
	depends on INPUT && INPUT_JOYSTICK && GAMEPORT
	---help---
	  Say Y here if you have a joystick that connects to the PC
	  gameport. In addition to the usual PC analog joystick, this driver
	  supports many extensions, including joysticks with throttle control,
	  with rudders, additional hats and buttons compatible with CH
	  Flightstick Pro, ThrustMaster FCS, 6 and 8 button gamepads, or
	  Saitek Cyborg joysticks. 

	  Please read the file <file:Documentation/input/joystick.txt> which
	  contains more information.

	  This driver is also available as a module ( = code which can be
	  inserted in and removed from the running kernel whenever you want).
	  The module will be called analog. If you want to compile it as a
	  module, say M here and read <file:Documentation/modules.txt>.

config JOYSTICK_A3D
	tristate "Assasin 3D and MadCatz Panther devices"
	depends on INPUT && INPUT_JOYSTICK && GAMEPORT
	help
	  Say Y here if you have an FPGaming or MadCatz controller using the
	  A3D protocol over the PC gameport. 

	  This driver is also available as a module ( = code which can be
	  inserted in and removed from the running kernel whenever you want).
	  The module will be called a3d. If you want to compile it as a
	  module, say M here and read <file:Documentation/modules.txt>.

config JOYSTICK_ADI
	tristate "Logitech ADI digital joysticks and gamepads"
	depends on INPUT && INPUT_JOYSTICK && GAMEPORT
	help
	  Say Y here if you have a Logitech controller using the ADI
	  protocol over the PC gameport. 

	  This driver is also available as a module ( = code which can be
	  inserted in and removed from the running kernel whenever you want).
	  The module will be called adi. If you want to compile it as a
	  module, say M here and read <file:Documentation/modules.txt>.

config JOYSTICK_COBRA
	tristate "Creative Labs Blaster Cobra gamepad"
	depends on INPUT && INPUT_JOYSTICK && GAMEPORT
	help
	  Say Y here if you have a Creative Labs Blaster Cobra gamepad.

	  This driver is also available as a module ( = code which can be
	  inserted in and removed from the running kernel whenever you want).
	  The module will be called cobra. If you want to compile it as a
	  module, say M here and read <file:Documentation/modules.txt>.

config JOYSTICK_GF2K
	tristate "Genius Flight2000 Digital joysticks and gamepads"
	depends on INPUT && INPUT_JOYSTICK && GAMEPORT
	help
	  Say Y here if you have a Genius Flight2000 or MaxFighter digitally
	  communicating joystick or gamepad.

	  This driver is also available as a module ( = code which can be
	  inserted in and removed from the running kernel whenever you want).
	  The module will be called gf2k. If you want to compile it as a
	  module, say M here and read <file:Documentation/modules.txt>.

config JOYSTICK_GRIP
	tristate "Gravis GrIP joysticks and gamepads"
	depends on INPUT && INPUT_JOYSTICK && GAMEPORT
	help
	  Say Y here if you have a Gravis controller using the GrIP protocol
	  over the PC gameport. 

	  This driver is also available as a module ( = code which can be
	  inserted in and removed from the running kernel whenever you want).
	  The module will be called grip. If you want to compile it as a
	  module, say M here and read <file:Documentation/modules.txt>.

config JOYSTICK_GRIP_MP
	tristate "Gravis GrIP MultiPort"
	depends on INPUT && INPUT_JOYSTICK && GAMEPORT
	help
	  Say Y here if you have the original Gravis GrIP MultiPort, a hub
	  that connects to the gameport and you connect gamepads to it.

	  This driver is also available as a module ( = code which can be
	  inserted in and removed from the running kernel whenever you want).
	  The module will be called grip_mp. If you want to compile it as a
	  module, say M here and read <file:Documentation/modules.txt>.

config JOYSTICK_GUILLEMOT
	tristate "Guillemot joysticks and gamepads"
	depends on INPUT && INPUT_JOYSTICK && GAMEPORT
	help
	  Say Y here if you have a Guillemot joystick using a digital
	  protocol over the PC gameport. 

	  This driver is also available as a module ( = code which can be
	  inserted in and removed from the running kernel whenever you want).
	  The module will be called guillemot. If you want to compile it as a
	  module, say M here and read <file:Documentation/modules.txt>.

config JOYSTICK_INTERACT
	tristate "InterAct digital joysticks and gamepads"
	depends on INPUT && INPUT_JOYSTICK && GAMEPORT
	help
	  Say Y here if you have an InterAct gameport or joystick
	  communicating digitally over the gameport.

	  This driver is also available as a module ( = code which can be
	  inserted in and removed from the running kernel whenever you want).
	  The module will be called interact. If you want to compile it as
	  a module, say M here and read <file:Documentation/modules.txt>.

config JOYSTICK_SIDEWINDER
	tristate "Microsoft SideWinder digital joysticks and gamepads"
	depends on INPUT && INPUT_JOYSTICK && GAMEPORT
	help
	  Say Y here if you have a Microsoft controller using the Digital
	  Overdrive protocol over PC gameport.

	  This driver is also available as a module ( = code which can be
	  inserted in and removed from the running kernel whenever you want).
	  The module will be called sidewinder. If you want to compile it
	  as a module, say M here and read <file:Documentation/modules.txt>.

config JOYSTICK_TMDC
	tristate "ThrustMaster DirectConnect joysticks and gamepads"
	depends on INPUT && INPUT_JOYSTICK && GAMEPORT
	help
	  Say Y here if you have a ThrustMaster controller using the
	  DirectConnect (BSP) protocol over the PC gameport. 

	  This driver is also available as a module ( = code which can be
	  inserted in and removed from the running kernel whenever you want).
	  The module will be called tmdc. If you want to compile it as a
	  module, say M here and read <file:Documentation/modules.txt>.

source "drivers/input/joystick/iforce/Kconfig"

config JOYSTICK_WARRIOR
	tristate "Logitech WingMan Warrior joystick"
	depends on INPUT && INPUT_JOYSTICK && SERIO
	help
	  Say Y here if you have a Logitech WingMan Warrior joystick connected
	  to your computer's serial port. 

	  This driver is also available as a module ( = code which can be
	  inserted in and removed from the running kernel whenever you want).
	  The module will be called warrior. If you want to compile it as a
	  module, say M here and read <file:Documentation/modules.txt>.

config JOYSTICK_MAGELLAN
	tristate "LogiCad3d Magellan/SpaceMouse 6dof controllers"
	depends on INPUT && INPUT_JOYSTICK && SERIO
	help
	  Say Y here if you have a Magellan or Space Mouse 6DOF controller
	  connected to your computer's serial port.

	  This driver is also available as a module ( = code which can be
	  inserted in and removed from the running kernel whenever you want).
	  The module will be called magellan. If you want to compile it as
	  a module, say M here and read <file:Documentation/modules.txt>.

config JOYSTICK_SPACEORB
	tristate "SpaceTec SpaceOrb/Avenger 6dof controllers"
	depends on INPUT && INPUT_JOYSTICK && SERIO
	help
	  Say Y here if you have a SpaceOrb 360 or SpaceBall Avenger 6DOF
	  controller connected to your computer's serial port.

	  This driver is also available as a module ( = code which can be
	  inserted in and removed from the running kernel whenever you want).
	  The module will be called spaceorb. If you want to compile it as
	  a module, say M here and read <file:Documentation/modules.txt>.

config JOYSTICK_SPACEBALL
	tristate "SpaceTec SpaceBall 6dof controllers"
	depends on INPUT && INPUT_JOYSTICK && SERIO
	help
	  Say Y here if you have a SpaceTec SpaceBall 2003/3003/4000 FLX
	  controller connected to your computer's serial port. For the
	  SpaceBall 4000 USB model, use the USB HID driver.

	  This driver is also available as a module ( = code which can be
	  inserted in and removed from the running kernel whenever you want).
	  The module will be called spaceball. If you want to compile it as
	  a module, say M here and read <file:Documentation/modules.txt>.

config JOYSTICK_STINGER
	tristate "Gravis Stinger gamepad"
	depends on INPUT && INPUT_JOYSTICK && SERIO
	help
	  Say Y here if you have a Gravis Stinger connected to one of your
	  serial ports.

	  This driver is also available as a module ( = code which can be
	  inserted in and removed from the running kernel whenever you want).
	  The module will be called stinger. If you want to compile it as a
	  module, say M here and read <file:Documentation/modules.txt>.

config JOYSTICK_TWIDDLER
	tristate "Twiddler as a joystick"
	depends on INPUT && INPUT_JOYSTICK && SERIO
	help
	  Say Y here if you have a Handykey Twiddler connected to your
	  computer's serial port and want to use it as a joystick.

	  This driver is also available as a module ( = code which can be
	  inserted in and removed from the running kernel whenever you want).
	  The module will be called twidjoy. If you want to compile it as a
	  module, say M here and read <file:Documentation/modules.txt>.

config JOYSTICK_DB9
	tristate "Multisystem, Sega Genesis, Saturn joysticks and gamepads"
	depends on INPUT && INPUT_JOYSTICK && PARPORT
	---help---
	  Say Y here if you have a Sega Master System gamepad, Sega Genesis
	  gamepad, Sega Saturn gamepad, or a Multisystem -- Atari, Amiga,
	  Commodore, Amstrad CPC joystick connected to your parallel port.
	  For more information on how to use the driver please read
	  <file:Documentation/input/joystick-parport.txt>.

	  This driver is also available as a module ( = code which can be
	  inserted in and removed from the running kernel whenever you want).
	  The module will be called db9. If you want to compile it as a
	  module, say M here and read <file:Documentation/modules.txt>.

config JOYSTICK_GAMECON
	tristate "Multisystem, NES, SNES, N64, PSX joysticks and gamepads"
	depends on INPUT && INPUT_JOYSTICK && PARPORT
	---help---
	  Say Y here if you have a Nintendo Entertainment System gamepad,
	  Super Nintendo Entertainment System gamepad, Nintendo 64 gamepad,
	  Sony PlayStation gamepad or a Multisystem -- Atari, Amiga,
	  Commodore, Amstrad CPC joystick connected to your parallel port.
	  For more information on how to use the driver please read
	  <file:Documentation/input/joystick-parport.txt>.

	  This driver is also available as a module ( = code which can be
	  inserted in and removed from the running kernel whenever you want).
	  The module will be called gamecon. If you want to compile it as a
	  module, say M here and read <file:Documentation/modules.txt>.

config JOYSTICK_TURBOGRAFX
	tristate "Multisystem joysticks via TurboGraFX device"
	depends on INPUT && INPUT_JOYSTICK && PARPORT
	help
	  Say Y here if you have the TurboGraFX interface by Steffen Schwenke,
	  and want to use it with Multisystem -- Atari, Amiga, Commodore,
	  Amstrad CPC joystick. For more information on how to use the driver
	  please read <file:Documentation/input/joystick-parport.txt>.

	  This driver is also available as a module ( = code which can be
	  inserted in and removed from the running kernel whenever you want).
	  The module will be called turbografx. If you want to compile it
	  as a module, say M here and read <file:Documentation/modules.txt>.

config JOYSTICK_AMIGA
	tristate "Amiga joysticks"
	depends on AMIGA && INPUT && INPUT_JOYSTICK
	help
	  Say Y here if you have an Amiga with a digital joystick connected
	  to it.

	  This driver is also available as a module ( = code which can be
	  inserted in and removed from the running kernel whenever you want).
	  The module will be called amijoy. If you want to compile it as
	  a module, say M here and read <file:Documentation/modules.txt>.

config INPUT_JOYDUMP
	tristate "Gameport data dumper"
	depends on INPUT && INPUT_JOYSTICK
	help
	  Say Y here if you want to dump data from your joystick into the system
	  log for debugging purposes. Say N if you are making a production
	  configuration or aren't sure. 

	  This driver is also available as a module ( = code which can be
	  inserted in and removed from the running kernel whenever you want).
	  The module will be called joydump. If you want to compile it as
	  a module, say M here and read <file:Documentation/modules.txt>.
```

## drivers/input/joystick/iforce/Kconfig
```kconfig
#
# I-Force driver configuration
#
config JOYSTICK_IFORCE
	tristate "I-Force devices"
	depends on INPUT && INPUT_JOYSTICK
	help
	  Say Y here if you have an I-Force joystick or steering wheel

	  You also must choose at least one of the two options below.

	  This driver is also available as a module ( = code which can be
	  inserted in and removed from the running kernel whenever you want).
	  The module will be called iforce. If you want to compile it as a
	  module, say M here and read <file:Documentation/modules.txt>.

config JOYSTICK_IFORCE_USB
	bool "I-Force USB joysticks and wheels"
	depends on JOYSTICK_IFORCE && (JOYSTICK_IFORCE=m || USB=y) && USB
	help
	  Say Y here if you have an I-Force joystick or steering wheel
	  connected to your USB port. 

config JOYSTICK_IFORCE_232
	bool "I-Force Serial joysticks and wheels"
	depends on JOYSTICK_IFORCE && (JOYSTICK_IFORCE=m || SERIO=y) && SERIO
	help
	  Say Y here if you have an I-Force joystick or steering wheel
	  connected to your serial (COM) port.

	  You will need an additional utility called inputattach, see
	  Documentation/input/joystick.txt and ff.txt.
```
