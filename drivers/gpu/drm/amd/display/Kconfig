## drivers/input/Config.in
```kconfig
#
# Input device configuration
#

mainmenu_option next_comment
comment 'Input device support'

define_tristate CONFIG_INPUT y

comment 'Userland interfaces'
dep_tristate '  Mouse interface' CONFIG_INPUT_MOUSEDEV $CONFIG_INPUT
dep_mbool '    Provide legacy /dev/psaux device' CONFIG_INPUT_MOUSEDEV_PSAUX $CONFIG_INPUT_MOUSEDEV
if [ "$CONFIG_INPUT_MOUSEDEV" != "n" ]; then
   int '   Horizontal screen resolution' CONFIG_INPUT_MOUSEDEV_SCREEN_X 1024
   int '   Vertical screen resolution' CONFIG_INPUT_MOUSEDEV_SCREEN_Y 768
fi
dep_tristate '  Joystick interface' CONFIG_INPUT_JOYDEV $CONFIG_INPUT
dep_tristate '  Touchscreen interface' CONFIG_INPUT_TSDEV $CONFIG_INPUT
if [ "$CONFIG_INPUT_TSDEV" != "n" ]; then
   int '   Horizontal screen resolution' CONFIG_INPUT_TSDEV_SCREEN_X 240
   int '   Vertical screen resolution' CONFIG_INPUT_TSDEV_SCREEN_Y 320 
fi
dep_tristate '  Event interface' CONFIG_INPUT_EVDEV $CONFIG_INPUT
dep_tristate '  Event debugging' CONFIG_INPUT_EVBUG $CONFIG_INPUT


comment 'Input I/O drivers'
source drivers/input/gameport/Config.in
source drivers/input/serio/Config.in

comment 'Input Device Drivers'
if [ "$CONFIG_INPUT" != "n" ]; then
   source drivers/input/keyboard/Config.in
   source drivers/input/mouse/Config.in
   source drivers/input/joystick/Config.in
   source drivers/input/touchscreen/Config.in
   source drivers/input/misc/Config.in
fi

endmenu
```

## drivers/input/Kconfig
```kconfig
#
# Input device configuration
#

menu "Input device support"

config INPUT
	tristate "Input devices (needed for keyboard, mouse, ...)"
	default y
	---help---
	  Say Y here if you have any input device (mouse, keyboard, tablet,
	  joystick, steering wheel ...) connected to your system and want
	  it to be available to applications. This includes standard PS/2
	  keyboard and mouse.

	  Say N here if you have a headless (no monitor, no keyboard) system.

	  More information is available: <file:Documentation/input/input.txt>

	  If unsure, say Y.

	  This driver is also available as a module ( = code which can be
	  inserted in and removed from the running kernel whenever you want).
	  The module will be called input. If you want to compile it as a
	  module, say M here and read <file:Documentation/modules.txt>.

comment "Userland interfaces"

config INPUT_MOUSEDEV
	tristate "Mouse interface"
	default y
	depends on INPUT
	---help---
	  Say Y here if you want your mouse to be accessible as char devices
	  13:32+ - /dev/input/mouseX and 13:63 - /dev/input/mice as an
	  emulated IntelliMouse Explorer PS/2 mouse. That way, all user space
	  programs (includung SVGAlib, GPM and X) will be able to use your
	  mouse.

	  If unsure, say Y.

	  This driver is also available as a module ( = code which can be
	  inserted in and removed from the running kernel whenever you want).
	  The module will be called mousedev. If you want to compile it as
	  a module, say M here and read <file:Documentation/modules.txt>.

config INPUT_MOUSEDEV_PSAUX
	bool "Provide legacy /dev/psaux device"
	default y
	depends on INPUT_MOUSEDEV

config INPUT_MOUSEDEV_SCREEN_X
	int "Horizontal screen resolution"
	depends on INPUT_MOUSEDEV
	default "1024"
	help
	  If you're using a digitizer, or a graphic tablet, and want to use
	  it as a mouse then the mousedev driver needs to know the X window
	  screen resolution you are using to correctly scale the data. If
	  you're not using a digitizer, this value is ignored.

config INPUT_MOUSEDEV_SCREEN_Y
	int "Vertical screen resolution"
	depends on INPUT_MOUSEDEV
	default "768"
	help
	  If you're using a digitizer, or a graphic tablet, and want to use
	  it as a mouse then the mousedev driver needs to know the X window
	  screen resolution you are using to correctly scale the data. If
	  you're not using a digitizer, this value is ignored.

config INPUT_JOYDEV
	tristate "Joystick interface"
	depends on INPUT
	---help---
	  Say Y here if you want your joystick or gamepad to be
	  accessible as char device 13:0+ - /dev/input/jsX device.

	  If unsure, say Y.

	  More information is available: <file:Documentation/input/joystick.txt>

	  This driver is also available as a module ( = code which can be
	  inserted in and removed from the running kernel whenever you want).
	  The module will be called joydev. If you want to compile it as a
	  module, say M here and read <file:Documentation/modules.txt>.

config INPUT_TSDEV
	tristate "Touchscreen interface"
	depends on INPUT
	---help---
	  Say Y here if you have an application that only can understand the
	  Compaq touchscreen protocol for absolute pointer data. This is
	  useful namely for embedded configurations.

	  If unsure, say N.

	  This driver is also available as a module ( = code which can be
	  inserted in and removed from the running kernel whenever you want).
	  The module will be called tsdev. If you want to compile it as a
	  module, say M here and read <file:Documentation/modules.txt>.

config INPUT_TSDEV_SCREEN_X
	int "Horizontal screen resolution"
	depends on INPUT_TSDEV
	default "240"

config INPUT_TSDEV_SCREEN_Y
	int "Vertical screen resolution"
	depends on INPUT_TSDEV
	default "320"

config INPUT_EVDEV
	tristate "Event interface"
	depends on INPUT
	help
	  Say Y here if you want your input device events be accessible
	  under char device 13:64+ - /dev/input/eventX in a generic way.

	  This driver is also available as a module ( = code which can be
	  inserted in and removed from the running kernel whenever you want).
	  The module will be called evdev. If you want to compile it as a
	  module, say M here and read <file:Documentation/modules.txt>.

config INPUT_EVBUG
	tristate "Event debugging"
	depends on INPUT
	---help---
	  Say Y here if you have a problem with the input subsystem and
	  want all events (keypresses, mouse movements), to be output to
	  the system log. While this is useful for debugging, it's also
	  a security threat - your keypresses include your passwords, of
	  course.

	  If unsure, say N.

	  This driver is also available as a module ( = code which can be
	  inserted in and removed from the running kernel whenever you want).
	  The module will be called joydev. If you want to compile it as a
	  module, say M here and read <file:Documentation/modules.txt>.

comment "Input I/O drivers"

source "drivers/input/gameport/Kconfig"

source "drivers/input/serio/Kconfig"

comment "Input Device Drivers"

source "drivers/input/keyboard/Kconfig"

source "drivers/input/mouse/Kconfig"

source "drivers/input/joystick/Kconfig"

source "drivers/input/touchscreen/Kconfig"

source "drivers/input/misc/Kconfig"

endmenu
```

## drivers/input/gameport/Kconfig
```kconfig
#
# Gameport configuration
#
config GAMEPORT
	tristate "Gameport support"
	---help---
	  Gameport support is for the standard 15-pin PC gameport. If you
	  have a joystick, gamepad, gameport card, a soundcard with a gameport
	  or anything else that uses the gameport, say Y or M here and also to
	  at least one of the hardware specific drivers.

	  For Ensoniq AudioPCI (ES1370), AudioPCI 97 (ES1371), ESS Solo1,
	  S3 SonicVibes, Trident 4DWave, SiS7018, and ALi 5451 gameport
	  support is provided by the sound drivers, so you won't need any
	  from the below listed modules. You still need to say Y here.

	  If unsure, say Y.

	  This driver is also available as a module ( = code which can be
	  inserted in and removed from the running kernel whenever you want).
	  The module will be called gameport. If you want to compile it as
	  a module, say M here and read <file:Documentation/modules.txt>.

config SOUND_GAMEPORT
	tristate
	default y if GAMEPORT!=m
	default m if GAMEPORT=m

config GAMEPORT_NS558
	tristate "Classic ISA and PnP gameport support"
	depends on GAMEPORT
	help
	  Say Y here if you have an ISA or PnP gameport.

	  If unsure, say Y.

	  This driver is also available as a module ( = code which can be
	  inserted in and removed from the running kernel whenever you want).
	  The module will be called ns558. If you want to compile it as a
	  module, say M here and read <file:Documentation/modules.txt>.

config GAMEPORT_L4
	tristate "PDPI Lightning 4 gamecard support"
	depends on GAMEPORT
	help
	  Say Y here if you have a PDPI Lightning 4 gamecard.

	  This driver is also available as a module ( = code which can be
	  inserted in and removed from the running kernel whenever you want).
	  The module will be called lightning. If you want to compile it as
	  a module, say M here and read <file:Documentation/modules.txt>.

config GAMEPORT_EMU10K1
	tristate "SB Live and Audigy gameport support"
	depends on GAMEPORT
	help
	  Say Y here if you have a SoundBlaster Live! or SoundBlaster
	  Audigy card and want to use its gameport.

	  This driver is also available as a module ( = code which can be
	  inserted in and removed from the running kernel whenever you want).
	  The module will be called emu10k1-gp. If you want to compile it as
	  a module, say M here and read <file:Documentation/modules.txt>.

config GAMEPORT_VORTEX
	tristate "Aureal Vortex, Vortex 2 gameport support"
	depends on GAMEPORT
	help
	  Say Y here if you have an Aureal Vortex 1 or 2  card and want
	  to use its gameport.

	  This driver is also available as a module ( = code which can be
	  inserted in and removed from the running kernel whenever you want).
	  The module will be called vortex. If you want to compile it as a
	  module, say M here and read <file:Documentation/modules.txt>.

config GAMEPORT_FM801
	tristate "ForteMedia FM801 gameport support"
	depends on GAMEPORT

config GAMEPORT_CS461x
	tristate "Crystal SoundFusion gameport support"
	depends on GAMEPORT
```

## drivers/input/joystick/Config.in
```kconfig
#
# Joystick driver configuration
#

bool 'Joysticks' CONFIG_INPUT_JOYSTICK

dep_tristate '  Classic PC analog joysticks and gamepads' CONFIG_JOYSTICK_ANALOG $CONFIG_INPUT $CONFIG_INPUT_JOYSTICK $CONFIG_GAMEPORT
dep_tristate '  Assasin 3D and MadCatz Panther devices' CONFIG_JOYSTICK_A3D $CONFIG_INPUT $CONFIG_INPUT_JOYSTICK $CONFIG_GAMEPORT
dep_tristate '  Logitech ADI digital joysticks and gamepads' CONFIG_JOYSTICK_ADI $CONFIG_INPUT $CONFIG_INPUT_JOYSTICK $CONFIG_GAMEPORT
dep_tristate '  Creative Labs Blaster Cobra gamepad' CONFIG_JOYSTICK_COBRA $CONFIG_INPUT $CONFIG_INPUT_JOYSTICK $CONFIG_GAMEPORT
dep_tristate '  Genius Flight2000 Digital joysticks and gamepads' CONFIG_JOYSTICK_GF2K $CONFIG_INPUT $CONFIG_INPUT_JOYSTICK $CONFIG_GAMEPORT
dep_tristate '  Gravis GrIP joysticks and gamepads' CONFIG_JOYSTICK_GRIP $CONFIG_INPUT $CONFIG_INPUT_JOYSTICK $CONFIG_GAMEPORT
dep_tristate '  Gravis GrIP MultiPort' CONFIG_JOYSTICK_GRIP_MP $CONFIG_INPUT $CONFIG_INPUT_JOYSTICK $CONFIG_GAMEPORT
dep_tristate '  Guillemot joysticks and gamepads' CONFIG_JOYSTICK_GUILLEMOT $CONFIG_INPUT $CONFIG_INPUT_JOYSTICK $CONFIG_GAMEPORT
dep_tristate '  InterAct digital joysticks and gamepads' CONFIG_JOYSTICK_INTERACT $CONFIG_INPUT $CONFIG_INPUT_JOYSTICK $CONFIG_GAMEPORT
dep_tristate '  Microsoft SideWinder digital joysticks and gamepads' CONFIG_JOYSTICK_SIDEWINDER $CONFIG_INPUT $CONFIG_INPUT_JOYSTICK $CONFIG_GAMEPORT
dep_tristate '  ThrustMaster DirectConnect joysticks and gamepads' CONFIG_JOYSTICK_TMDC $CONFIG_INPUT $CONFIG_INPUT_JOYSTICK $CONFIG_GAMEPORT
source drivers/input/joystick/iforce/Config.in
dep_tristate '  Logitech WingMan Warrior joystick' CONFIG_JOYSTICK_WARRIOR $CONFIG_INPUT $CONFIG_INPUT_JOYSTICK $CONFIG_SERIO
dep_tristate '  LogiCad3d Magellan/SpaceMouse 6dof controllers' CONFIG_JOYSTICK_MAGELLAN $CONFIG_INPUT $CONFIG_INPUT_JOYSTICK $CONFIG_SERIO
dep_tristate '  SpaceTec SpaceOrb/Avenger 6dof controllers' CONFIG_JOYSTICK_SPACEORB $CONFIG_INPUT $CONFIG_INPUT_JOYSTICK $CONFIG_SERIO
dep_tristate '  SpaceTec SpaceBall 6dof controllers' CONFIG_JOYSTICK_SPACEBALL $CONFIG_INPUT $CONFIG_INPUT_JOYSTICK $CONFIG_SERIO
dep_tristate '  Gravis Stinger gamepad' CONFIG_JOYSTICK_STINGER $CONFIG_INPUT $CONFIG_INPUT_JOYSTICK $CONFIG_SERIO
dep_tristate '  Twiddler as a joystick' CONFIG_JOYSTICK_TWIDDLER $CONFIG_INPUT $CONFIG_INPUT_JOYSTICK $CONFIG_SERIO

dep_tristate '  Multisystem, Sega Genesis, Saturn joysticks and gamepads' CONFIG_JOYSTICK_DB9 $CONFIG_INPUT $CONFIG_INPUT_JOYSTICK $CONFIG_PARPORT
dep_tristate '  Multisystem, NES, SNES, N64, PSX joysticks and gamepads' CONFIG_JOYSTICK_GAMECON $CONFIG_INPUT $CONFIG_INPUT_JOYSTICK $CONFIG_PARPORT
dep_tristate '  Multisystem joysticks via TurboGraFX device' CONFIG_JOYSTICK_TURBOGRAFX $CONFIG_INPUT $CONFIG_INPUT_JOYSTICK $CONFIG_PARPORT

if [ "$CONFIG_AMIGA" = "y" ]; then
   dep_tristate '  Amiga joysticks' CONFIG_JOYSTICK_AMIGA $CONFIG_INPUT $CONFIG_INPUT_JOYSTICK
fi

dep_tristate '  Gameport data dumper' CONFIG_INPUT_JOYDUMP $CONFIG_INPUT $CONFIG_INPUT_JOYSTICK
```
