## drivers/gpu/drm/amd/display/Kconfig
```kconfig
menu "Display Engine Configuration"
	depends on DRM && DRM_AMDGPU

config DRM_AMD_DC
        bool "AMD DC - Enable new display engine (will be deprecated when the development is done)"
        help
          Choose this option if you want to use the new display engine
          support for AMDGPU.

          Will be deprecated when the DC component is upstream.

config DEBUG_KERNEL_DC
        bool "Enable kgdb break in DC"
        depends on DRM_AMD_DC
        help
         Choose this option
         if you want to hit
         kdgb_break in assert.

endmenu
```

## drivers/hotplug/Kconfig
```kconfig
#
# PCI Hotplug support
#

menu "PCI Hotplug Support"
	depends on HOTPLUG

config HOTPLUG_PCI
	tristate "Support for PCI Hotplug (EXPERIMENTAL)"
	depends on PCI && EXPERIMENTAL
	---help---
	  Say Y here if you have a motherboard with a PCI Hotplug controller.
	  This allows you to add and remove PCI cards while the machine is
	  powered up and running.  The file system pcihpfs must be mounted
	  in order to interact with any PCI Hotplug controllers.

	  This code is also available as a module ( = code which can be
	  inserted in and removed from the running kernel whenever you want).
	  The module will be called pci_hotplug.o. If you want to compile it
	  as a module, say M here and read <file:Documentation/modules.txt>.

	  When in doubt, say N.

config HOTPLUG_PCI_COMPAQ
	tristate "Compaq PCI Hotplug driver"
	depends on HOTPLUG_PCI && X86
	help
	  Say Y here if you have a motherboard with a Compaq PCI Hotplug
	  controller.

	  This code is also available as a module ( = code which can be
	  inserted in and removed from the running kernel whenever you want).
	  The module will be called cpqphp.o. If you want to compile it
	  as a module, say M here and read <file:Documentation/modules.txt>.

	  When in doubt, say N.

config HOTPLUG_PCI_COMPAQ_NVRAM
	bool "Save configuration into NVRAM on Compaq servers"
	depends on HOTPLUG_PCI_COMPAQ
	help
	  Say Y here if you have a Compaq server that has a PCI Hotplug
	  controller.  This will allow the PCI Hotplug driver to store the PCI
	  system configuration options in NVRAM.

	  When in doubt, say N.

config HOTPLUG_PCI_IBM
	tristate "IBM PCI Hotplug driver"
	depends on HOTPLUG_PCI && X86_IO_APIC && X86
	help
	  Say Y here if you have a motherboard with a IBM PCI Hotplug
	  controller.

	  This code is also available as a module ( = code which can be
	  inserted in and removed from the running kernel whenever you want).
	  The module will be called cpqphp.o. If you want to compile it
	  as a module, say M here and read <file:Documentation/modules.txt>.

	  When in doubt, say N.

endmenu
```

## drivers/i2c/Kconfig
```kconfig
#
# Character device configuration
#

menu "I2C support"

config I2C
	tristate "I2C support"
	---help---
	  I2C (pronounce: I-square-C) is a slow serial bus protocol used in
	  many micro controller applications and developed by Philips.  SMBus,
	  or System Management Bus is a subset of the I2C protocol.  More
	  information is contained in the directory <file:Documentation/i2c/>,
	  especially in the file called "summary" there.

	  Both I2C and SMBus are supported here. You will need this for
	  hardware sensors support, and also for Video For Linux support.
	  Specifically, if you want to use a BT848 based frame grabber/overlay
	  boards under Linux, say Y here and also to "I2C bit-banging
	  interfaces", below.

	  If you want I2C support, you should say Y here and also to the
	  specific driver for your bus adapter(s) below.

	  This I2C support can also be built as a module.  If so, the module
	  will be called i2c-core.

config I2C_CHARDEV
	tristate "I2C device interface"
	depends on I2C
	help
	  Say Y here to use i2c-* device files, usually found in the /dev
	  directory on your system.  They make it possible to have user-space
	  programs use the I2C bus.  Information on how to do this is
	  contained in the file <file:Documentation/i2c/dev-interface>.

	  This support is also available as a module.  If so, the module 
	  will be called i2c-dev.

	source drivers/i2c/algos/Kconfig
	source drivers/i2c/busses/Kconfig
	source drivers/i2c/chips/Kconfig

endmenu
```

## drivers/i2c/algos/Kconfig
```kconfig
#
# Character device configuration
#

menu "I2C Algorithms"
	depends on I2C

config I2C_ALGOBIT
	tristate "I2C bit-banging interfaces"
	depends on I2C
	help
	  This allows you to use a range of I2C adapters called bit-banging
	  adapters.  Say Y if you own an I2C adapter belonging to this class
	  and then say Y to the specific driver for you adapter below.

	  This support is also available as a module.  If so, the module 
	  will be called i2c-algo-bit.

config I2C_ALGOPCF
	tristate "I2C PCF 8584 interfaces"
	depends on I2C
	help
	  This allows you to use a range of I2C adapters called PCF adapters.
	  Say Y if you own an I2C adapter belonging to this class and then say
	  Y to the specific driver for you adapter below.

	  This support is also available as a module.  If so, the module 
	  will be called i2c-algo-pcf.

config I2C_ALGOITE
	tristate "ITE I2C Algorithm"
	depends on MIPS_ITE8172 && I2C
	help
	  This supports the use of the ITE8172 I2C interface found on some MIPS
	  systems. Say Y if you have one of these. You should also say Y for
	  the ITE I2C peripheral driver support below.

	  This support is also available as a module.  If so, the module 
	  will be called i2c-algo-ite.

config I2C_ALGO8XX
	tristate "MPC8xx CPM I2C interface"
	depends on 8xx && I2C

endmenu
```

## drivers/i2c/busses/Kconfig
```kconfig
#
# Sensor device configuration
#

menu "I2C Hardware Sensors Mainboard support"

config I2C_ALI1535
	tristate "ALI 1535"
	depends on I2C && PCI && EXPERIMENTAL
	help
	  If you say yes to this option, support will be included for the SMB
	  Host controller on Acer Labs Inc. (ALI) M1535 South Bridges.  The SMB
	  controller is part of the 7101 device, which is an ACPI-compliant
	  Power Management Unit (PMU).

	  This driver can also be built as a module.  If so, the module
	  will be called i2c-ali1535.

config I2C_ALI15X3
	tristate "ALI 15x3"
	depends on I2C && PCI && EXPERIMENTAL
	help
	  If you say yes to this option, support will be included for the
	  Acer Labs Inc. (ALI) M1514 and M1543 motherboard I2C interfaces.

	  This driver can also be built as a module.  If so, the module
	  will be called i2c-ali15x3.

config I2C_AMD756
	tristate "AMD 756/766"
	depends on I2C && EXPERIMENTAL
	help
	  If you say yes to this option, support will be included for the AMD
	  756/766/768 mainboard I2C interfaces.

	  This driver can also be built as a module.  If so, the module
	  will be called i2c-amd756.

config I2C_AMD8111
	tristate "AMD 8111"
	depends on I2C && EXPERIMENTAL
	help
	  If you say yes to this option, support will be included for the AMD
	  8111 mainboard I2C interfaces.

	  This driver can also be built as a module.  If so, the module
	  will be called i2c-amd8111.

config I2C_I801
	tristate "Intel 801"
	depends on I2C && PCI && EXPERIMENTAL
	help
	  If you say yes to this option, support will be included for the Intel
	  801 family of mainboard I2C interfaces.  Specifically, the following
	  versions of the chipset is supported:
	    82801AA
	    82801AB
	    82801BA
	    82801CA/CAM
	    82801DB

	  This driver can also be built as a module.  If so, the module
	  will be called i2c-i801.

config I2C_I810
	tristate "Intel 810/815"
	depends on I2C && PCI && EXPERIMENTAL
	help
	  If you say yes to this option, support will be included for the Intel
	  810/815 family of mainboard I2C interfaces.  Specifically, the 
	  following versions of the chipset is supported:
	    i810AA
	    i810AB
	    i810E
	    i815

	  This driver can also be built as a module.  If so, the module
	  will be called i2c-i810.

config I2C_ISA
	tristate "ISA Bus support"
	depends on I2C && ISA && EXPERIMENTAL
	help
	  If you say yes to this option, support will be included for i2c
	  interfaces that are on the ISA bus.

	  This driver can also be built as a module.  If so, the module
	  will be called i2c-isa.

config I2C_NFORCE2
	tristate "Nvidia Nforce2"
	depends on I2C && PCI && EXPERIMENTAL
	help
	  If you say yes to this option, support will be included for the Nvidia
	  Nforce2 family of mainboard I2C interfaces.

	  This driver can also be built as a module.  If so, the module
	  will be called i2c-nforce2.

config I2C_PIIX4
	tristate "Intel PIIX4"
	depends on I2C && PCI && EXPERIMENTAL
	help
	  If you say yes to this option, support will be included for the Intel
	  PIIX4 family of mainboard I2C interfaces.  Specifically, the following
	  versions of the chipset is supported:
	    Intel PIIX4
	    Intel 440MX
	    Serverworks OSB4
	    Serverworks CSB5
	    SMSC Victory66

	  This driver can also be built as a module.  If so, the module
	  will be called i2c-piix4.

config I2C_SAVAGE4
	tristate "S3 Savage 4"
	depends on I2C && PCI && EXPERIMENTAL
	help
	  If you say yes to this option, support will be included for the 
	  S3 Savage 4 I2C interface.

	  This driver can also be built as a module.  If so, the module
	  will be called i2c-savage4.

config I2C_SIS5595
	tristate "SiS 5595"
	depends on I2C && PCI && EXPERIMENTAL
	help
	  If you say yes to this option, support will be included for the 
	  SiS5595 SMBus (a subset of I2C) interface.

	  This driver can also be built as a module.  If so, the module
	  will be called i2c-sis5595.

config I2C_SIS630
	tristate "SiS 630"
	depends on I2C && PCI && EXPERIMENTAL
	help
	  If you say yes to this option, support will be included for the 
	  SiS630 SMBus (a subset of I2C) interface.

	  This driver can also be built as a module.  If so, the module
	  will be called i2c-sis630.

config I2C_SIS96X
	tristate "SiS 96x"
	depends on I2C && PCI && EXPERIMENTAL
	help
	  If you say yes to this option, support will be included for the SiS
	  96x SMBus (a subset of I2C) interfaces.  Specifically, the following
	  chipsets are supported:
	    645/961
	    645DX/961
	    645DX/962
	    648/961
	    650/961
	    735

	  This driver can also be built as a module.  If so, the module
	  will be called i2c-sis96x.

config I2C_VIA
	tristate "VIA 82C58B"
	depends on I2C && PCI && EXPERIMENTAL
	help

	  If you say yes to this option, support will be included for the VIA
          82C586B I2C interface

	  This driver can also be built as a module.  If so, the module
	  will be called i2c-via.

config I2C_VIAPRO
	tristate "VIA 82C596/82C686/823x"
	depends on I2C && PCI && EXPERIMENTAL
	help

	  If you say yes to this option, support will be included for the VIA
	  82C596/82C686/823x I2C interfaces.  Specifically, the following 
	  chipsets are supported:
	  82C596A/B
	  82C686A/B
	  8231
	  8233
	  8233A
	  8235

	  This driver can also be built as a module.  If so, the module
	  will be called i2c-viapro.

config I2C_VOODOO3
	tristate "Voodoo 3"
	depends on I2C && PCI && EXPERIMENTAL
	help

	  If you say yes to this option, support will be included for the
	  Voodoo 3 I2C interface.

	  This driver can also be built as a module.  If so, the module
	  will be called i2c-voodoo3.

endmenu
```
