## arch/ppc/8xx_io/Kconfig
```kconfig
#
# MPC8xx Communication options
#

menu "MPC8xx CPM Options"
	depends on 8xx

config SCC_ENET
	bool "CPM SCC Ethernet"
	depends on NET_ETHERNET
	help
	  Enable Ethernet support via the Motorola MPC8xx serial
	  commmunications controller.

choice
	prompt "SCC used for Ethernet"
	depends on SCC_ENET
	default SCC1_ENET

config SCC1_ENET
	bool "SCC1"
	help
	  Use MPC8xx serial communications controller 1 to drive Ethernet
	  (default).

config SCC2_ENET
	bool "SCC2"
	help
	  Use MPC8xx serial communications controller 2 to drive Ethernet.

config SCC3_ENET
	bool "SCC3"
	help
	  Use MPC8xx serial communications controller 3 to drive Ethernet.

endchoice

config FEC_ENET
	bool "860T FEC Ethernet"
	depends on NET_ETHERNET
	help
	  Enable Ethernet support via the Fast Ethernet Controller (FCC) on
	  the Motorola MPC8260.

config USE_MDIO
	bool "Use MDIO for PHY configuration"
	depends on FEC_ENET
	help
	  On some boards the hardware configuration of the ethernet PHY can be
	  used without any software interaction over the MDIO interface, so
	  all MII code can be omitted. Say N here if unsure or if you don't
	  need link status reports.

config  FEC_AM79C874
	bool "Support AMD79C874 PHY"
	depends on USE_MDIO

config FEC_LXT970
	bool "Support LXT970 PHY"
	depends on USE_MDIO

config FEC_LXT971
	bool "Support LXT971 PHY"
	depends on USE_MDIO
	
config FEC_QS6612
	bool "Support QS6612 PHY"
	depends on USE_MDIO
	
config ENET_BIG_BUFFERS
	bool "Use Big CPM Ethernet Buffers"
	depends on NET_ETHERNET
	help
	  Allocate large buffers for MPC8xx Etherenet.  Increases throughput
	  and decreases the likelihood of dropped packets, but costs memory.

config SMC2_UART
	bool "Use SMC2 for UART"
	help
	  If you would like to use SMC2 as a serial port, say Y here.

	  If in doubt, say Y here.

config ALTSMC2
	bool "Use Alternate SMC2 I/O (823/850)"
	depends on SMC2_UART
	help
	  If you have an MPC823 or MPC850 and would like to use the alternate
	  SMC2 for I/O, say Y here.

	  If in doubt, say N here.

config CONS_SMC2
	bool "Use SMC2 for Console"
	depends on SMC2_UART
	help
	  If you are going to have a serial console on your device and are
	  using SMC2 for your serial port, say Y here, else say N.

config USE_SCC_IO
	bool "Enable SCC2 and SCC3 for UART"
	help
	  If your MPC8xx board has other SCC ports that you would like to use
	  for for a serial port, say Y here.

	  If in doubt, say N here.

config HTDMSOUND
	bool "Embedded Planet HIOX Audio"
	depends on SOUND=y

# This doesn't really belong here, but it is convenient to ask
# 8xx specific questions.
comment "Generic MPC8xx Options"

config 8xx_COPYBACK
	bool "Copy-Back Data Cache (else Writethrough)"
	help
	  Saying Y here will cause the cache on an MPC8xx processor to be used
	  in Copy-Back mode.  If you say N here, it is used in Writethrough
	  mode.

	  If in doubt, say Y here.

config 8xx_CPU6
	bool "CPU6 Silicon Errata (860 Pre Rev. C)"
	help
	  MPC860 CPUs, prior to Rev C have some bugs in the silicon, which
	  require workarounds for Linux (and most other OSes to work).  If you
	  get a BUG() very early in boot, this might fix the problem.  For
	  more details read the document entitled "MPC860 Family Device Errata
	  Reference" on Motorola's website.  This option also incurs a
	  performance hit.

	  If in doubt, say N here.

config UCODE_PATCH
	bool "I2C/SPI Microcode Patch"
	help
	  Motorola releases microcode updates for their 8xx CPM modules.  The
	  microcode update file has updates for IIC, SMC and USB.  Currently only
	  the USB update is available by default, if the MPC8xx USB option is
	  enabled.  If in doubt, say 'N' here.

endmenu
```
