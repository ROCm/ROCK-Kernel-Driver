## arch/mips/perfmon/Kconfig
```kconfig
menu "Hardware Performance Monitoring support"
config PERFMON
	bool "Perfmon2 performance monitoring interface"
	default n
	help
	Enables the perfmon2 interface to access the hardware
	performance counters. See <http://perfmon2.sf.net/> for
	more details.

config PERFMON_DEBUG
	bool "Perfmon debugging"
	default n
	depends on PERFMON
	help
	Enables perfmon debugging support

config PERFMON_DEBUG_FS
	bool "Enable perfmon statistics reporting via debugfs"
	default y
	depends on PERFMON && DEBUG_FS
	help
	Enable collection and reporting of perfmon timing statistics under
	debugfs. This is used for debugging and performance analysis of the
	subsystem. The debugfs filesystem must be mounted.

config PERFMON_FLUSH
	bool "Flush sampling buffer when modified"
	depends on PERFMON
	default n
	help
	On some MIPS models, cache aliasing may cause invalid
	data to be read from the perfmon sampling buffer. Use this option
	to flush the buffer when it is modified to ensure valid data is
	visible at the user level.

config PERFMON_ALIGN
	bool "Align sampling buffer to avoid cache aliasing"
	depends on PERFMON
	default n
	help
	On some MIPS models, cache aliasing may cause invalid
	data to be read from the perfmon sampling buffer. By forcing a bigger
	page alignment (4-page), one can guarantee the buffer virtual address
	will conflict in the cache with the user level mapping of the buffer
	thereby ensuring a consistent view by user programs.

config PERFMON_DEBUG
	bool "Perfmon debugging"
	depends on PERFMON
	default n
	depends on PERFMON
	help
	Enables perfmon debugging support

config PERFMON_MIPS64
	tristate "Support for MIPS64 hardware performance counters"
	depends on PERFMON
	default n
	help
	Enables support for the MIPS64 hardware performance counters"
endmenu
```

## arch/mips64/Kconfig
```kconfig
#
# For a description of the syntax of this configuration file,
# see Documentation/kbuild/kconfig-language.txt.
#
config MIPS
	bool
	default y

config MIPS32
	bool
	default n

config MIPS64
	bool
	default y

source "arch/mips/Kconfig-shared"
```

## arch/mips64/config.in
```kconfig
# $Id: config.in,v 1.19 2000/03/27 01:44:45 ralf Exp $
#
# For a description of the syntax of this configuration file,
# see Documentation/kbuild/config-language.txt.
#
mainmenu_name "Linux Kernel Configuration"

mainmenu_option next_comment
comment 'Code maturity level options'
bool 'Prompt for development and/or incomplete code/drivers' CONFIG_EXPERIMENTAL
endmenu

mainmenu_option next_comment
comment 'Machine selection'
bool 'Support for SGI IP22' CONFIG_SGI_IP22
bool 'Support for SGI IP27' CONFIG_SGI_IP27
if [ "$CONFIG_SGI_IP27" = "y" ]; then
   bool '  IP27 N-Mode' CONFIG_SGI_SN0_N_MODE
   bool '  Discontiguous Memory Support' CONFIG_DISCONTIGMEM
   bool '  NUMA support' CONFIG_NUMA
   bool '  Mapped kernel support' CONFIG_MAPPED_KERNEL
   bool '  Kernel text replication support' CONFIG_REPLICATE_KTEXT
   bool '  Exception handler replication support' CONFIG_REPLICATE_EXHANDLERS
   bool '  Multi-Processing support' CONFIG_SMP
   #bool '  IP27 XXL' CONFIG_SGI_SN0_XXL
fi
endmenu

#
# Select some configuration options automatically based on user selections
#
unset CONFIG_ARC32
unset CONFIG_ARC64
unset CONFIG_BINFMT_ELF32
unset CONFIG_BOARD_SCACHE
unset CONFIG_BOOT_ELF32
unset CONFIG_BOOT_ELF64
unset CONFIG_COHERENT_IO
unset CONFIG_ISA
unset CONFIG_PCI

if [ "$CONFIG_SGI_IP22" = "y" ]; then
   define_bool CONFIG_BOOT_ELF32 y
   define_bool CONFIG_ARC32 y
   define_bool CONFIG_BOARD_SCACHE y
   define_bool CONFIG_ARC_MEMORY y
   define_bool CONFIG_SGI y
fi

if [ "$CONFIG_SGI_IP27" = "y" ]; then
   define_bool CONFIG_BOOT_ELF64 y
   define_bool CONFIG_ARC64 y
   define_bool CONFIG_COHERENT_IO y
   define_bool CONFIG_PCI y
   define_bool CONFIG_QL_ISP_A64 y
fi

if [ "$CONFIG_ISA" != "y" ]; then
   define_bool CONFIG_ISA n
   define_bool CONFIG_EISA n
else
   define_bool CONFIG_EISA y
fi

if [ "$CONFIG_PCI" != "y" ]; then
   define_bool CONFIG_PCI n
fi

define_bool CONFIG_MCA n
define_bool CONFIG_SBUS n

mainmenu_option next_comment
comment 'CPU selection'

choice 'CPU type'				\
	"R4300 CONFIG_CPU_R4300			\
	 R4x00 CONFIG_CPU_R4X00			\
	 R5000 CONFIG_CPU_R5000			\
	 R56x0 CONFIG_CPU_NEVADA		\
	 R8000 CONFIG_CPU_R8000			\
	 R10000 CONFIG_CPU_R10000" R4x00
endmenu

mainmenu_option next_comment
comment 'General setup'

if [ "$CONFIG_CPU_R10000" = "y" ]; then
   bool 'Support for large 64-bit configurations' CONFIG_MIPS_INSANE_LARGE
fi
bool 'Generate little endian code' CONFIG_CPU_LITTLE_ENDIAN

bool 'Networking support' CONFIG_NET

source drivers/pci/Config.in

bool 'Support for hot-pluggable devices' CONFIG_HOTPLUG

if [ "$CONFIG_HOTPLUG" = "y" ] ; then
   source drivers/pcmcia/Config.in
else
   define_bool CONFIG_PCMCIA n
fi

bool 'System V IPC' CONFIG_SYSVIPC
bool 'BSD Process Accounting' CONFIG_BSD_PROCESS_ACCT
bool 'Sysctl support' CONFIG_SYSCTL
tristate 'Kernel support for 64-bit ELF binaries' CONFIG_BINFMT_ELF
bool 'Kernel support for Linux/MIPS 32-bit binary compatibility' CONFIG_MIPS32_COMPAT
if [ "$CONFIG_MIPS32_COMPAT" = "y" ]; then
   define_bool CONFIG_BINFMT_ELF32 y
fi
tristate 'Kernel support for MISC binaries' CONFIG_BINFMT_MISC

endmenu

mainmenu_option next_comment
comment 'Loadable module support'
bool 'Enable loadable module support' CONFIG_MODULES
if [ "$CONFIG_MODULES" = "y" ]; then
   bool 'Set version information on all symbols for modules' CONFIG_MODVERSIONS
   bool 'Kernel module loader' CONFIG_KMOD
fi

source drivers/pci/Config.in

if [ "$CONFIG_EXPERIMENTAL" = "y" ]; then
   bool 'Support for frame buffer devices (EXPERIMENTAL)' CONFIG_FB
fi

endmenu

source drivers/mtd/Config.in

source drivers/block/Config.in

source drivers/md/Config.in

if [ "$CONFIG_NET" = "y" ]; then
   source net/Config.in
fi

source drivers/telephony/Config.in

mainmenu_option next_comment
comment 'ATA/IDE/MFM/RLL support'

tristate 'ATA/IDE/MFM/RLL support' CONFIG_IDE

if [ "$CONFIG_IDE" != "n" ]; then
  source drivers/ide/Config.in
else
  define_bool CONFIG_BLK_DEV_IDE_MODES n
  define_bool CONFIG_BLK_DEV_HD n
fi
endmenu

mainmenu_option next_comment
comment 'SCSI support'

tristate 'SCSI support' CONFIG_SCSI

if [ "$CONFIG_SCSI" != "n" ]; then
   source drivers/scsi/Config.in
fi
endmenu

source drivers/i2o/Config.in

if [ "$CONFIG_NET" = "y" ]; then
   mainmenu_option next_comment
   comment 'Network device support'

   bool 'Network device support' CONFIG_NETDEVICES
   if [ "$CONFIG_NETDEVICES" = "y" ]; then
      source drivers/net/Config.in
      if [ "$CONFIG_SGI_IP22" = "y" ]; then
	 bool 'SGI Seeq ethernet controller support' CONFIG_SGISEEQ
      fi
      if [ "$CONFIG_DECSTATION" = "y" ]; then
	 bool 'DEC LANCE ethernet controller support' CONFIG_DECLANCE
      fi
      if [ "$CONFIG_BAGET_MIPS" = "y" ]; then
	 tristate 'Baget AMD LANCE support' CONFIG_BAGETLANCE
	 tristate 'Baget Backplane Shared Memory support' CONFIG_BAGETBSM
      fi
      if [ "$CONFIG_ATM" = "y" ]; then
	 source drivers/atm/Config.in
      fi
   fi
   endmenu
fi

source net/ax25/Config.in

source net/irda/Config.in

mainmenu_option next_comment
comment 'ISDN subsystem'

if [ "$CONFIG_NET" != "n" ]; then
   tristate 'ISDN support' CONFIG_ISDN
   if [ "$CONFIG_ISDN" != "n" ]; then
      source drivers/isdn/Config.in
   fi
fi
endmenu

mainmenu_option next_comment
comment 'Old CD-ROM drivers (not SCSI, not IDE)'

bool 'Support non-SCSI/IDE/ATAPI CDROM drives' CONFIG_CD_NO_IDESCSI
if [ "$CONFIG_CD_NO_IDESCSI" != "n" ]; then
   source drivers/cdrom/Config.in
fi
endmenu

source drivers/char/Config.in

#source drivers/misc/Config.in

source drivers/media/Config.in

source fs/Config.in

if [ "$CONFIG_VT" = "y" ]; then
   mainmenu_option next_comment
   comment 'Console drivers'
   if [ "$CONFIG_SGI_IP22" = "y" ]; then
      tristate 'SGI Newport Console support' CONFIG_SGI_NEWPORT_CONSOLE
      if [ "$CONFIG_SGI_NEWPORT_CONSOLE" != "y" ]; then
	 define_bool CONFIG_DUMMY_CONSOLE y
      else
	 define_bool CONFIG_FONT_8x16 y
      fi
   fi
  endmenu
fi

if [ "$CONFIG_PROC_FS" = "y" ]; then
   define_bool CONFIG_KCORE_ELF y
fi

mainmenu_option next_comment
comment 'Sound'

tristate 'Sound card support' CONFIG_SOUND
if [ "$CONFIG_SOUND" != "n" ]; then
   source drivers/sound/Config.in
fi
endmenu

if [ "$CONFIG_SGI_IP22" = "y" ]; then
   source drivers/sgi/Config.in
fi

source drivers/usb/Config.in
source drivers/input/Config.in

mainmenu_option next_comment
comment 'Kernel hacking'

#bool 'Debug kmalloc/kfree' CONFIG_DEBUG_MALLOC
bool 'Are you using a crosscompiler' CONFIG_CROSSCOMPILE
if [ "$CONFIG_MODULES" = "y" ]; then
   bool ' Build fp execption handler module' CONFIG_MIPS_FPE_MODULE
fi
bool 'Remote GDB kernel debugging' CONFIG_REMOTE_DEBUG
bool 'Magic SysRq key' CONFIG_MAGIC_SYSRQ
endmenu
```

## arch/parisc/Kconfig
```kconfig
#
# For a description of the syntax of this configuration file,
# see Documentation/kbuild/kconfig-language.txt.
#

mainmenu "Linux/PA-RISC Kernel Configuration"

config PARISC
	bool
	default y
	help
	  The PA-RISC microprocessor is designed by Hewlett-Packard and used
	  in many of their workstations & servers (HP9000 700 and 800 series,
	  and later HP3000 series).  The PA-RISC Linux project home page is
	  at <http://www.parisc-linux.org/>.

config MMU
	bool
	default y

config STACK_GROWSUP
	bool
	default y

config UID16
	bool

config RWSEM_GENERIC_SPINLOCK
	bool
	default y

config RWSEM_XCHGADD_ALGORITHM
	bool

config GENERIC_ISA_DMA
	bool

# unless you want to implement ACPI on PA-RISC ... ;-)
config PM
	bool

source "init/Kconfig"


menu "Processor type and features"

choice
	prompt "Processor type"
	default PA7000

config PA7000
	bool "PA7000/PA7100"
	---help---
	  This is the processor type of your CPU. This information is used for
	  optimizing purposes.  In order to compile a kernel that can run on
	  all PA CPUs (albeit not optimally fast), you can specify "PA7000"
	  here.

	  Specifying "PA8000" here will allow you to select a 64-bit kernel
	  which is required on some machines.

config PA7100LC
	bool "PA7100LC/PA7300LC"
	help
	  Select this option for a 7100LC or 7300LC processor, as used
	  in the 712, 715/Mirage, A180, B132, C160L and some other machines.

config PA7200
	bool "PA7200"
	help
	  Select this option for the PCX-T' processor, as used in C110, D100
	  and similar machines.

config PA8X00
	bool "PA8000 and up"
	help
	  Select this option for PCX-U to PCX-W2 processors.

endchoice

# Define implied options from the CPU selection here

config PA20
	bool
	depends on PA8X00
	default y

config PA11
	bool
	depends on PA7000 || PA7100LC || PA7200
	default y

config PARISC64
	bool "64-bit kernel"
	depends on PA8X00
	help
	  Enable this if you want to support 64bit kernel on PA-RISC platform.
	  
	  At the moment, only people willing to use more than 2GB of RAM,
	  or having a 64bit-only capable PA-RISC machine should say Y here.

	  Since there is no 64bit userland on PA-RISC, there is no point to
	  enable this option otherwise. The 64bit kernel is significantly bigger
	  and slower than the 32bit one.

config 64BIT
	def_bool PARISC64

config PDC_NARROW
	bool "32-bit firmware"
	depends on PARISC64
	help
	  This option will enable owners of C160, C180, C200, C240, C360, J280,
	  J282, J2240 and some D/K/R class to run a 64bit kernel with their
	  32bit PDC firmware.
	
	  Nobody should try this option unless they know what they are doing.
	
	  If unsure, say N.

config SMP
	bool "Symmetric multi-processing support"
	---help---
	  This enables support for systems with more than one CPU. If you have
	  a system with only one CPU, like most personal computers, say N. If
	  you have a system with more than one CPU, say Y.

	  If you say N here, the kernel will run on single and multiprocessor
	  machines, but will use only one CPU of a multiprocessor machine. If
	  you say Y here, the kernel will run on many, but not all,
	  singleprocessor machines. On a singleprocessor machine, the kernel
	  will run faster if you say N here.

	  See also the <file:Documentation/smp.tex>,
	  <file:Documentation/smp.txt>, <file:Documentation/nmi_watchdog.txt>
	  and the SMP-HOWTO available at
	  <http://www.tldp.org/docs.html#howto>.

	  If you don't know what to do here, say N.

config PREEMPT
	bool
#	bool "Preemptible Kernel"
	default n

config COMPAT
	bool
	depends on PARISC64
	default y

config HPUX
	bool "Support for HP-UX binaries"
	depends on !PARISC64

config NR_CPUS
	int "Maximum number of CPUs (2-32)"
	depends on SMP
	default "32"

endmenu


source "drivers/parisc/Kconfig"


menu "Executable file formats"

source "fs/Kconfig.binfmt"

endmenu

source "drivers/base/Kconfig"

# source "drivers/mtd/Kconfig"

source "drivers/parport/Kconfig"

# source "drivers/pnp/Kconfig"

source "drivers/block/Kconfig"

source "drivers/ide/Kconfig"

source "drivers/scsi/Kconfig"

source "drivers/md/Kconfig"

source drivers/message/fusion/Kconfig

#source drivers/ieee1394/Kconfig

#source drivers/message/i2o/Kconfig

source "net/Kconfig"

#source "drivers/isdn/Kconfig"

#source "drivers/telephony/Kconfig"

# input before char - char/joystick depends on it. As does USB.
source "drivers/input/Kconfig"

source "drivers/char/Kconfig"

#source "drivers/misc/Kconfig"

source "drivers/media/Kconfig"

source "fs/Kconfig"

source "drivers/video/Kconfig"

source "sound/Kconfig"

source "drivers/usb/Kconfig"

source "arch/parisc/oprofile/Kconfig"

menu "Kernel hacking"

config DEBUG_KERNEL
	bool "Kernel debugging"
	help
	  Say Y here if you are developing drivers or trying to debug and
	  identify kernel problems.

config DEBUG_SLAB
	bool "Debug memory allocations"
	depends on DEBUG_KERNEL
	help
	  Say Y here to have the kernel do limited verification on memory
	  allocation as well as poisoning memory on free to catch use of freed
	  memory.

config MAGIC_SYSRQ
	bool "Magic SysRq key"
	depends on DEBUG_KERNEL
	help
	  If you say Y here, you will have some control over the system even
	  if the system crashes for example during kernel debugging (e.g., you
	  will be able to flush the buffer cache to disk, reboot the system
	  immediately or dump some status information). This is accomplished
	  by pressing various keys while holding SysRq (Alt+PrintScreen). It
	  also works on a serial console (on PC hardware at least), if you
	  send a BREAK and then within 5 seconds a command keypress. The
	  keys are documented in <file:Documentation/sysrq.txt>. Don't say Y
	  unless you really know what this hack does.

config FRAME_POINTER
	bool "Compile the kernel with frame pointers"
	help
	  If you say Y here the resulting kernel image will be slightly larger
	  and slower, but it will give very useful debugging information.
	  If you don't debug the kernel, you can say N, but we may not be able
	  to solve problems without frame pointers.

config DEBUG_INFO
	bool "Compile the kernel with debug info"
	depends on DEBUG_KERNEL
	help
          If you say Y here the resulting kernel image will include
	  debugging info resulting in a larger kernel image.
	  Say Y here only if you plan to use gdb to debug the kernel.
	  If you don't debug the kernel, you can say N.
	  
endmenu

source "security/Kconfig"

source "crypto/Kconfig"

source "lib/Kconfig"
```
