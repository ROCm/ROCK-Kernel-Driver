## arch/parisc/Kconfig.orig
```kconfig
#
# For a description of the syntax of this configuration file,
# see Documentation/kbuild/kconfig-language.txt.
#

mainmenu "Linux/PA-RISC Kernel Configuration"

config PARISC
	bool
	default y
	help
	  The PA-RISC microprocessor is designed by Hewlett-Packard and used
	  in many of their workstations & servers (HP9000 700 and 800 series,
	  and later HP3000 series).  The PA-RISC Linux project home page is
	  at <http://www.parisc-linux.org/>.

config MMU
	bool
	default y

config STACK_GROWSUP
	bool
	default y

config UID16
	bool

config RWSEM_GENERIC_SPINLOCK
	bool
	default y

config RWSEM_XCHGADD_ALGORITHM
	bool

config GENERIC_ISA_DMA
	bool

# unless you want to implement ACPI on PA-RISC ... ;-)
config PM
	bool

source "init/Kconfig"


menu "Processor type and features"

choice
	prompt "Processor type"
	default PA7000

config PA7000
	bool "PA7000/PA7100"
	---help---
	  This is the processor type of your CPU.  This information is
	  used for optimizing purposes.  In order to compile a kernel
	  that can run on all 32-bit PA CPUs (albeit not optimally fast),
	  you can specify "PA7000" here.

	  Specifying "PA8000" here will allow you to select a 64-bit kernel
	  which is required on some machines.

config PA7100LC
	bool "PA7100LC"
	help
	  Select this option for the PCX-L processor, as used in the
	  712, 715/64, 715/80, 715/100, 715/100XC, 725/100, 743, 748,
	  D200, D210, D300, D310 and E-class

config PA7200
	bool "PA7200"
	help
	  Select this option for the PCX-T' processor, as used in the
	  C100, C110, J100, J110, J210XC, D250, D260, D350, D360,
	  K100, K200, K210, K220, K400, K410 and K420

config PA7300LC
	bool "PA7300LC"
	help
	  Select this option for the PCX-L2 processor, as used in the
	  744, A180, B132L, B160L, B180L, C132L, C160L, C180L,
	  D220, D230, D320 and D330.

config PA8X00
	bool "PA8000 and up"
	help
	  Select this option for PCX-U to PCX-W2 processors.

endchoice

# Define implied options from the CPU selection here

config PA20
	def_bool y
	depends on PA8X00

config PA11
	def_bool y
	depends on PA7000 || PA7100LC || PA7200 || PA7300LC

config PREFETCH
	def_bool y
	depends on PA8X00

config PARISC64
	bool "64-bit kernel"
	depends on PA8X00
	help
	  Enable this if you want to support 64bit kernel on PA-RISC platform.
	  
	  At the moment, only people willing to use more than 2GB of RAM,
	  or having a 64bit-only capable PA-RISC machine should say Y here.

	  Since there is no 64bit userland on PA-RISC, there is no point to
	  enable this option otherwise. The 64bit kernel is significantly bigger
	  and slower than the 32bit one.

config 64BIT
	def_bool PARISC64

config SMP
	bool "Symmetric multi-processing support"
	---help---
	  This enables support for systems with more than one CPU. If you have
	  a system with only one CPU, like most personal computers, say N. If
	  you have a system with more than one CPU, say Y.

	  If you say N here, the kernel will run on single and multiprocessor
	  machines, but will use only one CPU of a multiprocessor machine. If
	  you say Y here, the kernel will run on many, but not all,
	  singleprocessor machines. On a singleprocessor machine, the kernel
	  will run faster if you say N here.

	  See also the <file:Documentation/smp.txt>,
	  <file:Documentation/nmi_watchdog.txt> and the SMP-HOWTO available
	  at <http://www.tldp.org/docs.html#howto>.

	  If you don't know what to do here, say N.

config PREEMPT
	bool
#	bool "Preemptible Kernel"
	default n

config COMPAT
	bool
	depends on PARISC64
	default y

config HPUX
	bool "Support for HP-UX binaries"
	depends on !PARISC64

config NR_CPUS
	int "Maximum number of CPUs (2-32)"
	range 2 32
	depends on SMP
	default "32"

endmenu


source "drivers/parisc/Kconfig"


menu "Executable file formats"

source "fs/Kconfig.binfmt"

endmenu

source "drivers/Kconfig"

source "fs/Kconfig"

source "arch/parisc/oprofile/Kconfig"

menu "Kernel hacking"

config DEBUG_KERNEL
	bool "Kernel debugging"
	help
	  Say Y here if you are developing drivers or trying to debug and
	  identify kernel problems.

config DEBUG_SLAB
	bool "Debug memory allocations"
	depends on DEBUG_KERNEL
	help
	  Say Y here to have the kernel do limited verification on memory
	  allocation as well as poisoning memory on free to catch use of freed
	  memory.

config MAGIC_SYSRQ
	bool "Magic SysRq key"
	depends on DEBUG_KERNEL
	help
	  If you say Y here, you will have some control over the system even
	  if the system crashes for example during kernel debugging (e.g., you
	  will be able to flush the buffer cache to disk, reboot the system
	  immediately or dump some status information). This is accomplished
	  by pressing various keys while holding SysRq (Alt+PrintScreen). It
	  also works on a serial console (on PC hardware at least), if you
	  send a BREAK and then within 5 seconds a command keypress. The
	  keys are documented in <file:Documentation/sysrq.txt>. Don't say Y
	  unless you really know what this hack does.

config FRAME_POINTER
	bool "Compile the kernel with frame pointers"
	help
	  If you say Y here the resulting kernel image will be slightly larger
	  and slower, but it will give very useful debugging information.
	  If you don't debug the kernel, you can say N, but we may not be able
	  to solve problems without frame pointers.

config DEBUG_INFO
	bool "Compile the kernel with debug info"
	depends on DEBUG_KERNEL
	help
          If you say Y here the resulting kernel image will include
	  debugging info resulting in a larger kernel image.
	  Say Y here only if you plan to use gdb to debug the kernel.
	  If you don't debug the kernel, you can say N.
	  
endmenu

source "security/Kconfig"

source "crypto/Kconfig"

source "lib/Kconfig"
```

## arch/parisc/config.in
```kconfig
#
# For a description of the syntax of this configuration file,
# see the Configure script.
#

mainmenu_name "Linux Kernel Configuration"

define_bool CONFIG_PARISC y
define_bool CONFIG_UID16 n

mainmenu_option next_comment
comment 'Code maturity level options'
bool 'Prompt for development and/or incomplete code/drivers' CONFIG_EXPERIMENTAL
endmenu

mainmenu_option next_comment
comment 'General options'

# bool 'Symmetric multi-processing support' CONFIG_SMP
define_bool CONFIG_SMP n

bool 'Kernel Debugger support' CONFIG_KWDB
# define_bool CONFIG_KWDB n

# bool 'GSC/Gecko bus support' CONFIG_GSC y
define_bool CONFIG_GSC y

bool 'U2/Uturn I/O MMU' CONFIG_IOMMU_CCIO y
bool 'LASI I/O support' CONFIG_GSC_LASI y

bool 'PCI bus support' CONFIG_PCI y

if [ "$CONFIG_PCI" = "y" ]; then
	bool 'GSCtoPCI/DINO PCI support' CONFIG_GSC_DINO y
	bool 'LBA/Elroy PCI support' CONFIG_PCI_LBA n
fi 

if [ "$CONFIG_PCI_LBA" = "y" ]; then
	define_bool CONFIG_IOSAPIC y
	define_bool CONFIG_IOMMU_SBA y
fi

#
# if [ "$CONFIG_PCI_EPIC" = "y" ]; then...
#

endmenu

mainmenu_option next_comment
comment 'Loadable module support'
bool 'Enable loadable module support' CONFIG_MODULES
if [ "$CONFIG_MODULES" = "y" ]; then
  bool 'Set version information on all symbols for modules' CONFIG_MODVERSIONS
  bool 'Kernel module loader' CONFIG_KMOD
fi
endmenu

mainmenu_option next_comment
comment 'General setup'

bool 'Networking support' CONFIG_NET

bool 'System V IPC' CONFIG_SYSVIPC
bool 'BSD Process Accounting' CONFIG_BSD_PROCESS_ACCT
bool 'Sysctl support' CONFIG_SYSCTL
tristate 'Kernel support for SOM binaries' CONFIG_BINFMT_SOM
tristate 'Kernel support for ELF binaries' CONFIG_BINFMT_ELF
tristate 'Kernel support for MISC binaries' CONFIG_BINFMT_MISC
if [ "$CONFIG_EXPERIMENTAL" = "y" ]; then
  tristate 'Kernel support for JAVA binaries (obsolete)' CONFIG_BINFMT_JAVA
fi

endmenu

##source drivers/parport/Config.in
mainmenu_option next_comment
comment 'Parallel port support'

tristate 'Parallel port support' CONFIG_PARPORT
if [ "$CONFIG_PARPORT" != "n" ]; then
   if [ "$CONFIG_PCI" = "y" ]; then
     dep_tristate '  PC-style hardware' CONFIG_PARPORT_PC $CONFIG_PARPORT
     if [ "$CONFIG_PARPORT_PC" != "n" ]; then
        bool '    Use FIFO/DMA if available' CONFIG_PARPORT_PC_FIFO
        if [ "$CONFIG_EXPERIMENTAL" = "y" ]; then
           bool '    SuperIO chipset support (EXPERIMENTAL)' CONFIG_PARPORT_PC_SUPERIO
        fi
     fi
   fi
   if [ "$CONFIG_GSC_LASI" = "y" ]; then
      dep_tristate '  LASI/ASP builtin parallel-port' CONFIG_PARPORT_GSC $CONFIG_PARPORT
   else
      define_tristate CONFIG_PARPORT_GSC n
   fi

   # If exactly one hardware type is selected then parport will optimise away
   # support for loading any others.  Defeat this if the user is keen.
   bool '  Support foreign hardware' CONFIG_PARPORT_OTHER

   bool '  IEEE 1284 transfer modes' CONFIG_PARPORT_1284
fi
endmenu


source drivers/block/Config.in

if [ "$CONFIG_NET" = "y" ]; then
  source net/Config.in
fi

mainmenu_option next_comment
comment 'SCSI support'

tristate 'SCSI support' CONFIG_SCSI

if [ "$CONFIG_SCSI" != "n" ]; then
  comment 'SCSI support type (disk, tape, CDrom)'

  dep_tristate 'SCSI disk support' CONFIG_BLK_DEV_SD $CONFIG_SCSI
  if [ "$CONFIG_BLK_DEV_SD" != "n" ]; then
    int  'Maximum number of SCSI disks that can be loaded as modules' CONFIG_SD_EXTRA_DEVS 40
  fi

  dep_tristate 'SCSI tape support' CONFIG_CHR_DEV_ST $CONFIG_SCSI
  dep_tristate 'SCSI CDROM support' CONFIG_BLK_DEV_SR $CONFIG_SCSI
  if [ "$CONFIG_BLK_DEV_SR" != "n" ]; then
    bool '  Enable vendor-specific extensions (for SCSI CDROM)' CONFIG_BLK_DEV_SR_VENDOR
    int  'Maximum number of CDROM devices that can be loaded as modules' CONFIG_SR_EXTRA_DEVS 2
  fi
  dep_tristate 'SCSI generic support' CONFIG_CHR_DEV_SG $CONFIG_SCSI

  comment 'Some SCSI devices (e.g. CD jukebox) support multiple LUNs'
  bool 'Probe all LUNs on each SCSI device' CONFIG_SCSI_MULTI_LUN
  bool 'Verbose SCSI error reporting (kernel size +=12K)' CONFIG_SCSI_CONSTANTS

  mainmenu_option next_comment
  comment 'SCSI low-level drivers'
  if [ "$CONFIG_GSC_LASI" = "y" ]; then
    dep_tristate 'Lasi SCSI support' CONFIG_SCSI_LASI $CONFIG_SCSI
    dep_tristate 'Zalon SCSI support' CONFIG_SCSI_ZALON $CONFIG_SCSI
  fi
  if [ "$CONFIG_PCI" = "y" ]; then
    dep_tristate 'SYM53C8XX SCSI support' CONFIG_SCSI_SYM53C8XX $CONFIG_SCSI
  fi
  if [ "$CONFIG_SCSI_ZALON" != "n" -o "$CONFIG_SCSI_SYM53C8XX" != "n" ]; then
    int  '  default tagged command queue depth' CONFIG_SCSI_NCR53C8XX_DEFAULT_TAGS 8
    int  '  maximum number of queued commands' CONFIG_SCSI_NCR53C8XX_MAX_TAGS 32
    int  '  synchronous transfers frequency in MHz' CONFIG_SCSI_NCR53C8XX_SYNC 20
    bool '  enable profiling' CONFIG_SCSI_NCR53C8XX_PROFILE
    bool '  use normal IO' CONFIG_SCSI_NCR53C8XX_IOMAPPED
  fi
  endmenu
fi
endmenu

if [ "$CONFIG_NET" = "y" ]; then
  mainmenu_option next_comment
  comment 'Network device support'

  bool 'Network device support' CONFIG_NETDEVICES

  if [ "$CONFIG_NETDEVICES" = "y" ]; then
    if [ "$CONFIG_GSC_LASI" = "y" ]; then
      tristate 'Lasi ethernet' CONFIG_LASI_82596
    fi
    source drivers/net/Config.in
  fi
  endmenu
fi

source drivers/char/Config.in

source fs/Config.in

mainmenu_option next_comment
comment 'Sound Drivers'
tristate 'Sound card support' CONFIG_SOUND
if [ "$CONFIG_SOUND" != "n" ]; then
   source drivers/sound/Config.in
fi
endmenu

if [ "$CONFIG_VT" = "y" ]; then
  mainmenu_option next_comment
  comment 'Console drivers'
  source drivers/video/Config.in

#  bool 'IODC console' CONFIG_IODC_CONSOLE
  bool 'STI console' CONFIG_STI_CONSOLE
  if [ "$CONFIG_IODC_CONSOLE" = "n" ]; then
    if [ "$CONFIG_GSC_PS2" = "y" ]; then
      define_bool CONFIG_DUMMY_CONSOLE y
    fi
  fi
  if [ "$CONFIG_STI_CONSOLE" = "y" ]; then
    define_bool CONFIG_DUMMY_CONSOLE y
  fi
  endmenu
fi
# endmenu

mainmenu_option next_comment
comment 'Kernel hacking'

#bool 'Debug kmalloc/kfree' CONFIG_DEBUG_MALLOC
bool 'Magic SysRq key' CONFIG_MAGIC_SYSRQ
endmenu
```

## arch/powerpc/perfmon/Kconfig
```kconfig
menu "Hardware Performance Monitoring support"
config PERFMON
	bool "Perfmon2 performance monitoring interface"
	default n
	help
	Enables the perfmon2 interface to access the hardware
	performance counters. See <http://perfmon2.sf.net/> for
	more details.

config PERFMON_DEBUG
	bool "Perfmon debugging"
	default n
	depends on PERFMON
	help
	Enables perfmon debugging support

config PERFMON_DEBUG_FS
	bool "Enable perfmon statistics reporting via debugfs"
	default y
	depends on PERFMON && DEBUG_FS
	help
	Enable collection and reporting of perfmon timing statistics under
	debugfs. This is used for debugging and performance analysis of the
	subsystem. The debugfs filesystem must be mounted.

config PERFMON_POWER4
	tristate "Support for Power4 hardware performance counters"
	depends on PERFMON && PPC64
	default n
	help
	Enables support for the Power 4 hardware performance counters
	If unsure, say M.

config PERFMON_POWER5
	tristate "Support for Power5 hardware performance counters"
	depends on PERFMON && PPC64
	default n
	help
	Enables support for the Power 5 hardware performance counters
	If unsure, say M.

config PERFMON_POWER6
	tristate "Support for Power6 hardware performance counters"
	depends on PERFMON && PPC64
	default n
	help
	Enables support for the Power 6 hardware performance counters
	If unsure, say M.

config PERFMON_PPC32
	tristate "Support for PPC32 hardware performance counters"
	depends on PERFMON && PPC32
	default n
	help
	Enables support for the PPC32 hardware performance counters
	If unsure, say M.

config PERFMON_CELL
	tristate "Support for Cell hardware performance counters"
	depends on PERFMON && PPC_CELL
	select PS3_LPM if PPC_PS3
	default n
	help
	Enables support for the Cell hardware performance counters.
	If unsure, say M.

endmenu
```

## arch/ppc/8260_io/Config.in
```kconfig
#
# MPC8260 Communication options
#
mainmenu_option next_comment
comment 'MPC8260 CPM Options'
bool 'Enable SCC Console' CONFIG_SCC_CONSOLE
if [ "$CONFIG_NET_ETHERNET" = "y" ]; then
  bool 'CPM SCC Ethernet' CONFIG_SCC_ENET
  if [ "$CONFIG_SCC_ENET" = "y" ]; then
  bool 'Ethernet on SCC1' CONFIG_SCC1_ENET
    if [ "$CONFIG_SCC1_ENET" != "y" ]; then
      bool 'Ethernet on SCC2' CONFIG_SCC2_ENET
    fi
  fi
#
#  CONFIG_FEC_ENET is only used to get netdevices to call our init
#    function.  Any combination of FCC1,2,3 are supported.
#
  bool 'FCC Ethernet' CONFIG_FEC_ENET
  if [ "$CONFIG_FEC_ENET" = "y" ]; then
    bool 'Ethernet on FCC1' CONFIG_FCC1_ENET
    bool 'Ethernet on FCC2' CONFIG_FCC2_ENET
    bool 'Ethernet on FCC3' CONFIG_FCC3_ENET
    bool 'Use MDIO for PHY configuration' CONFIG_USE_MDIO
    if [ "$CONFIG_USE_MDIO" = "y" ]; then
      choice 'Type of PHY'	\
	"LXT970		CONFIG_FCC_LXT970	\
	 LXT971		CONFIG_FCC_LXT971	\
	 QS6612		CONFIG_FCC_QS6612"	CONFIG_FCC_LXT971
      fi
  fi
fi

comment 'Generic MPC8260 Options'
bool 'Disable data cache' CONFIG_DCACHE_DISABLE
endmenu
```

## arch/ppc/8xx_io/Config.in
```kconfig
#
# MPC8xx Communication options
#
mainmenu_option next_comment
comment 'MPC8xx CPM Options'

if [ "$CONFIG_NET_ETHERNET" = "y" ]; then
  bool 'CPM SCC Ethernet' CONFIG_SCC_ENET
  if [ "$CONFIG_SCC_ENET" = "y" ]; then
    choice 'SCC used for Ethernet'	\
  	"SCC1	CONFIG_SCC1_ENET	\
	 SCC2	CONFIG_SCC2_ENET	\
	 SCC3	CONFIG_SCC3_ENET"	SCC1
  fi
  bool '860T FEC Ethernet' CONFIG_FEC_ENET
  if [ "$CONFIG_FEC_ENET" = "y" ]; then
    bool 'Use MDIO for PHY configuration' CONFIG_USE_MDIO
  fi
  bool 'Use Big CPM Ethernet Buffers' CONFIG_ENET_BIG_BUFFERS
fi
bool 'Use SMC2 for UART' CONFIG_SMC2_UART
if [ "$CONFIG_SMC2_UART" = "y" ]; then
  bool 'Use Alternate SMC2 I/O (823/850)' CONFIG_ALTSMC2
  bool 'Use SMC2 for Console' CONFIG_CONS_SMC2
fi
bool 'Enable SCC2 and SCC3 for UART' CONFIG_USE_SCC_IO

# This doesn't really belong here, but it is convenient to ask
# 8xx specific questions.

comment 'Generic MPC8xx Options'
bool 'Copy-Back Data Cache (else Writethrough)' CONFIG_8xx_COPYBACK
bool 'CPU6 Silicon Errata (860 Pre Rev. C)' CONFIG_8xx_CPU6
bool 'I2C/SPI Microcode Patch' CONFIG_UCODE_PATCH

endmenu
```
