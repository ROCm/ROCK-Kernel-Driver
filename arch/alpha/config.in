## arch/arm/config.in
```kconfig
#
# For a description of the syntax of this configuration file,
# see Documentation/kbuild/config-language.txt.
#
mainmenu_name "Linux Kernel Configuration"

define_bool CONFIG_ARM y
define_bool CONFIG_EISA n
define_bool CONFIG_SBUS n
define_bool CONFIG_MCA n
define_bool CONFIG_UID16 y
define_bool CONFIG_RWSEM_GENERIC_SPINLOCK y
define_bool CONFIG_RWSEM_XCHGADD_ALGORITHM n
define_bool CONFIG_GENERIC_BUST_SPINLOCK n
define_bool CONFIG_GENERIC_ISA_DMA n

source init/Config.in

mainmenu_option next_comment
comment 'System Type'

choice 'ARM system type' \
	"ADIFCC-based		CONFIG_ARCH_ADIFCC \
	 Anakin			CONFIG_ARCH_ANAKIN \
	 Archimedes/A5000	CONFIG_ARCH_ARCA5K \
	 Cirrus-CL-PS7500FE     CONFIG_ARCH_CLPS7500 \
 	 CLPS711x/EP721x-based	CONFIG_ARCH_CLPS711X \
	 Co-EBSA285		CONFIG_ARCH_CO285 \
	 PXA250/210-based	CONFIG_ARCH_PXA \
	 EBSA-110		CONFIG_ARCH_EBSA110 \
 	 Epxa10db               CONFIG_ARCH_CAMELOT \
	 FootBridge		CONFIG_ARCH_FOOTBRIDGE \
	 Integrator		CONFIG_ARCH_INTEGRATOR \
 	 IOP310-based		CONFIG_ARCH_IOP310 \
	 LinkUp-L7200		CONFIG_ARCH_L7200 \
	 RiscPC			CONFIG_ARCH_RPC \
 	 SA1100-based		CONFIG_ARCH_SA1100 \
	 Shark			CONFIG_ARCH_SHARK" RiscPC

source arch/arm/mach-arc/Config.in
source arch/arm/mach-clps711x/Config.in
source arch/arm/mach-epxa10db/Config.in
source arch/arm/mach-footbridge/Config.in
source arch/arm/mach-iop310/Config.in
source arch/arm/mach-pxa/Config.in
source arch/arm/mach-sa1100/Config.in

# Definitions to make life easier
if [ "$CONFIG_ARCH_ARCA5K" = "y" -o \
     "$CONFIG_ARCH_RPC" = "y" ]; then
   define_bool CONFIG_ARCH_ACORN y
else
   define_bool CONFIG_ARCH_ACORN n
fi

#####################################################################
# Footbridge support
if [ "$CONFIG_ARCH_CO285" = "y" -o \
     "$CONFIG_ARCH_FOOTBRIDGE" = "y" ]; then
   define_bool CONFIG_FOOTBRIDGE y
else
   define_bool CONFIG_FOOTBRIDGE n
fi
if [ "$CONFIG_ARCH_CATS" = "y" -o \
     "$CONFIG_ARCH_EBSA285_HOST" = "y" -o \
     "$CONFIG_ARCH_NETWINDER" = "y" -o \
     "$CONFIG_ARCH_PERSONAL_SERVER" = "y" ]; then
   define_bool CONFIG_FOOTBRIDGE_HOST y
else
   define_bool CONFIG_FOOTBRIDGE_HOST n
fi
if [ "$CONFIG_ARCH_CO285" = "y" -o \
     "$CONFIG_ARCH_EBSA285_ADDIN" = "y" ]; then
   define_bool CONFIG_FOOTBRIDGE_ADDIN y
else
   define_bool CONFIG_FOOTBRIDGE_ADDIN n
fi
if [ "$CONFIG_ARCH_EBSA285_HOST" = "y" -o \
     "$CONFIG_ARCH_EBSA285_ADDIN" = "y" ]; then
   define_bool CONFIG_ARCH_EBSA285 y
fi

#####################################################################
# SA1111 support
if [ "$CONFIG_ASSABET_NEPONSET" = "y" -o \
     "$CONFIG_SA1100_ADSBITSY" = "y" -o \
     "$CONFIG_SA1100_BADGE4" = "y" -o \
     "$CONFIG_SA1100_CONSUS" = "y" -o \
     "$CONFIG_SA1100_GRAPHICSMASTER" = "y" -o \
     "$CONFIG_SA1100_JORNADA720" = "y" -o \
     "$CONFIG_ARCH_LUBBOCK" = "y" -o \
     "$CONFIG_SA1100_PFS168" = "y" -o \
     "$CONFIG_SA1100_PT_SYSTEM3" = "y" -o \
     "$CONFIG_SA1100_XP860" = "y" ]; then
   define_bool CONFIG_SA1111 y
   define_int CONFIG_FORCE_MAX_ZONEORDER 9
fi

comment 'Processor Type'

# Figure out whether this system uses 26-bit or 32-bit CPUs.
if [ "$CONFIG_ARCH_ARCA5K" = "y" ]; then
   define_bool CONFIG_CPU_32 n
   define_bool CONFIG_CPU_26 y
else
   define_bool CONFIG_CPU_32 y
   define_bool CONFIG_CPU_26 n
fi

# Select CPU types depending on the architecture selected.  This selects
# which CPUs we support in the kernel image, and the compiler instruction
# optimiser behaviour.

# ARM610
if [ "$CONFIG_ARCH_RPC" = "y" ]; then
   bool 'Support ARM610 processor' CONFIG_CPU_ARM610
else
   define_bool CONFIG_CPU_ARM610 n
fi

# ARM710
if [ "$CONFIG_ARCH_CLPS7500" = "y" ]; then
   define_bool CONFIG_CPU_ARM710 y
else
   if [ "$CONFIG_ARCH_RPC" = "y" ]; then
      bool 'Support ARM710 processor' CONFIG_CPU_ARM710
   else
      define_bool CONFIG_CPU_ARM710 n
   fi
fi

# ARM720T
if [ "$CONFIG_ARCH_CLPS711X" = "y" -o \
     "$CONFIG_ARCH_L7200"    = "y" -o \
     "$CONFIG_ARCH_CDB89712" = "y" ]; then
   define_bool CONFIG_CPU_ARM720T y
else
   if [ "$CONFIG_ARCH_INTEGRATOR" = "y" ]; then
      bool 'Support ARM720T processor' CONFIG_CPU_ARM720T
   else
      define_bool CONFIG_CPU_ARM720T n
   fi
fi

# ARM920T
if [ "$CONFIG_ARCH_INTEGRATOR" = "y" ]; then
   bool 'Support ARM920T processor' CONFIG_CPU_ARM920T
else
   define_bool CONFIG_CPU_ARM920T n
fi

# ARM922T
if [ "$CONFIG_ARCH_CAMELOT" = "y" ]; then
         define_bool CONFIG_CPU_ARM922T y
else
         define_bool CONFIG_CPU_ARM922T n
fi

# ARM926T
if [ "$CONFIG_ARCH_INTEGRATOR" = "y" ]; then
   bool 'Support ARM926T processor' CONFIG_CPU_ARM926T
else
   define_bool CONFIG_CPU_ARM926T n
fi

# ARM1020
if [ "$CONFIG_ARCH_INTEGRATOR" = "y" ]; then
   bool 'Support ARM1020 processor' CONFIG_CPU_ARM1020
else
    define_bool CONFIG_CPU_ARM1020 n
fi

# SA110
if [ "$CONFIG_ARCH_EBSA110"  = "y" -o "$CONFIG_FOOTBRIDGE" = "y" -o \
     "$CONFIG_ARCH_TBOX"     = "y" -o "$CONFIG_ARCH_SHARK" = "y" -o \
     "$CONFIG_ARCH_NEXUSPCI" = "y" -o "$CONFIG_ARCH_ANAKIN" = "y" ]; then
   define_bool CONFIG_CPU_SA110 y
else
   if [ "$CONFIG_ARCH_RPC" = "y" ]; then
      bool 'Support StrongARM(R) SA-110 processor' CONFIG_CPU_SA110
   else
      define_bool CONFIG_CPU_SA110 n
   fi
fi

# SA1100
if [ "$CONFIG_ARCH_SA1100" = "y" ]; then
   define_bool CONFIG_CPU_SA1100 y
else
   define_bool CONFIG_CPU_SA1100 n
fi

# XScale
if [ "$CONFIG_ARCH_IOP310" = "y" -o \
     "$CONFIG_ARCH_ADIFCC" = "y" -o \
     "$CONFIG_ARCH_PXA" = "y" ]; then
   define_bool CONFIG_CPU_XSCALE y
else
   define_bool CONFIG_CPU_XSCALE n
fi

# Figure out what processor architecture version we should be using.
# This defines the compiler instruction set which depends on the machine type.

if [ "$CONFIG_ARCH_RPC"        = "y" -o "$CONFIG_ARCH_CLPS7500" = "y" ]; then
   define_bool CONFIG_CPU_32v3 y
else
   define_bool CONFIG_CPU_32v3 n
fi
if [ "$CONFIG_ARCH_EBSA110"    = "y" -o "$CONFIG_FOOTBRIDGE"    = "y" -o \
     "$CONFIG_ARCH_TBOX"       = "y" -o "$CONFIG_ARCH_SHARK"    = "y" -o \
     "$CONFIG_ARCH_NEXUSPCI"   = "y" -o "$CONFIG_ARCH_CLPS711X" = "y" -o \
     "$CONFIG_ARCH_INTEGRATOR" = "y" -o "$CONFIG_ARCH_SA1100"   = "y" -o \
     "$CONFIG_ARCH_L7200"      = "y" -o "$CONFIG_ARCH_ANAKIN"	= "y" -o \
     "$CONFIG_ARCH_CAMELOT"    = "y" ]; then
   define_bool CONFIG_CPU_32v4 y
else
   define_bool CONFIG_CPU_32v4 n
fi
if [ "$CONFIG_ARCH_IOP310" = "y" -o \
     "$CONFIG_ARCH_ADIFCC" = "y" -o \
     "$CONFIG_ARCH_PXA" = "y" ]; then
   define_bool CONFIG_CPU_32v5 y
else
   define_bool CONFIG_CPU_32v5 n
fi

comment 'Processor Features'

if [ "$CONFIG_CPU_ARM720T" = "y" -o "$CONFIG_CPU_ARM920T" = "y" -o \
     "$CONFIG_CPU_ARM922T" = "y" -o "$CONFIG_CPU_ARM926T" = "y" -o \
     "$CONFIG_CPU_ARM1020" = "y" -o "$CONFIG_CPU_XSCALE" = "y" ]; then
   dep_bool 'Support Thumb instructions (EXPERIMENTAL)' CONFIG_ARM_THUMB $CONFIG_EXPERIMENTAL
fi
if [ "$CONFIG_CPU_ARM920T" = "y" -o "$CONFIG_CPU_ARM922T" = "y" -o \
     "$CONFIG_CPU_ARM926T" = "y" -o "$CONFIG_CPU_ARM1020" = "y" ]; then
   bool 'Disable I-Cache' CONFIG_CPU_ICACHE_DISABLE
   bool 'Disable D-Cache' CONFIG_CPU_DCACHE_DISABLE
   if [ "$CONFIG_CPU_DISABLE_DCACHE" = "n" ]; then
      bool 'Force write through D-cache' CONFIG_CPU_DCACHE_WRITETHROUGH
   fi
fi
if [ "$CONFIG_CPU_ARM926T" = "y" -o "$CONFIG_CPU_ARM1020" = "y" ]; then
   if [ "$CONFIG_CPU_ICACHE_DISABLE" = "n" -o "$CONFIG_CPU_DCACHE_DISABLE" = "n" ]; then
      bool 'Round robin I and D cache replacement algorithm' CONFIG_CPU_CACHE_ROUND_ROBIN
   fi
fi
if [ "$CONFIG_CPU_ARM1020" = "y" ]; then
   bool 'Disable branch prediction' CONFIG_CPU_BPREDICT_DISABLE
fi

if [ "$CONFIG_CPU_XSCALE" = "y" ]; then
#  bool 'Use XScale PMU as timer source' CONFIG_XSCALE_PMU_TIMER
   if [ "$CONFIG_XSCALE_PMU_TIMER" != "y" ]; then
      define_bool CONFIG_XSCALE_PMU y
   else
      define_bool CONFIG_XSCALE_PMU n
   fi
fi

endmenu

mainmenu_option next_comment
comment 'General setup'

# Select various configuration options depending on the machine type
if [ "$CONFIG_ARCH_EDB7211" = "y" -o \
     "$CONFIG_ARCH_SA1100" = "y" ]; then
   define_bool CONFIG_DISCONTIGMEM y
else
   define_bool CONFIG_DISCONTIGMEM n
fi

# Now handle the bus types
if [ "$CONFIG_ARCH_FTVPCI" = "y" -o \
     "$CONFIG_ARCH_SHARK" = "y" -o \
     "$CONFIG_FOOTBRIDGE_HOST" = "y" -o \
     "$CONFIG_ARCH_IOP310" = "y" ]; then
   define_bool CONFIG_PCI y
else
   if [ "$CONFIG_ARCH_INTEGRATOR" = "y" ]; then
      bool 'PCI support' CONFIG_PCI_INTEGRATOR
      define_bool CONFIG_PCI $CONFIG_PCI_INTEGRATOR
   else
      define_bool CONFIG_PCI n
   fi
fi

# Select the host bridge type
if [ "$CONFIG_PCI" = "y" ]; then
   if [ "$CONFIG_ARCH_FTVPCI" = "y" ]; then
      define_bool CONFIG_PCI_HOST_PLX90X0 y
   else
      define_bool CONFIG_PCI_HOST_PLX90X0 n
   fi
   if [ "$CONFIG_ARCH_SHARK" = "y" ]; then
      define_bool CONFIG_PCI_HOST_VIA82C505 y
   else
      define_bool CONFIG_PCI_HOST_VIA82C505 n
   fi
fi

if [ "$CONFIG_FOOTBRIDGE_HOST" = "y" -o \
     "$CONFIG_ARCH_SHARK" = "y" -o \
     "$CONFIG_ARCH_CLPS7500" = "y" -o \
     "$CONFIG_ARCH_EBSA110" = "y" -o \
     "$CONFIG_ARCH_CDB89712" = "y" -o \
     "$CONFIG_ARCH_EDB7211" = "y" -o \
     "$CONFIG_ARCH_SA1100" = "y" ]; then
   define_bool CONFIG_ISA y
else
   define_bool CONFIG_ISA n
fi

if [ "$CONFIG_FOOTBRIDGE_HOST" = "y" -o \
     "$CONFIG_ARCH_SHARK" = "y" ]; then
   define_bool CONFIG_ISA_DMA y
else
   define_bool CONFIG_ISA_DMA n
fi

if [ "$CONFIG_ARCH_ACORN" = "y" -o \
     "$CONFIG_ARCH_L7200" = "y" ]; then
   define_bool CONFIG_FIQ y
else
   define_bool CONFIG_FIQ n
fi

# Compressed boot loader in ROM.  Yes, we really want to ask about
# TEXT and BSS so we preserve their values in the config files.
bool 'Compressed boot loader in ROM/flash' CONFIG_ZBOOT_ROM
hex 'Compressed ROM boot loader base address' CONFIG_ZBOOT_ROM_TEXT 0
hex 'Compressed ROM boot loader BSS address' CONFIG_ZBOOT_ROM_BSS 0

if [ "$CONFIG_ARCH_SA1100" = "y" -o \
     "$CONFIG_ARCH_INTEGRATOR" = "y" ]; then
   dep_bool 'Support CPU clock change (EXPERIMENTAL)' CONFIG_CPU_FREQ $CONFIG_EXPERIMENTAL
fi

source drivers/pci/Config.in
bool 'Support for hot-pluggable devices' CONFIG_HOTPLUG
if [ "$CONFIG_HOTPLUG" = "y" ]; then
   source drivers/pcmcia/Config.in
else
   define_bool CONFIG_PCMCIA n
fi
comment 'At least one math emulation must be selected'
tristate 'NWFPE math emulation' CONFIG_FPE_NWFPE
if [ "$CONFIG_CPU_26" = "n" -a "$CONFIG_CPU_32v3" = "n" ]; then
   dep_tristate 'FastFPE math emulation (EXPERIMENTAL)' CONFIG_FPE_FASTFPE $CONFIG_EXPERIMENTAL
fi
choice 'Kernel core (/proc/kcore) format' \
	"ELF		CONFIG_KCORE_ELF	\
	 A.OUT		CONFIG_KCORE_AOUT" ELF
tristate 'Kernel support for a.out binaries' CONFIG_BINFMT_AOUT
tristate 'Kernel support for ELF binaries' CONFIG_BINFMT_ELF
tristate 'Kernel support for MISC binaries' CONFIG_BINFMT_MISC
bool 'Power Management support' CONFIG_PM
dep_bool 'Preemptible Kernel (EXPERIMENTAL)' CONFIG_PREEMPT $CONFIG_CPU_32 $CONFIG_EXPERIMENTAL
dep_tristate 'Advanced Power Management Emulation' CONFIG_APM $CONFIG_PM
dep_tristate 'RISC OS personality' CONFIG_ARTHUR $CONFIG_CPU_32
string 'Default kernel command string' CONFIG_CMDLINE ""

if [ "$CONFIG_ARCH_NETWINDER" = "y" -o  \
     "$CONFIG_ARCH_EBSA110" = "y" -o    \
     "$CONFIG_ARCH_EBSA285" = "y" -o    \
     "$CONFIG_ARCH_FTVPCI" = "y" -o     \
     "$CONFIG_ARCH_SHARK" = "y" -o      \
     "$CONFIG_ARCH_CO285" = "y" -o      \
     "$CONFIG_ARCH_SA1100" = "y" -o     \
     "$CONFIG_ARCH_LUBBOCK" = "y" -o    \
     "$CONFIG_ARCH_PXA_IDP" = "y" -o \
     "$CONFIG_ARCH_INTEGRATOR" = "y" -o \
     "$CONFIG_ARCH_CDB89712" = "y" -o   \
     "$CONFIG_ARCH_P720T" = "y" ]; then
   bool 'Timer and CPU usage LEDs' CONFIG_LEDS
   if [ "$CONFIG_LEDS" = "y" ]; then
      if [ "$CONFIG_ARCH_NETWINDER" = "y" -o  \
	   "$CONFIG_ARCH_EBSA285" = "y" -o    \
	   "$CONFIG_ARCH_SHARK" = "y" -o      \
	   "$CONFIG_ARCH_CO285" = "y" -o      \
	   "$CONFIG_ARCH_SA1100" = "y" -o     \
	   "$CONFIG_ARCH_LUBBOCK" = "y" -o    \
	   "$CONFIG_ARCH_PXA_IDP" = "y" -o    \
	   "$CONFIG_ARCH_INTEGRATOR" = "y" -o \
	   "$CONFIG_ARCH_P720T" = "y" ]; then
         bool '  Timer LED' CONFIG_LEDS_TIMER
         bool '  CPU usage LED' CONFIG_LEDS_CPU
      fi
   fi
   if [ "$CONFIG_ARCH_EBSA110" = "y" ]; then
      define_bool CONFIG_LEDS_TIMER y
   fi
fi

if [ "$CONFIG_CPU_32" = "y" ]; then
   define_bool CONFIG_ALIGNMENT_TRAP y
else
   define_bool CONFIG_ALIGNMENT_TRAP n
fi
endmenu

source drivers/parport/Config.in

if [ "$CONFIG_ALIGNMENT_TRAP" = "y" ]; then
  source drivers/mtd/Config.in
else
  define_bool CONFIG_MTD n
fi

source drivers/pnp/Config.in
source drivers/block/Config.in
source drivers/md/Config.in

if [ "$CONFIG_ARCH_ACORN" = "y" ]; then
   source drivers/acorn/block/Config.in
fi

if [ "$CONFIG_NET" = "y" ]; then
   source net/Config.in

   mainmenu_option next_comment
   comment 'Network device support'

   bool 'Network device support' CONFIG_NETDEVICES
   if [ "$CONFIG_NETDEVICES" = "y" ]; then
      source drivers/net/Config.in
   fi
   endmenu

   source net/ax25/Config.in

   source net/irda/Config.in
fi

mainmenu_option next_comment
comment 'ATA/ATAPI/MFM/RLL support'

tristate 'ATA/ATAPI/MFM/RLL support' CONFIG_IDE

if [ "$CONFIG_IDE" != "n" ]; then
  source drivers/ide/Config.in
else
  define_bool CONFIG_BLK_DEV_HD n
fi
endmenu

mainmenu_option next_comment
comment 'SCSI support'

tristate 'SCSI support' CONFIG_SCSI

if [ "$CONFIG_SCSI" != "n" ]; then
   source drivers/scsi/Config.in
fi
endmenu

if [ "$CONFIG_ARCH_CLPS711X" = "y" ]; then
   source drivers/ssi/Config.in
fi

source drivers/ieee1394/Config.in

source drivers/message/i2o/Config.in

source drivers/isdn/Config.in

#
# input before char - char/joystick depends on it. As does USB.
#
source drivers/input/Config.in

source drivers/char/Config.in
if [ "$CONFIG_ARCH_ACORN" = "y" -a \
     "$CONFIG_BUSMOUSE" = "y" ]; then
   if [ "$CONFIG_ARCH_RPC" != "y" ]; then
      define_bool CONFIG_KBDMOUSE y
   else
      define_bool CONFIG_RPCMOUSE y
   fi
fi

source drivers/media/Config.in

source fs/Config.in

if [ "$CONFIG_VT" = "y" ]; then
   mainmenu_option next_comment
   comment 'Console drivers'
   if [ "$CONFIG_ARCH_ACORN" != "y" -a "$CONFIG_ARCH_EBSA110" != "y" ]; then
      bool 'VGA text console' CONFIG_VGA_CONSOLE
   fi
   source drivers/video/Config.in
   endmenu
fi

if [ "$CONFIG_ARCH_ACORN" = "y" -o \
     "$CONFIG_ARCH_CLPS7500" = "y" -o \
     "$CONFIG_ARCH_TBOX" = "y" -o \
     "$CONFIG_ARCH_SHARK" = "y" -o \
     "$CONFIG_ARCH_SA1100" = "y" -o \
     "$CONFIG_PCI" = "y" ]; then
   mainmenu_option next_comment
   comment 'Sound'

   tristate 'Sound card support' CONFIG_SOUND
   if [ "$CONFIG_SOUND" != "n" ]; then
      source sound/Config.in
   fi
   endmenu
fi

source drivers/misc/Config.in

source drivers/usb/Config.in

source net/bluetooth/Config.in

mainmenu_option next_comment
comment 'Kernel hacking'

# Always compile kernel with framepointer (until 2.4 real comes out)
# Bug reports aren't much use without this.
bool 'Compile kernel without frame pointer' CONFIG_NO_FRAME_POINTER
bool 'Verbose user fault messages' CONFIG_DEBUG_USER
bool 'Include debugging information in kernel binary' CONFIG_DEBUG_INFO

bool 'Kernel debugging' CONFIG_DEBUG_KERNEL
dep_bool '  Debug memory allocations' CONFIG_DEBUG_SLAB $CONFIG_DEBUG_KERNEL
dep_bool '  Magic SysRq key' CONFIG_MAGIC_SYSRQ $CONFIG_DEBUG_KERNEL
dep_bool '  Spinlock debugging' CONFIG_DEBUG_SPINLOCK $CONFIG_DEBUG_KERNEL
dep_bool '  Wait queue debugging' CONFIG_DEBUG_WAITQ $CONFIG_DEBUG_KERNEL
dep_bool '  Verbose BUG() reporting (adds 70K)' CONFIG_DEBUG_BUGVERBOSE $CONFIG_DEBUG_KERNEL
dep_bool '  Verbose kernel error messages' CONFIG_DEBUG_ERRORS $CONFIG_DEBUG_KERNEL
# These options are only for real kernel hackers who want to get their hands dirty. 
dep_bool '  Kernel low-level debugging functions' CONFIG_DEBUG_LL $CONFIG_DEBUG_KERNEL
dep_bool '    Kernel low-level debugging messages via footbridge serial port' CONFIG_DEBUG_DC21285_PORT $CONFIG_DEBUG_LL $CONFIG_FOOTBRIDGE
dep_bool '    Kernel low-level debugging messages via UART2' CONFIG_DEBUG_CLPS711X_UART2 $CONFIG_DEBUG_LL $CONFIG_ARCH_CLPS711X
endmenu

source security/Config.in
source lib/Config.in
```
