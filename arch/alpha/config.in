## arch/arm/mach-arc/Kconfig
```kconfig
menu "Archimedes/A5000 Implementations"

# These architectures will be combined.  However, until this
# is complete...  Note that the ARC will take precedence over
# A5K
comment "Archimedes/A5000 Implementations (select only ONE)"

config ARCH_ARC
	bool "Archimedes"
	depends on ARCH_ARCA5K
	help
	  The Acorn Archimedes was an personal computer based on an 8K ARM2
	  processor, released in 1987.  It supported 512K of RAM and 2 800K
	  floppy disks.  Picture and more detailed specifications at
	  <http://www.computingmuseum.com/museum/archi.htm>.

config ARCH_A5K
	bool "A5000"
	depends on ARCH_ARCA5K
	help
	  Say Y here to to support the Acorn A5000.  Linux can support the
	  internal IDE disk and CD-ROM interface, serial and parallel port,
	  and the floppy drive.  Note that on some A5000s the floppy is
	  plugged into the wrong socket on the motherboard.

config PAGESIZE_16
	bool "2MB physical memory"
	depends on ARCH_ARCA5K
	help
	  Say Y here if your Archimedes or A5000 system has only 2MB of
	  memory, otherwise say N.  The resulting kernel will not run on a
	  machine with 4MB of memory.

endmenu
```

## arch/arm/mach-epxa10db/Kconfig
```kconfig
menu "Epxa10db"

comment "PLD hotswap support"
	depends on ARCH_CAMELOT

config PLD
	bool
	depends on ARCH_CAMELOT
	default y

config PLD_HOTSWAP
	bool "Support for PLD device hotplugging (experimental)"
	depends on ARCH_CAMELOT && EXPERIMENTAL
	help
	  This enables support for the dynamic loading and configuration of
	  compatible drivers when the contents of the PLD are changed. This
	  is still experimental and requires configuration tools which are
	  not yet generally available. Say N here. You must enable the kernel
	  module loader for this feature to work.

endmenu
```

## arch/arm/mach-footbridge/Kconfig
```kconfig
if ARCH_FOOTBRIDGE

menu "Footbridge Implementations"

config ARCH_CATS
	bool "CATS"
	help
	  Say Y here if you intend to run this kernel on the CATS.

	  Saying N will reduce the size of the Footbridge kernel.

config ARCH_PERSONAL_SERVER
	bool "Compaq Personal Server"
	---help---
	  Say Y here if you intend to run this kernel on the Compaq
	  Personal Server.

	  Saying N will reduce the size of the Footbridge kernel.

	  The Compaq Personal Server is not available for purchase.
	  There are no product plans beyond the current research
	  prototypes at this time.  Information is available at:

	  <http://www.crl.hpl.hp.com/projects/personalserver/>

	  If you have any questions or comments about the  Compaq Personal
	  Server, send e-mail to skiff@crl.dec.com.

config ARCH_EBSA285_ADDIN
	bool "EBSA285 (addin mode)"
	help
	  Say Y here if you intend to run this kernel on the EBSA285 card
	  in addin mode.

	  Saying N will reduce the size of the Footbridge kernel.

config ARCH_EBSA285_HOST
	bool "EBSA285 (host mode)"
	help
	  Say Y here if you intend to run this kernel on the EBSA285 card
	  in host ("central function") mode.

	  Saying N will reduce the size of the Footbridge kernel.

config ARCH_NETWINDER
	bool "NetWinder"
	help
	  Say Y here if you intend to run this kernel on the Rebel.COM
	  NetWinder.  Information about this machine can be found at:

	  <http://www.netwinder.org/>

	  Saying N will reduce the size of the Footbridge kernel.

endmenu

endif
```

## arch/arm/mach-h720x/Kconfig
```kconfig
if ARCH_H720X

menu "h720x Implementations"

config ARCH_H7201
	bool "gms30c7201"
	depends on ARCH_H720X
	select CPU_H7201
	help
	  Say Y here if you are using the Hynix GMS30C7201 Reference Board

config ARCH_H7202
	bool "hms30c7202"
	select CPU_H7202
	depends on ARCH_H720X
	help
	  Say Y here if you are using the Hynix HMS30C7202 Reference Board

endmenu

config CPU_H7201
	bool
	help
	  Select code specific to h7201 variants

config CPU_H7202
	bool
	help
	  Select code specific to h7202 variants

endif
```

## arch/arm/mach-integrator/Kconfig
```kconfig
menu "Integrator Options"
	depends on ARCH_INTEGRATOR

config INTEGRATOR_IMPD1
	tristate "Include support for Integrator/IM-PD1"
	help
	  The IM-PD1 is an add-on logic module for the Integrator which
	  allows ARM(R) Ltd PrimeCells to be developed and evaluated.
	  The IM-PD1 can be found on the Integrator/PP2 platform.

	  To compile this driver as a module, choose M here: the
	  module will be called impd1.

endmenu
```

## arch/arm/mach-iop310/Kconfig
```kconfig
menu "IOP310 Implementation Options"

config ARCH_IQ80310
	bool "IQ80310"
	depends on ARCH_IOP310
	help
	  Say Y here if you want to run your kernel on the Intel IQ80310
	  evaluation kit for the IOP310 chipset.

comment "IOP310 Chipset Features"

config IOP310_AAU
	bool "Support Intel 80312 Application Accelerator Unit (EXPERIMENTAL)"
	depends on ARCH_IOP310 && EXPERIMENTAL

config IOP310_DMA
	bool "Support Intel 80312 DMA (EXPERIMENTAL)"
	depends on ARCH_IOP310 && EXPERIMENTAL

config IOP310_MU
	bool "Support Intel 80312 Messaging Unit (EXPERIMENTAL)"
	depends on ARCH_IOP310 && EXPERIMENTAL

config IOP310_PMON
	bool "Support Intel 80312 Performance Monitor (EXPERIMENTAL)"
	depends on ARCH_IOP310 && EXPERIMENTAL

endmenu
```

## arch/arm/mach-iop3xx/Kconfig
```kconfig
if ARCH_IOP3XX

menu "IOP3xx Implementation Options"

choice
	prompt "IOP3xx System Type"
	default ARCH_IQ80321

config ARCH_IQ80321
	bool "IQ80321"
	help
	  Say Y here if you want to run your kernel on the Intel IQ80321
	  evaluation kit for the IOP321 chipset.
endchoice

# Which IOP variant are we running?
config ARCH_IOP321
	bool
	default ARCH_IQ80321
	help
	  The IQ80321 uses the IOP321 variant.

comment "IOP3xx Chipset Features"

config IOP3XX_AAU
	bool "Support Intel IOP3xx Application Accelerator Unit (EXPERIMENTAL)"
	depends on EXPERIMENTAL

config IOP3XX_DMA
	bool "Support Intel IOP3xx DMA (EXPERIMENTAL)"
	depends on EXPERIMENTAL

endmenu

endif
```

## arch/arm/mach-lh7a40x/Kconfig
```kconfig
menu "LH7A40X Implementations"

config MACH_KEV7A400
	bool "KEV7A400"
	depends on ARCH_LH7A40X
	select ARCH_LH7A400
	help
	  Say Y here if you are using the Sharp KEV7A400 development
	  board.  This hardware is discontinued, so I'd be very
	  suprised if you wanted this option.

config MACH_LPD7A400
	bool "LPD7A400 Card Engine"
	depends on ARCH_LH7A40X
	select ARCH_LH7A400
	select IDE_POLL
	help
	  Say Y here if you are using Logic Product Development's
	  LPD7A400 CardEngine.  For the time being, the LPD7A400 and
	  LPD7A404 options are mutually exclusive.

config MACH_LPD7A404
	bool "LPD7A404 Card Engine"
	depends on ARCH_LH7A40X
	select ARCH_LH7A404
	select IDE_POLL
	help
	  Say Y here if you are using Logic Product Development's
	  LPD7A404 CardEngine. For the time being, the LPD7A400 and
	  LPD7A404 options are mutually exclusive.

config ARCH_LH7A400
	bool

config ARCH_LH7A404
	bool

endmenu
```

## arch/arm/mach-omap/Kconfig
```kconfig
menu "TI OMAP Implementations"

choice
	prompt "OMAP Core Type"
	depends on ARCH_OMAP
	default ARCH_OMAP1510

config ARCH_OMAP1510
	bool "OMAP-1510 Based System"
	select CPU_ARM925T
	select CPU_DCACHE_WRITETHROUGH

config ARCH_OMAP1610
	bool "OMAP-1610 Based System"
	select CPU_ARM926T

endchoice

choice
	prompt "OMAP Board Type"
	depends on ARCH_OMAP
	default MACH_OMAP_INNOVATOR

config MACH_OMAP_INNOVATOR
	bool "TI Innovator"
	depends on ARCH_OMAP1510 || ARCH_OMAP1610
	help
          TI OMAP 1510 or 1610 Innovator board support. Say Y here if you
          have such a board.

config MACH_OMAP_GENERIC
	bool "Generic OMAP board"
	depends on ARCH_OMAP1510 || ARCH_OMAP1610
	help
          Support for generic OMAP-1510 or 1610 board with no
          FPGA. Can be used as template for porting Linux to
          custom OMAP boards. Say Y here if you have a custom
          board.

endchoice

comment "OMAP Feature Selections"

config MACH_OMAP_H2
	bool "TI H2 Support"
	depends on ARCH_OMAP1610 && MACH_OMAP_INNOVATOR
    	help
	  TI OMAP 1610 H2 board support. Say Y here if you have such
	  a board.

config OMAP_MUX
	bool "OMAP multiplexing support"
        depends on ARCH_OMAP
	default y
        help
          Pin multiplexing support for OMAP boards. If your bootloader
          sets the multiplexing correctly, say N. Otherwise, or if unsure,
          say Y.

config OMAP_MUX_DEBUG
	bool "Multiplexing debug output"
        depends on OMAP_MUX
        default n
        help
          Makes the multiplexing functions print out a lot of debug info.
          This is useful if you want to find out the correct values of the
          multiplexing registers.

config OMAP_ARM_195MHZ
	bool "OMAP ARM 195 MHz CPU"
	depends on ARCH_OMAP730
	help
          Enable 195MHz clock for OMAP CPU. If unsure, say N.

config OMAP_ARM_192MHZ
	bool "OMAP ARM 192 MHz CPU"
	depends on ARCH_OMAP1610
	help
          Enable 192MHz clock for OMAP CPU. If unsure, say N.

config OMAP_ARM_182MHZ
	bool "OMAP ARM 182 MHz CPU"
	depends on ARCH_OMAP730
	help
          Enable 182MHz clock for OMAP CPU. If unsure, say N.

config OMAP_ARM_168MHZ
	bool "OMAP ARM 168 MHz CPU"
	depends on ARCH_OMAP1510 || ARCH_OMAP1610 || ARCH_OMAP730
	help
          Enable 168MHz clock for OMAP CPU. If unsure, say N.

config OMAP_ARM_120MHZ
	bool "OMAP ARM 120 MHz CPU"
	depends on ARCH_OMAP1510 || ARCH_OMAP1610 || ARCH_OMAP730
	help
          Enable 120MHz clock for OMAP CPU. If unsure, say N.

config OMAP_ARM_60MHZ
	bool "OMAP ARM 60 MHz CPU"
	depends on ARCH_OMAP1510 || ARCH_OMAP1610 || ARCH_OMAP730
        default y
	help
          Enable 60MHz clock for OMAP CPU. If unsure, say Y.

config OMAP_ARM_30MHZ
	bool "OMAP ARM 30 MHz CPU"
	depends on ARCH_OMAP1510 || ARCH_OMAP1610 || ARCH_OMAP730
	help
          Enable 30MHz clock for OMAP CPU. If unsure, say N.

endmenu
```

## arch/arm/mach-pxa/Kconfig
```kconfig
menu "Intel PXA2xx Implementations"

choice
	prompt "Select target board"
	depends on ARCH_PXA

config ARCH_LUBBOCK
	bool "Intel DBPXA250 Development Platform"
	select PXA25x

config MACH_MAINSTONE
	bool "Intel HCDDBBVA0 Development Platform"
	select PXA27x
	#select IWMMXT

config ARCH_PXA_IDP
	bool "Accelent Xscale IDP"
	select PXA25x

endchoice

endmenu

config PXA25x
	bool
	help
	  Select code specific to PXA21x/25x/26x variants

config PXA27x
	bool
	help
	  Select code specific to PXA27x variants
```

## arch/arm/mach-s3c2410/Kconfig
```kconfig
if ARCH_S3C2410

menu "S3C2410 Implementations"

config ARCH_BAST
	bool "Simtec Electronics BAST (EB2410ITX)"
	help
	  Say Y here if you are using the Simtec Electronics EB2410ITX
	  development board (also known as BAST)

	  Product page: <http://www.simtec.co.uk/products/EB2410ITX/>.

config ARCH_H1940
	bool "IPAQ H1940"
	help
	  Say Y here if you are using the HP IPAQ H1940
	  <http://www.handhelds.org/projects/h1940.html>.

config ARCH_SMDK2410
	bool "SMDK2410/A9M2410"
	help
	   Say Y here if you are using the SMDK2410 or the derived module A9M2410
           <http://www.fsforth.de>

config MACH_VR1000
	bool "Thorcom VR1000"
	help
	  Say Y here if you are using the Thorcom VR1000 board.

	  This linux port is currently being maintained by Simtec, on behalf
	  of Thorcom. Any queries, please contact Thorcom first.

endmenu

comment "S3C2410 Setup"

config S3C2410_DMA
	bool "S3C2410 DMA support"
	depends on ARCH_S3C2410
	help
	  S3C2410 DMA support. This is needed for drivers like sound which
	  use the S3C2410's DMA system to move data to and from the
	  peripheral blocks.

config S3C2410_DMA_DEBUG
	bool "S3C2410 DMA support debug"
	depends on ARCH_S3C2410 && S3C2410_DMA
	help
	  Enable debugging output for the DMA code. This option sends info
	  to the kernel log, at priority KERN_DEBUG.

	  Note, it is easy to create and fill the log buffer in a small
	  amount of time, as well as using an significant percantage of
	  the CPU time doing so.


endif
```
