## arch/arm/mach-sa1100/Config.in
```kconfig
mainmenu_option next_comment
comment 'SA11x0 Implementations'
dep_bool '  Assabet' CONFIG_SA1100_ASSABET $CONFIG_ARCH_SA1100
dep_bool '    Include support for Neponset' CONFIG_ASSABET_NEPONSET $CONFIG_SA1100_ASSABET
dep_bool '  ADS Bitsy' CONFIG_SA1100_ADSBITSY $CONFIG_ARCH_SA1100
dep_bool '  Brutus' CONFIG_SA1100_BRUTUS $CONFIG_ARCH_SA1100
dep_bool '  CerfBoard' CONFIG_SA1100_CERF $CONFIG_ARCH_SA1100
if [ "$CONFIG_SA1100_CERF" = "y" ]; then
   choice 'Cerf Flash available'  \
        "8MB    CONFIG_SA1100_CERF_FLASH_8MB \
         16MB   CONFIG_SA1100_CERF_FLASH_16MB \
         32MB   CONFIG_SA1100_CERF_FLASH_32MB" 8MB
   bool 'Cerf w/CPLD support (CerfPDA)' CONFIG_SA1100_CERF_CPLD
fi
dep_bool '  Compaq iPAQ H3100' CONFIG_SA1100_H3100 $CONFIG_ARCH_SA1100
dep_bool '  Compaq iPAQ H3600/H3700' CONFIG_SA1100_H3600 $CONFIG_ARCH_SA1100
dep_bool '  Compaq iPAQ H3800' CONFIG_SA1100_H3800 $CONFIG_ARCH_SA1100
if [ "$CONFIG_SA1100_H3100" = "y" -o "$CONFIG_SA1100_H3600" = "y" -o "$CONFIG_SA1100_H3800" = "y" ]; then
  define_bool CONFIG_SA1100_H3XXX y
else
  define_bool CONFIG_SA1100_H3XXX n
fi
#dep_bool '  Consus' CONFIG_SA1100_CONSUS $CONFIG_ARCH_SA1100
#dep_bool '  Empeg' CONFIG_SA1100_EMPEG $CONFIG_ARCH_SA1100
dep_bool '  Extenex HandHeld Theater (Squashtail)' CONFIG_SA1100_EXTENEX1 $CONFIG_ARCH_SA1100
if [ "$CONFIG_SA1100_EXTENEX1" = "y" ]; then
   bool '    Support 16 MB of DRAM (not just 8)' CONFIG_SA1100_EXTENEX1_16MB
fi
dep_bool '  FlexaNet' CONFIG_SA1100_FLEXANET $CONFIG_ARCH_SA1100
dep_bool '  FreeBird-v1.1' CONFIG_SA1100_FREEBIRD $CONFIG_ARCH_SA1100
dep_bool '  GraphicsClient Plus' CONFIG_SA1100_GRAPHICSCLIENT $CONFIG_ARCH_SA1100
dep_bool '  GraphicsMaster' CONFIG_SA1100_GRAPHICSMASTER $CONFIG_ARCH_SA1100
dep_bool '  HP Labs BadgePAD 4' CONFIG_SA1100_BADGE4 $CONFIG_ARCH_SA1100
dep_bool '  HP Jornada 720' CONFIG_SA1100_JORNADA720 $CONFIG_ARCH_SA1100
dep_bool '  HuW WebPanel' CONFIG_SA1100_HUW_WEBPANEL $CONFIG_ARCH_SA1100
dep_bool '  Itsy' CONFIG_SA1100_ITSY $CONFIG_ARCH_SA1100
dep_bool '  LART' CONFIG_SA1100_LART $CONFIG_ARCH_SA1100
dep_bool '  nanoEngine' CONFIG_SA1100_NANOENGINE $CONFIG_ARCH_SA1100
dep_bool '  OmniMeter' CONFIG_SA1100_OMNIMETER $CONFIG_ARCH_SA1100
dep_bool '  Pangolin' CONFIG_SA1100_PANGOLIN $CONFIG_ARCH_SA1100
dep_bool '  PLEB' CONFIG_SA1100_PLEB $CONFIG_ARCH_SA1100
dep_bool '  PT System 3' CONFIG_SA1100_PT_SYSTEM3 $CONFIG_ARCH_SA1100
dep_bool '  Shannon' CONFIG_SA1100_SHANNON $CONFIG_ARCH_SA1100
dep_bool '  Sherman' CONFIG_SA1100_SHERMAN $CONFIG_ARCH_SA1100
dep_bool '  Simpad' CONFIG_SA1100_SIMPAD $CONFIG_ARCH_SA1100
dep_bool '  Tulsa' CONFIG_SA1100_PFS168 $CONFIG_ARCH_SA1100
dep_bool '  Victor' CONFIG_SA1100_VICTOR $CONFIG_ARCH_SA1100
dep_bool '  XP860' CONFIG_SA1100_XP860 $CONFIG_ARCH_SA1100
dep_bool '  Yopy' CONFIG_SA1100_YOPY $CONFIG_ARCH_SA1100
dep_bool '  Stork' CONFIG_SA1100_STORK $CONFIG_ARCH_SA1100

dep_tristate 'SA1100 USB function support' CONFIG_SA1100_USB $CONFIG_ARCH_SA1100
dep_tristate '  Support for SA11x0 USB network link function' CONFIG_SA1100_USB_NETLINK $CONFIG_SA1100_USB
dep_tristate '  Support for SA11x0 USB character device emulation' CONFIG_SA1100_USB_CHAR $CONFIG_SA1100_USB

dep_tristate 'Compaq iPAQ Handheld sleeve support' CONFIG_H3600_SLEEVE $CONFIG_SA1100_H3600
endmenu
```

## arch/arm/mach-sa1100/Kconfig
```kconfig
menu "SA11x0 Implementations"

config SA1100_ASSABET
	bool "Assabet"
	depends on ARCH_SA1100
	help
	  Say Y here if you are using the Intel(R) StrongARM(R) SA-1110
	  Microprocessor Development Board (also known as the Assabet).

config ASSABET_NEPONSET
	bool "Include support for Neponset"
	depends on SA1100_ASSABET
	help
	  Say Y here if you are using the Intel(R) StrongARM(R) SA-1110
	  Microprocessor Development Board (Assabet)  with the SA-1111
	  Development Board (Nepon).

config SA1100_ADSBITSY
	bool "ADS Bitsy"
	depends on ARCH_SA1100
	help
	  Say Y here if you are using Applied Data Systems Intel(R)
	  StrongARM(R) 1110 based Bitsy, 3 x 5 inches in size, Compaq - IPAQ -
	  like platform. See
	  <http://www.applieddata.net/products_bitsySpec.asp> for more
	  information.

config SA1100_BRUTUS
	bool "Brutus"
	depends on ARCH_SA1100
	help
	  Say Y here if you are using the Intel(R) StrongARM(R) SA-1100
	  Microprocessor Development Board (also known as the Brutus).

config SA1100_CERF
	bool "CerfBoard"
	depends on ARCH_SA1100
	help
	  The Intrinsyc CerfBoard is based on the StrongARM 1110.
	  More information is available at:
	  <http://www.intrinsyc.com/products/referenceplatforms/cerfboard.html>.

	  Say Y if configuring for an Intrinsyc CerfBoard.
	  Say N otherwise.

choice
	prompt "Cerf Flash available"
	depends on SA1100_CERF
	default SA1100_CERF_FLASH_8MB

config SA1100_CERF_FLASH_8MB
	bool "8MB"

config SA1100_CERF_FLASH_16MB
	bool "16MB"

config SA1100_CERF_FLASH_32MB
	bool "32MB"

endchoice

config SA1100_CERF_CPLD
	bool "Cerf w/CPLD support (CerfPDA)"
	depends on SA1100_CERF
	help
	  Say Y here to support the Linux CerfPDA development kit from
	  Intrinsyc. This is a StrongARM-1110-based reference platform for
	  designing custom PDAs.  Product info is at
	  <http://www.intrinsyc.com/products/referencedesigns/cerfpda.asp>.

config SA1100_H3100
	bool "Compaq iPAQ H3100"
	depends on ARCH_SA1100
	help
	  Say Y here if you intend to run this kernel on the Compaq iPAQ
	  H3100 handheld computer.  Information about this machine and the
	  Linux port to this machine can be found at:

	  <http://www.handhelds.org/Compaq/index.html#iPAQ_H3100>
	  <http://www.compaq.com/products/handhelds/pocketpc/>

config SA1100_H3600
	bool "Compaq iPAQ H3600/H3700"
	depends on ARCH_SA1100
	help
	  Say Y here if you intend to run this kernel on the Compaq iPAQ
	  H3600 handheld computer.  Information about this machine and the
	  Linux port to this machine can be found at:

	  <http://www.handhelds.org/Compaq/index.html#iPAQ_H3600>
	  <http://www.compaq.com/products/handhelds/pocketpc/>

config SA1100_H3800
	bool "Compaq iPAQ H3800"
	depends on ARCH_SA1100
	help
	  Say Y here if you intend to run this kernel on the Compaq iPAQ H3800
	  series handheld computer.  Information about this machine and the
	  Linux port to this machine can be found at:

	  <http://www.handhelds.org/Compaq/index.html#iPAQ_H3800>
	  <http://www.compaq.com/products/handhelds/pocketpc/>

config SA1100_H3XXX
	bool
	depends on SA1100_H3100 || SA1100_H3600 || SA1100_H3800
	default y

#dep_bool '  Consus' CONFIG_SA1100_CONSUS $CONFIG_ARCH_SA1100
#dep_bool '  Empeg' CONFIG_SA1100_EMPEG $CONFIG_ARCH_SA1100
config SA1100_EXTENEX1
	bool "Extenex HandHeld Theater (Squashtail)"
	depends on ARCH_SA1100

config SA1100_EXTENEX1_16MB
	bool "Support 16 MB of DRAM (not just 8)"
	depends on SA1100_EXTENEX1

config SA1100_FLEXANET
	bool "FlexaNet"
	depends on ARCH_SA1100
	help
	  Say Y here if you intend to run this kernel on the FlexaNet
	  handheld instruments. Information about this machine can be
	  found at: <http://www.flexanet.com/>.

config SA1100_FREEBIRD
	bool "FreeBird-v1.1"
	depends on ARCH_SA1100
	help
	  Support the FreeBird board used in Coventive embedded products.  See
	  Documentation/arm/SA1100/Freebird for more.

config SA1100_GRAPHICSCLIENT
	bool "GraphicsClient Plus"
	depends on ARCH_SA1100
	help
	  Say Y here if you are using an Applied Data Systems Intel(R)
	  StrongARM(R) SA-1100 based Graphics Client SBC.  See
	  <http://www.flatpanels.com/> for information on this system.

config SA1100_GRAPHICSMASTER
	bool "GraphicsMaster"
	depends on ARCH_SA1100
	help
	  Say Y here if you are using an Applied Data Systems Intel(R)
	  StrongARM(R) SA-1100 based Graphics Master SBC with SA-1111
	  StrongARM companion chip.  See
	  <http://www.applieddata.net/products_masterSpec.asp> for information
	  on this system.

config SA1100_BADGE4
	bool "HP Labs BadgePAD 4"
	depends on ARCH_SA1100
	help
	  Say Y here if you want to build a kernel for the HP Laboratories
	  BadgePAD 4.

config SA1100_JORNADA720
	bool "HP Jornada 720"
	depends on ARCH_SA1100
	help
	  Say Y here if you want to build a kernel for the HP Jornada 720
	  handheld computer.  See <http://www.hp.com/jornada/products/720>
	  for details.

config SA1100_HACKKIT
	bool "HackKit Core CPU Board"
	depends on ARCH_SA1100
	help
	  Say Y here to support the HackKit Core CPU Board
	  <http://hackkit.eletztrick.de>;

config SA1100_HUW_WEBPANEL
	bool "HuW WebPanel"
	depends on ARCH_SA1100
	help
	  Say Y here to support the HuW Webpanel produced by Hoeft & Wessel
	  AG.  English-language website is at
	  <http://www.hoeft-wessel.de/en.htm>; credits and build instructions
	  at Documentation/arm/SA1100/HUW_WEBPANEL.

config SA1100_ITSY
	bool "Itsy"
	depends on ARCH_SA1100
	help
	  Say Y here if you are using the Compaq Itsy experimental pocket
	  computer. See <http://research.compaq.com/wrl/projects/itsy/> for
	  more information.

config SA1100_LART
	bool "LART"
	depends on ARCH_SA1100
	help
	  Say Y here if you are using the Linux Advanced Radio Terminal
	  (also known as the LART).  See <http://www.lart.tudelft.nl/> for
	  information on the LART.

config SA1100_NANOENGINE
	bool "nanoEngine"
	depends on ARCH_SA1100
	help
	  The nanoEngine is a StrongARM 1110-based single board computer
	  from Bright Star Engineering. More information is available at:
	  <http://www.brightstareng.com/arm/nanoeng.htm>.

	  Say Y if configuring for a nanoEngine.
	  Say N otherwise.

config SA1100_OMNIMETER
	bool "OmniMeter"
	depends on ARCH_SA1100
	help
	  Say Y here if you are using the inhand electronics OmniMeter.  See
	  <http://www.inhandelectronics.com/html/omni1.html> for details.

config SA1100_PANGOLIN
	bool "Pangolin"
	depends on ARCH_SA1100
	help
	  Pangolin is a StrongARM 1110-based evaluation platform produced
	  by Dialogue Technology.  It has EISA slots for ease of configuration
	  with SDRAM/Flash memory card, USB/Serial/Audio card, Compact Flash
	  card, and TFT-LCD card.

	  Say Y if configuring for a Pangolin.
	  Say N otherwise.

config SA1100_PLEB
	bool "PLEB"
	depends on ARCH_SA1100
	help
	  Say Y here if you are using a Portable Linux Embedded Board
	  (also known as PLEB). See <http://www.cse.unsw.edu.au/~pleb/>
	  for more information.

config SA1100_PT_SYSTEM3
	bool "PT System 3"
	depends on ARCH_SA1100
	help
	  Say Y here if you intend to build a kernel suitable to run on
	  a Pruftechnik Digital Board. For more information see
	  <http://www.pruftechnik.com>

config SA1100_SHANNON
	bool "Shannon"
	depends on ARCH_SA1100
	help
	  The Shannon (also known as a Tuxscreen, and also as a IS2630) was a
	  limited edition webphone produced by Philips. The Shannon is a SA1100
	  platform with a 640x480 LCD, touchscreen, CIR keyboard, PCMCIA slots,
	  and a telco interface.

config SA1100_SHERMAN
	bool "Sherman"
	depends on ARCH_SA1100
	help
	  Say Y here to support the Blazie Engineering `Sherman' StrongARM
	  1110-based SBC, used primarily in assistance products for the
	  visually impaired.  The company is now Freedom Scientific, with
	  a website at <http://www.freedomscientific.com/index.html>. The
	  Sherman product, however, appears to have been discontinued.

config SA1100_SIMPAD
	bool "Simpad"
	depends on ARCH_SA1100
	help
	  The SIEMENS webpad SIMpad is based on the StrongARM 1110. There
	  are two different versions CL4 and SL4. CL4 has 32MB RAM and 16MB
	  FLASH. The SL4 version got 64 MB RAM and 32 MB FLASH and a
	  PCMCIA-Slot. The version for the Germany Telecom (DTAG) is the same
	  like CL4 in additional it has a PCMCIA-Slot. For more information
	  visit <http://www.my-siemens.com or www.siemens.ch>.

config SA1100_PFS168
	bool "Tulsa"
	depends on ARCH_SA1100
	help
	  The Radisys Corp. PFS-168 (aka Tulsa) is an Intel® StrongArm® SA-1110 based
	  computer which includes the SA-1111 Microprocessor Companion Chip and other
	  custom I/O designed to add connectivity and multimedia features for vending
	  and business machine applications. Say Y here if you require support for
	  this target.

config SA1100_VICTOR
	bool "Victor"
	depends on ARCH_SA1100
	help
	  Say Y here if you are using a Visu Aide Intel(R) StrongARM(R)
	  SA-1100 based Victor Digital Talking Book Reader.  See
	  <http://www.visuaide.com/pagevictor.en.html> for information on
	  this system.

config SA1100_XP860
	bool "XP860"
	depends on ARCH_SA1100
	help
	  :: Config help missing ::
	  :: 06 August 2002 ::

config SA1100_YOPY
	bool "Yopy"
	depends on ARCH_SA1100
	help
	  Say Y here to support the Yopy PDA.  Product information at
	  <http://www.yopy.com/>.  See Documentation/arm/SA110/Yopy
	  for more.

config SA1100_STORK
	bool "Stork"
	depends on ARCH_SA1100
	help
	  Say Y here if you intend to run this kernel on the Stork
	  handheld computer.

#config SA1100_TRIZEPS
#	bool "Trizeps"
#	depends on ARCH_SA1100
#	help
#	  :: write me ::

#config TRIZEPS_MFTB2
#	bool "MFTB2"
#	depends on SA1100_TRIZEPS
#	help
#	  :: write me ::

config SA1100_SSP
	tristate "Generic PIO SSP"
	depends on ARCH_SA1100
	help
	  Say Y here to enable support for the generic PIO SSP driver.
	  This isn't for audio support, but for attached sensors and
	  other devices, eg for BadgePAD 4 sensor support, or Jornada
	  720 touchscreen support.

config SA1100_USB
	tristate "SA1100 USB function support"
	depends on ARCH_SA1100

config SA1100_USB_NETLINK
	tristate "Support for SA11x0 USB network link function"
	depends on SA1100_USB

config SA1100_USB_CHAR
	tristate "Support for SA11x0 USB character device emulation"
	depends on SA1100_USB

config H3600_SLEEVE
	tristate "Compaq iPAQ Handheld sleeve support"
	depends on SA1100_H3600
	help
	  Choose this option to enable support for extension packs (sleeves)
	  for the Compaq iPAQ H3XXX series of handheld computers.  This option
	  is required for the CF, PCMCIA, Bluetooth and GSM/GPRS extension
	  packs.

endmenu
```
