## arch/ia64/Kconfig.debug
```kconfig
menu "Kernel hacking"

source "lib/Kconfig.debug"

config KPROBES
        bool "Kprobes"
        depends on DEBUG_KERNEL
        help
          Kprobes allows you to trap at almost any kernel address and
          execute a callback function.  register_kprobe() establishes
          a probepoint and specifies the callback.  Kprobes is useful
          for kernel debugging, non-intrusive instrumentation and testing.
          If in doubt, say "N".


choice
	prompt "Physical memory granularity"
	default IA64_GRANULE_64MB

config IA64_GRANULE_16MB
	bool "16MB"
	help
	  IA-64 identity-mapped regions use a large page size called "granules".

	  Select "16MB" for a small granule size.
	  Select "64MB" for a large granule size.  This is the current default.

config IA64_GRANULE_64MB
	bool "64MB"
	depends on !(IA64_GENERIC || IA64_HP_ZX1 || IA64_HP_ZX1_SWIOTLB || IA64_SGI_SN2)

endchoice

config IA64_PRINT_HAZARDS
	bool "Print possible IA-64 dependency violations to console"
	depends on DEBUG_KERNEL
	help
	  Selecting this option prints more information for Illegal Dependency
	  Faults, that is, for Read-after-Write (RAW), Write-after-Write (WAW),
	  or Write-after-Read (WAR) violations.  This option is ignored if you
	  are compiling for an Itanium A step processor
	  (CONFIG_ITANIUM_ASTEP_SPECIFIC).  If you're unsure, select Y.

config DISABLE_VHPT
	bool "Disable VHPT"
	depends on DEBUG_KERNEL
	help
	  The Virtual Hash Page Table (VHPT) enhances virtual address
	  translation performance.  Normally you want the VHPT active but you
	  can select this option to disable the VHPT for debugging.  If you're
	  unsure, answer N.

config IA64_DEBUG_CMPXCHG
	bool "Turn on compare-and-exchange bug checking (slow!)"
	depends on DEBUG_KERNEL
	help
	  Selecting this option turns on bug checking for the IA-64
	  compare-and-exchange instructions.  This is slow!  Itaniums
	  from step B3 or later don't have this problem. If you're unsure,
	  select N.

config IA64_DEBUG_IRQ
	bool "Turn on irq debug checks (slow!)"
	depends on DEBUG_KERNEL
	help
	  Selecting this option turns on bug checking for the IA-64 irq_save
	  and restore instructions.  It's useful for tracking down spinlock
	  problems, but slow!  If you're unsure, select N.

config KDB
	bool "Built-in Kernel Debugger support"
	depends on DEBUG_KERNEL
	select KALLSYMS
	select KALLSYMS_ALL
	help
	  This option provides a built-in kernel debugger.  The built-in
	  kernel debugger contains commands which allow memory to be examined,
	  instructions to be disassembled and breakpoints to be set.  For details,
	  see Documentation/kdb/kdb.mm and the manual pages kdb_bt, kdb_ss, etc.
	  Kdb can also be used via the serial port.  Set up the system to
	  have a serial console (see Documentation/serial-console.txt).
	  The key sequence <escape>KDB on the serial port will cause the
	  kernel debugger to be entered with input from the serial port and
	  output to the serial console.  If unsure, say N.

config KDB_MODULES
	tristate "KDB modules"
	depends on KDB
	help
	  KDB can be extended by adding your own modules, in directory
	  kdb/modules.  This option selects the way that these modules should
	  be compiled, as free standing modules (select M) or built into the
	  kernel (select Y).  If unsure say M.

config KDB_OFF
	bool "KDB off by default"
	depends on KDB
	help
	  Normally kdb is activated by default, as long as CONFIG_KDB is set.
	  If you want to ship a kernel with kdb support but only have kdb
	  turned on when the user requests it then select this option.  When
	  compiled with CONFIG_KDB_OFF, kdb ignores all events unless you boot
	  with kdb=on or you echo "1" > /proc/sys/kernel/kdb.  This option also
	  works in reverse, if kdb is normally activated, you can boot with
	  kdb=off or echo "0" > /proc/sys/kernel/kdb to deactivate kdb. If
	  unsure, say N.

config KDB_CONTINUE_CATASTROPHIC
	int "KDB continues after catastrophic errors"
	depends on KDB
	default "0"
	help
	  This integer controls the behaviour of kdb when the kernel gets a
	  catastrophic error, i.e. for a panic, oops, NMI or other watchdog
	  tripping.  CONFIG_KDB_CONTINUE_CATASTROPHIC interacts with
	  /proc/sys/kernel/kdb and CONFIG_CRASH_DUMP (if your kernel has the
	  LKCD patch).
	  When KDB is active (/proc/sys/kernel/kdb == 1) and a catastrophic
	  error occurs, nothing extra happens until you type 'go'.
	  CONFIG_KDB_CONTINUE_CATASTROPHIC == 0 (default).  The first time
	  you type 'go', kdb warns you.  The second time you type 'go', KDB
	  tries to continue - no guarantees that the kernel is still usable.
	  CONFIG_KDB_CONTINUE_CATASTROPHIC == 1.  KDB tries to continue - no
	  guarantees that the kernel is still usable.
	  CONFIG_KDB_CONTINUE_CATASTROPHIC == 2.  If your kernel has the LKCD
	  patch and LKCD is configured to take a dump then KDB forces a dump.
	  Whether or not a dump is taken, KDB forces a reboot.
	  When KDB is not active (/proc/sys/kernel/kdb == 0) and a catastrophic
	  error occurs, the following steps are automatic, no human
	  intervention is required.
	  CONFIG_KDB_CONTINUE_CATASTROPHIC == 0 (default) or 1.  KDB attempts
	  to continue - no guarantees that the kernel is still usable.
	  CONFIG_KDB_CONTINUE_CATASTROPHIC == 2.  If your kernel has the LKCD
	  patch and LKCD is configured to take a dump then KDB automatically
	  forces a dump.  Whether or not a dump is taken, KDB forces a
	  reboot.
	  If you are not sure, say 0.  Read Documentation/kdb/dump.txt before
	  setting to 2.

config KDB_USB
	bool "Support for USB Keyboard in KDB (OHCI only)"
	depends on KDB && USB_OHCI_HCD
	help
	  If you want to use kdb from a OHCI USB keyboard then say Y here.  If you
	  say N then kdb can only be used from a PC (AT) keyboard or a serial
	  console.

config SYSVIPC_COMPAT
	bool
	depends on COMPAT && SYSVIPC
	default y

endmenu
```

## arch/ia64/config.in
```kconfig
mainmenu_name "IA-64 Linux Kernel Configuration"

source init/Config.in

mainmenu_option next_comment
comment 'Processor type and features'

define_bool CONFIG_IA64 y

define_bool CONFIG_ISA n
define_bool CONFIG_EISA n
define_bool CONFIG_MCA n
define_bool CONFIG_SBUS n
define_bool CONFIG_RWSEM_GENERIC_SPINLOCK y
define_bool CONFIG_RWSEM_XCHGADD_ALGORITHM n

choice 'IA-64 processor type' \
	"Itanium			CONFIG_ITANIUM \
	 Itanium-2			CONFIG_MCKINLEY" Itanium

choice 'IA-64 system type'					\
	"generic		CONFIG_IA64_GENERIC		\
	 DIG-compliant		CONFIG_IA64_DIG			\
	 HP-simulator		CONFIG_IA64_HP_SIM		\
	 HP-zx1			CONFIG_IA64_HP_ZX1		\
	 SGI-SN1		CONFIG_IA64_SGI_SN1		\
	 SGI-SN2		CONFIG_IA64_SGI_SN2" generic

if [ "$CONFIG_ITANIUM" = "y" ]; then
  choice 'Kernel page size'						\
	"4KB			CONFIG_IA64_PAGE_SIZE_4KB		\
	 8KB			CONFIG_IA64_PAGE_SIZE_8KB		\
	 16KB			CONFIG_IA64_PAGE_SIZE_16KB" 16KB
else
  choice 'Kernel page size'						\
	"4KB			CONFIG_IA64_PAGE_SIZE_4KB		\
	 8KB			CONFIG_IA64_PAGE_SIZE_8KB		\
	 16KB			CONFIG_IA64_PAGE_SIZE_16KB		\
	 64KB			CONFIG_IA64_PAGE_SIZE_64KB" 16KB
fi

if [ "$CONFIG_IA64_HP_SIM" = "n" ]; then
  define_bool CONFIG_ACPI y
  define_bool CONFIG_ACPI_EFI y
  define_bool CONFIG_ACPI_INTERPRETER y
  define_bool CONFIG_ACPI_KERNEL_CONFIG y
fi

if [ "$CONFIG_ITANIUM" = "y" ]; then
	define_bool CONFIG_IA64_BRL_EMU y
	bool '  Enable Itanium B-step specific code' CONFIG_ITANIUM_BSTEP_SPECIFIC
	if [ "$CONFIG_IA64_SGI_SN1" = "y" ]; then
	  define_int CONFIG_IA64_L1_CACHE_SHIFT 7 # align cache-sensitive data to 128 bytes
	else
	  define_int CONFIG_IA64_L1_CACHE_SHIFT 6 # align cache-sensitive data to 64 bytes
	fi
fi

if [ "$CONFIG_MCKINLEY" = "y" ]; then
	define_int CONFIG_IA64_L1_CACHE_SHIFT 7
	bool '  Enable McKinley A-step specific code' CONFIG_MCKINLEY_ASTEP_SPECIFIC
	if [ "$CONFIG_MCKINLEY_ASTEP_SPECIFIC" = "y" ]; then
	  bool '   Enable McKinley A0/A1-step specific code' CONFIG_MCKINLEY_A0_SPECIFIC
	fi
fi

if [ "$CONFIG_IA64_GENERIC" = "y" -o "$CONFIG_IA64_DIG" = "y" -o "$CONFIG_IA64_HP_ZX1" = "y" ];
then
	bool '  Enable IA-64 Machine Check Abort' CONFIG_IA64_MCA
	define_bool CONFIG_PM y
fi

if [ "$CONFIG_IA64_SGI_SN1" = "y" -o "$CONFIG_IA64_SGI_SN2" = "y" ]; then
	define_bool CONFIG_IA64_SGI_SN y
	bool '  Enable extra debugging code' CONFIG_IA64_SGI_SN_DEBUG n
	bool '  Enable SGI Medusa Simulator Support' CONFIG_IA64_SGI_SN_SIM
	bool '  Enable autotest (llsc). Option to run cache test instead of booting' \
			CONFIG_IA64_SGI_AUTOTEST n
	define_bool CONFIG_DEVFS_FS y
	if [ "$CONFIG_DEVFS_FS" = "y" ]; then
	  bool '    Enable DEVFS Debug Code' CONFIG_DEVFS_DEBUG n
	fi
	bool '  Enable protocol mode for the L1 console' CONFIG_SERIAL_SGI_L1_PROTOCOL y
	define_bool CONFIG_DISCONTIGMEM y
	define_bool CONFIG_IA64_MCA y
	define_bool CONFIG_NUMA y
	define_bool CONFIG_PERCPU_IRQ y
	tristate '  PCIBA support' CONFIG_PCIBA
fi

define_bool CONFIG_KCORE_ELF y	# On IA-64, we always want an ELF /proc/kcore.

bool 'SMP support' CONFIG_SMP
bool 'Support running of Linux/x86 binaries' CONFIG_IA32_SUPPORT
bool 'Performance monitor support' CONFIG_PERFMON
tristate '/proc/pal support' CONFIG_IA64_PALINFO
tristate '/proc/efi/vars support' CONFIG_EFI_VARS

tristate 'Kernel support for ELF binaries' CONFIG_BINFMT_ELF
tristate 'Kernel support for MISC binaries' CONFIG_BINFMT_MISC

if [ "$CONFIG_IA64_HP_SIM" = "n" ]; then
  source drivers/acpi/Config.in

  bool 'PCI support' CONFIG_PCI
  source drivers/pci/Config.in

  bool 'Support for hot-pluggable devices' CONFIG_HOTPLUG
  if [ "$CONFIG_HOTPLUG" = "y" ]; then
     source drivers/hotplug/Config.in
     source drivers/pcmcia/Config.in
  else
     define_bool CONFIG_PCMCIA n
  fi

  source drivers/parport/Config.in
fi # !HP_SIM

endmenu

if [ "$CONFIG_NET" = "y" ]; then
  source net/Config.in
fi

if [ "$CONFIG_IA64_HP_SIM" = "n" ]; then
  define_tristate CONFIG_BLK_DEV_LOOP n
  define_tristate CONFIG_BLK_DEV_NBD n
  define_tristate CONFIG_BLK_DEV_RAM n

  source drivers/mtd/Config.in
  source drivers/pnp/Config.in
  source drivers/block/Config.in
  source drivers/ieee1394/Config.in
  source drivers/message/i2o/Config.in
  source drivers/md/Config.in
  source drivers/message/fusion/Config.in

  mainmenu_option next_comment
  comment 'ATA/IDE/MFM/RLL support'

  tristate 'ATA/IDE/MFM/RLL support' CONFIG_IDE

  if [ "$CONFIG_IDE" != "n" ]; then
    source drivers/ide/Config.in
  else
    define_bool CONFIG_BLK_DEV_HD n
  fi
  endmenu
else # HP_SIM
  mainmenu_option next_comment
  comment 'Block devices'
  tristate 'Loopback device support' CONFIG_BLK_DEV_LOOP
  dep_tristate 'Network block device support' CONFIG_BLK_DEV_NBD $CONFIG_NET

  tristate 'RAM disk support' CONFIG_BLK_DEV_RAM
  if [ "$CONFIG_BLK_DEV_RAM" = "y" -o "$CONFIG_BLK_DEV_RAM" = "m" ]; then
    int '  Default RAM disk size' CONFIG_BLK_DEV_RAM_SIZE 4096
  fi
  endmenu
fi # HP_SIM

mainmenu_option next_comment
comment 'SCSI support'

tristate 'SCSI support' CONFIG_SCSI

if [ "$CONFIG_SCSI" != "n" ]; then
  source drivers/scsi/Config.in
fi
endmenu

if [ "$CONFIG_IA64_HP_SIM" = "n" ]; then
  if [ "$CONFIG_NET" = "y" ]; then
    mainmenu_option next_comment
    comment 'Network device support'

    bool 'Network device support' CONFIG_NETDEVICES
    if [ "$CONFIG_NETDEVICES" = "y" ]; then
      source drivers/net/Config.in
    fi
    endmenu
  fi

  source net/ax25/Config.in

  source drivers/isdn/Config.in

  mainmenu_option next_comment
  comment 'CD-ROM drivers (not for SCSI or IDE/ATAPI drives)'

  bool 'Support non-SCSI/IDE/ATAPI drives' CONFIG_CD_NO_IDESCSI
  if [ "$CONFIG_CD_NO_IDESCSI" != "n" ]; then
    source drivers/cdrom/Config.in
  fi
  endmenu
fi # !HP_SIM

#
# input before char - char/joystick depends on it. As does USB.
#
source drivers/input/Config.in
source drivers/char/Config.in

#source drivers/misc/Config.in

source drivers/media/Config.in

source fs/Config.in

if [ "$CONFIG_VT" = "y" ]; then
  mainmenu_option next_comment
  comment 'Console drivers'
  bool 'VGA text console' CONFIG_VGA_CONSOLE
  source drivers/video/Config.in
  if [ "$CONFIG_FB" = "y" ]; then
    define_bool CONFIG_PCI_CONSOLE y
  fi
  endmenu
fi

if [ "$CONFIG_IA64_HP_SIM" = "n" ]; then

  mainmenu_option next_comment
  comment 'Sound'

  tristate 'Sound card support' CONFIG_SOUND
  if [ "$CONFIG_SOUND" != "n" ]; then
    source sound/Config.in
  fi
  endmenu

  source drivers/usb/Config.in
  source lib/Config.in
  source net/bluetooth/Config.in
fi # !HP_SIM

if [ "$CONFIG_IA64_HP_SIM" != "n" -o "$CONFIG_IA64_GENERIC" != "n" ]; then
  source arch/ia64/hp/Config.in
fi


mainmenu_option next_comment
comment 'Kernel hacking'

choice 'Physical memory granularity'				\
	"16MB			CONFIG_IA64_GRANULE_16MB	\
	 64MB			CONFIG_IA64_GRANULE_64MB" 64MB

bool 'Kernel debugging' CONFIG_DEBUG_KERNEL
if [ "$CONFIG_DEBUG_KERNEL" != "n" ]; then
   bool '  Print possible IA64 hazards to console' CONFIG_IA64_PRINT_HAZARDS
   bool '  Disable VHPT' CONFIG_DISABLE_VHPT
   bool '  Magic SysRq key' CONFIG_MAGIC_SYSRQ

   bool '  Early printk support (requires VGA!)' CONFIG_IA64_EARLY_PRINTK
   bool '  Debug memory allocations' CONFIG_DEBUG_SLAB
   bool '  Spinlock debugging' CONFIG_DEBUG_SPINLOCK
   bool '  Turn on compare-and-exchange bug checking (slow!)' CONFIG_IA64_DEBUG_CMPXCHG
   bool '  Turn on irq debug checks (slow!)' CONFIG_IA64_DEBUG_IRQ
fi

endmenu
```
