## arch/cris/Kconfig
```kconfig
#
# For a description of the syntax of this configuration file,
# see the Configure script.
#

mainmenu "Linux/CRIS Kernel Configuration"

config MMU
	bool
	default y

config UID16
	bool
	default y

config RWSEM_GENERIC_SPINLOCK
	bool
	default y

config RWSEM_XCHGADD_ALGORITHM
	bool

source "init/Kconfig"


menu "General setup"

source "fs/Kconfig.binfmt"

config ETRAX_KGDB
	bool "Use kernel gdb debugger"
	---help---
	  The CRIS version of gdb can be used to remotely debug a running
	  Linux kernel via the serial debug port.  Provided you have gdb-cris
	  installed, run gdb-cris vmlinux, then type

	  (gdb) set remotebaud 115200           <- kgdb uses 115200 as default
	  (gdb) target remote /dev/ttyS0        <- maybe you use another port

	  This should connect you to your booted kernel (or boot it now if you
	  didn't before).  The kernel halts when it boots, waiting for gdb if
	  this option is turned on!

config ETRAX_WATCHDOG
	bool "Enable ETRAX watchdog"
	help
	  Enable the built-in watchdog timer support on ETRAX based embedded
	  network computers.

config ETRAX_WATCHDOG_NICE_DOGGY
	bool "Disable watchdog during Oops printouts"
	depends on ETRAX_WATCHDOG
	help
	  By enabling this you make sure that the watchdog does not bite while
	  printing oopses. Recommended for development systems but not for
	  production releases.

config ETRAX_FAST_TIMER
       bool "Enable ETRAX fast timer API"
       help
         This options enables the API to a fast timer implementation using
	 timer1 to get sub jiffie resolution timers (primarily one-shot 
	 timers).
	 This is needed if CONFIG_ETRAX_SERIAL_FAST_TIMER is enabled.

config PREEMPT
	bool "Preemptible Kernel"
	help
	  This option reduces the latency of the kernel when reacting to
	  real-time or interactive events by allowing a low priority process to
	  be preempted even if it is in kernel mode executing a system call.
	  This allows applications to run more reliably even when the system is
	  under load.

	  Say Y here if you are building a kernel for a desktop, embedded
	  or real-time system.  Say N if you are unsure.

endmenu


menu "Hardware setup"

choice
	prompt "Processor type"
	default ETRAX100LX

config ETRAX100LX
	bool "ETRAX-100LX-v1"
	help
	  Support version 1 of the ETRAX 100LX.

config ETRAX100LX_V2
	bool "ETRAX-100LX-v2"
	help
	  Support version 2 of the ETRAX 100LX.

config SVINTO_SIM
	bool "ETRAX-100LX-for-xsim-simulator"
	help
	  Support the xsim ETRAX Simulator.

config ETRAX200LX
	bool "ETRAX-200LX-V32"
	help
	  Support CRIS V32.

endchoice

config ETRAX_ARCH_V10
       bool
       default y if ETRAX100LX || ETRAX100LX_V2
       default n if !(ETRAX100LX || ETRAX100LX_V2) 

config ETRAX_ARCH_V32
       bool
       default y if ETRAX200LX
       default n if !(ETRAX200LX) 

config ETRAX_DRAM_SIZE
	int "DRAM size (dec, in MB)"
	default "8"
	help
	  Size of DRAM (decimal in MB) typically 2, 8 or 16.

config ETRAX_FLASH_BUSWIDTH
	int "Buswidth of flash in bytes"
	default "2"
	help
	  Width in bytes of the Flash bus (1, 2 or 4). Is usually 2.

config ETRAX_ROOT_DEVICE
	string "Root device name"
	default "/dev/mtdblock3"
	help
	  Specifies the device that should be mounted as root file system
	  when booting from flash. The axisflashmap driver adds an additional
	  mtd partition for the appended root file system image, so this option
	  should normally be the mtdblock device for the partition after the
	  last partition in the partition table.

# duplicate choice configs are not yet supported, so the followinguse 
# doesn't work:

source arch/cris/arch-v10/Kconfig

endmenu

# bring in ETRAX built-in drivers
menu "Drivers for built-in interfaces"

source arch/cris/arch-v10/drivers/Kconfig

endmenu

source "drivers/base/Kconfig"

# bring in Etrax built-in drivers
source "arch/cris/drivers/Kconfig"

# standard linux drivers
source "drivers/mtd/Kconfig"

source "drivers/parport/Kconfig"

source "drivers/pnp/Kconfig"

source "drivers/block/Kconfig"

source "drivers/md/Kconfig"

source "drivers/ide/Kconfig"

source "drivers/scsi/Kconfig"

source "drivers/ieee1394/Kconfig"

source "drivers/message/i2o/Kconfig"

source "net/Kconfig"

source "drivers/isdn/Kconfig"

source "drivers/telephony/Kconfig"

source "drivers/cdrom/Kconfig"

#
# input before char - char/joystick depends on it. As does USB.
#
source "drivers/input/Kconfig"

source "drivers/char/Kconfig"

#source drivers/misc/Config.in
source "drivers/media/Kconfig"

source "fs/Kconfig"

source "sound/Kconfig"

source "drivers/usb/Kconfig"


menu "Kernel hacking"

#bool 'Debug kmalloc/kfree' CONFIG_DEBUG_MALLOC
config PROFILE
	bool "Kernel profiling support"

config PROFILE_SHIFT
	int "Profile shift count"
	depends on PROFILE
	default "2"

endmenu

source "security/Kconfig"

source "crypto/Kconfig"

source "lib/Kconfig"
```

## arch/cris/Kconfig.debug
```kconfig
menu "Kernel hacking"

source "lib/Kconfig.debug"

#bool 'Debug kmalloc/kfree' CONFIG_DEBUG_MALLOC
config PROFILE
	bool "Kernel profiling support"

config PROFILE_SHIFT
	int "Profile shift count"
	depends on PROFILE
	default "2"

config ETRAX_KGDB
	bool "Use kernel GDB debugger"
	---help---
	  The CRIS version of gdb can be used to remotely debug a running
	  Linux kernel via the serial debug port.  Provided you have gdb-cris
	  installed, run gdb-cris vmlinux, then type

	  (gdb) set remotebaud 115200           <- kgdb uses 115200 as default
	  (gdb) target remote /dev/ttyS0        <- maybe you use another port

	  This should connect you to your booted kernel (or boot it now if you
	  didn't before).  The kernel halts when it boots, waiting for gdb if
	  this option is turned on!

endmenu
```

## arch/cris/config.in
```kconfig
#
# For a description of the syntax of this configuration file,
# see the Configure script.
#
mainmenu_name "Linux/CRIS Kernel Configuration"

define_bool CONFIG_UID16 y

mainmenu_option next_comment
comment 'Code maturity level options'
bool 'Prompt for development and/or incomplete code/drivers' CONFIG_EXPERIMENTAL
endmenu

mainmenu_option next_comment
comment 'General setup'

bool 'Networking support' CONFIG_NET
bool 'System V IPC' CONFIG_SYSVIPC

tristate 'Kernel support for ELF binaries' CONFIG_BINFMT_ELF
if [ "$CONFIG_EXPERIMENTAL" = "y" ]; then
  tristate 'Kernel support for JAVA binaries' CONFIG_BINFMT_JAVA
fi

bool 'Use kernel gdb debugger' CONFIG_KGDB

bool 'Enable Etrax100 watchdog' CONFIG_ETRAX_WATCHDOG

bool 'Use serial console (on the debug port)' CONFIG_USE_SERIAL_CONSOLE

bool 'Use in-kernel ifconfig/route setup' CONFIG_KERNEL_IFCONFIG

endmenu

mainmenu_option next_comment
comment 'Hardware setup'

choice 'Processor type' \
	"Etrax-100-LX	CONFIG_ETRAX100LX	\
	 Etrax-100-LX-for-xsim-simulator   CONFIG_SVINTO_SIM" Etrax-100-LX

# For both LX version 1 and the current simulator we enable the low VM mapping
# Later when LX version 2 and above exist, this should be done with an if

define_bool CONFIG_CRIS_LOW_MAP y

hex 'DRAM base (hex)' ETRAX_DRAM_BASE 40000000
int 'DRAM size (dec, in MB)' ETRAX_DRAM_SIZE 8

int 'Max possible flash size (dec, in MB)' CONFIG_ETRAX_FLASH_LENGTH 2
int 'Buswidth of flash in bytes' CONFIG_ETRAX_FLASH_BUSWIDTH 2

choice 'Product LED port' \
	"Port-PA-LEDs	CONFIG_ETRAX_PA_LEDS	\
	 Port-PB-LEDs	CONFIG_ETRAX_PB_LEDS	\
	 Mem-0x90000000-LEDs	CONFIG_ETRAX_90000000_LEDS  \
	 None	CONFIG_ETRAX_NO_LEDS" Port-PA-LEDs

if [ "$CONFIG_ETRAX_NO_LEDS" != "y" ]; then
  int '  First green LED bit' CONFIG_ETRAX_LED1G 2
  int '  First red LED bit' CONFIG_ETRAX_LED1R 3
  int '  Second green LED bit' CONFIG_ETRAX_LED2G 4
  int '  Second red LED bit' CONFIG_ETRAX_LED2R 5
  int '  Third green LED bit' CONFIG_ETRAX_LED3R 2
  int '  Third red LED bit' CONFIG_ETRAX_LED3G 2
fi

choice 'Product debug-port' \
	"Serial-0	CONFIG_DEBUG_PORT0	\
	 Serial-1	CONFIG_DEBUG_PORT1	\
	 Serial-2	CONFIG_DEBUG_PORT2	\
	 Serial-3	CONFIG_DEBUG_PORT3" Serial-0

hex 'R_WAITSTATES' DEF_R_WAITSTATES 95a6
hex 'R_BUS_CONFIG' DEF_R_BUS_CONFIG 104
hex 'R_DRAM_CONFIG' DEF_R_DRAM_CONFIG 1a200040
hex 'R_DRAM_TIMING' DEF_R_DRAM_TIMING 5611
hex 'R_PORT_PA_DIR' DEF_R_PORT_PA_DIR 1c
hex 'R_PORT_PA_DATA' DEF_R_PORT_PA_DATA 00
hex 'R_PORT_PB_CONFIG' DEF_R_PORT_PB_CONFIG 00
hex 'R_PORT_PB_DIR' DEF_R_PORT_PB_DIR 00
hex 'R_PORT_PB_DATA' DEF_R_PORT_PB_DATA ff

endmenu

# only configure IP numbers if the kernel ifconfig/route setup is enabled

if [ "$CONFIG_KERNEL_IFCONFIG" = "y" ]; then
  mainmenu_option next_comment	
  comment 'IP address selection'

  comment 'All addresses are in hexadecimal form without 0x prefix'

  hex 'IP address' ELTEST_IPADR ab1005af
  hex 'Network' ELTEST_NETWORK ab100000
  hex 'Netmask' ELTEST_NETMASK ffff0000
  hex 'Broadcast' ELTEST_BROADCAST ab10ffff
  hex 'Gateway' ELTEST_GATEWAY ab100101
  hwaddr 'Ethernet address' ELTEST_ETHADR 00408ccd0000

  endmenu
fi

# bring in Etrax built-in drivers

source arch/cris/drivers/Config.in

# standard linux drivers

source drivers/mtd/Config.in

source drivers/parport/Config.in

source drivers/pnp/Config.in

source drivers/block/Config.in

source drivers/md/Config.in

if [ "$CONFIG_NET" = "y" ]; then
  source net/Config.in
fi

source drivers/telephony/Config.in

mainmenu_option next_comment
comment 'ATA/IDE/MFM/RLL support'

tristate 'ATA/IDE/MFM/RLL support' CONFIG_IDE

if [ "$CONFIG_IDE" != "n" ]; then
  source drivers/ide/Config.in
else
  define_bool CONFIG_BLK_DEV_IDE_MODES n
  define_bool CONFIG_BLK_DEV_HD n
fi
endmenu

mainmenu_option next_comment
comment 'SCSI support'

tristate 'SCSI support' CONFIG_SCSI

if [ "$CONFIG_SCSI" != "n" ]; then
  source drivers/scsi/Config.in
fi
endmenu

source drivers/ieee1394/Config.in

source drivers/i2o/Config.in

if [ "$CONFIG_NET" = "y" ]; then
  mainmenu_option next_comment
  comment 'Network device support'

  bool 'Network device support' CONFIG_NETDEVICES
  if [ "$CONFIG_NETDEVICES" = "y" ]; then
    source drivers/net/Config.in
      if [ "$CONFIG_ATM" = "y" ]; then
         source drivers/atm/Config.in
      fi
  fi
  endmenu
fi

source net/ax25/Config.in

source net/irda/Config.in

mainmenu_option next_comment
comment 'ISDN subsystem'
if [ "$CONFIG_NET" != "n" ]; then
   tristate 'ISDN support' CONFIG_ISDN
   if [ "$CONFIG_ISDN" != "n" ]; then
      source drivers/isdn/Config.in
   fi
fi
endmenu

mainmenu_option next_comment
comment 'Old CD-ROM drivers (not SCSI, not IDE)'

bool 'Support non-SCSI/IDE/ATAPI CDROM drives' CONFIG_CD_NO_IDESCSI
if [ "$CONFIG_CD_NO_IDESCSI" != "n" ]; then
   source drivers/cdrom/Config.in
fi
endmenu

#
# input before char - char/joystick depends on it. As does USB.
#
source drivers/input/Config.in
source drivers/char/Config.in

#source drivers/misc/Config.in

source drivers/media/Config.in

source fs/Config.in

source drivers/char/Config.in

mainmenu_option next_comment
comment 'Sound'

tristate 'Sound card support' CONFIG_SOUND
if [ "$CONFIG_SOUND" != "n" ]; then
  source drivers/sound/Config.in
fi
endmenu

source drivers/usb/Config.in

mainmenu_option next_comment
comment 'Kernel hacking'

#bool 'Debug kmalloc/kfree' CONFIG_DEBUG_MALLOC
bool 'Kernel profiling support' CONFIG_PROFILE
if [ "$CONFIG_PROFILE" = "y" ]; then
  int ' Profile shift count' CONFIG_PROFILE_SHIFT 2
fi
endmenu
```
