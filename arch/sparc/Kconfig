## arch/x86_64/Kconfig.debug
```kconfig
menu "Kernel hacking"

config TRACE_IRQFLAGS_SUPPORT
	bool
	default y

source "lib/Kconfig.debug"

config DEBUG_RODATA
       bool "Write protect kernel read-only data structures"
       depends on DEBUG_KERNEL
       help
	 Mark the kernel read-only data as write-protected in the pagetables,
	 in order to catch accidental (and incorrect) writes to such const data.
	 This option may have a slight performance impact because a portion
	 of the kernel code won't be covered by a 2MB TLB anymore.
	 If in doubt, say "N".

config KDB
	bool "Built-in Kernel Debugger support"
	depends on DEBUG_KERNEL
	select KALLSYMS
	select KALLSYMS_ALL
	help
	  This option provides a built-in kernel debugger.  The built-in
	  kernel debugger contains commands which allow memory to be examined,
	  instructions to be disassembled and breakpoints to be set.  For details,
	  see Documentation/kdb/kdb.mm and the manual pages kdb_bt, kdb_ss, etc.
	  Kdb can also be used via the serial port.  Set up the system to
	  have a serial console (see Documentation/serial-console.txt).
	  The key sequence <escape>KDB on the serial port will cause the
	  kernel debugger to be entered with input from the serial port and
	  output to the serial console.  If unsure, say N.

config KDB_MODULES
	tristate "KDB modules"
	depends on KDB
	help
	  KDB can be extended by adding your own modules, in directory
	  kdb/modules.  This option selects the way that these modules should
	  be compiled, as free standing modules (select M) or built into the
	  kernel (select Y).  If unsure say M.

config KDB_OFF
	bool "KDB off by default"
	depends on KDB
	help
	  Normally kdb is activated by default, as long as CONFIG_KDB is set.
	  If you want to ship a kernel with kdb support but only have kdb
	  turned on when the user requests it then select this option.  When
	  compiled with CONFIG_KDB_OFF, kdb ignores all events unless you boot
	  with kdb=on or you echo "1" > /proc/sys/kernel/kdb.  This option also
	  works in reverse, if kdb is normally activated, you can boot with
	  kdb=off or echo "0" > /proc/sys/kernel/kdb to deactivate kdb. If
	  unsure, say N.

config KDB_CONTINUE_CATASTROPHIC
	int "KDB continues after catastrophic errors"
	depends on KDB
	default "0"
	help
	  This integer controls the behaviour of kdb when the kernel gets a
	  catastrophic error, i.e. for a panic, oops, NMI or other watchdog
	  tripping.  CONFIG_KDB_CONTINUE_CATASTROPHIC interacts with
	  /proc/sys/kernel/kdb and CONFIG_DUMP (if your kernel has the LKCD
	  patch).
	  When KDB is active (/proc/sys/kernel/kdb == 1) and a catastrophic
	  error occurs, nothing extra happens until you type 'go'.
	  CONFIG_KDB_CONTINUE_CATASTROPHIC == 0 (default).  The first time
	  you type 'go', kdb warns you.  The second time you type 'go', KDB
	  tries to continue - no guarantees that the kernel is still usable.
	  CONFIG_KDB_CONTINUE_CATASTROPHIC == 1.  KDB tries to continue - no
	  guarantees that the kernel is still usable.
	  CONFIG_KDB_CONTINUE_CATASTROPHIC == 2.  If your kernel has the LKCD
	  patch and LKCD is configured to take a dump then KDB forces a dump.
	  Whether or not a dump is taken, KDB forces a reboot.
	  When KDB is not active (/proc/sys/kernel/kdb == 0) and a catastrophic
	  error occurs, the following steps are automatic, no human
	  intervention is required.
	  CONFIG_KDB_CONTINUE_CATASTROPHIC == 0 (default) or 1.  KDB attempts
	  to continue - no guarantees that the kernel is still usable.
	  CONFIG_KDB_CONTINUE_CATASTROPHIC == 2.  If your kernel has the LKCD
	  patch and LKCD is configured to take a dump then KDB automatically
	  forces a dump.  Whether or not a dump is taken, KDB forces a
	  reboot.
	  If you are not sure, say 0.  Read Documentation/kdb/dump.txt before
	  setting to 2.

config IOMMU_DEBUG
       depends on IOMMU && DEBUG_KERNEL
       bool "Enable IOMMU debugging"
       help
         Force the IOMMU to on even when you have less than 4GB of
	 memory and add debugging code. On overflow always panic. And
	 allow to enable IOMMU leak tracing. Can be disabled at boot
	 time with iommu=noforce. This will also enable scatter gather
	 list merging.  Currently not recommended for production
	 code. When you use it make sure you have a big enough
	 IOMMU/AGP aperture.  Most of the options enabled by this can
	 be set more finegrained using the iommu= command line
	 options. See Documentation/x86_64/boot-options.txt for more
	 details.

config IOMMU_LEAK
       bool "IOMMU leak tracing"
       depends on DEBUG_KERNEL
       depends on IOMMU_DEBUG
       help
         Add a simple leak tracer to the IOMMU code. This is useful when you
	 are debugging a buggy device driver that leaks IOMMU mappings.

config DEBUG_STACKOVERFLOW
        bool "Check for stack overflows"
        depends on DEBUG_KERNEL
        help
	  This option will cause messages to be printed if free stack space
	  drops below a certain limit.

config DEBUG_STACK_USAGE
        bool "Stack utilization instrumentation"
        depends on DEBUG_KERNEL
        help
	  Enables the display of the minimum amount of free stack which each
	  task has ever had available in the sysrq-T and sysrq-P debug output.

	  This option will slow down process creation somewhat.

#config X86_REMOTE_DEBUG
#       bool "kgdb debugging stub"

endmenu
```

## arch/x86_64/config.in
```kconfig
#
# For a description of the syntax of this configuration file,
# see Documentation/kbuild/config-language.txt.
#
# Note: ISA is disabled and will hopefully never be enabled.
# If you managed to buy an ISA x86-64 box you'll have to fix all the
# ISA drivers you need yourself. 
#

mainmenu_name "Linux Kernel Configuration"

define_bool CONFIG_X86_64 y

define_bool CONFIG_X86 y
define_bool CONFIG_ISA n
define_bool CONFIG_SBUS n

define_bool CONFIG_UID16 y
define_bool CONFIG_RWSEM_GENERIC_SPINLOCK y
define_bool CONFIG_RWSEM_XCHGADD_ALGORITHM n
define_bool CONFIG_X86_CMPXCHG y

define_bool CONFIG_EARLY_PRINTK y

source init/Config.in

mainmenu_option next_comment
comment 'Processor type and features'
choice 'Processor family' \
	"AMD-Hammer			CONFIG_MK8 \
	 Generic-x86-64			CONFIG_GENERIC_CPU" AMD-Hammer
	
#
# Define implied options from the CPU selection here
#
define_int CONFIG_X86_L1_CACHE_BYTES 64
define_int CONFIG_X86_L1_CACHE_SHIFT 6
define_bool CONFIG_X86_TSC y
define_bool CONFIG_X86_GOOD_APIC y

tristate '/dev/cpu/*/msr - Model-specific register support' CONFIG_X86_MSR
tristate '/dev/cpu/*/cpuid - CPU information support' CONFIG_X86_CPUID

define_bool CONFIG_MATH_EMULATION n
define_bool CONFIG_MCA n
define_bool CONFIG_EISA n
define_bool CONFIG_X86_IO_APIC y
define_bool CONFIG_X86_LOCAL_APIC y

#currently broken:
#bool 'MTRR (Memory Type Range Register) support' CONFIG_MTRR
bool 'Symmetric multi-processing support' CONFIG_SMP
if [ "$CONFIG_SMP" = "n" ]; then
   bool 'Preemptible Kernel' CONFIG_PREEMPT
fi
if [ "$CONFIG_SMP" = "y" ]; then
    define_bool CONFIG_HAVE_DEC_LOCK y
fi

define_bool CONFIG_X86_MCE y
bool 'Check for non-fatal machine check errors' CONFIG_X86_MCE_NONFATAL $CONFIG_X86_MCE

endmenu

mainmenu_option next_comment

comment 'Power management options'

bool 'Power Management support' CONFIG_PM

source drivers/acpi/Config.in

endmenu

mainmenu_option next_comment

comment 'Bus options (PCI etc.)'

bool 'PCI support' CONFIG_PCI
if [ "$CONFIG_PCI" = "y" ]; then
# x86-64 doesn't support PCI BIOS access from long mode so always go direct. 
   define_bool CONFIG_PCI_DIRECT y 
fi

source drivers/pci/Config.in

bool 'Support for hot-pluggable devices' CONFIG_HOTPLUG

if [ "$CONFIG_HOTPLUG" = "y" ] ; then
   source drivers/pcmcia/Config.in
   source drivers/hotplug/Config.in
else
   define_bool CONFIG_PCMCIA n
fi

endmenu

mainmenu_option next_comment

comment 'Executable file formats / Emulations'

if [ "$CONFIG_PROC_FS" = "y" ]; then
   define_bool CONFIG_KCORE_ELF y
fi
#tristate 'Kernel support for a.out binaries' CONFIG_BINFMT_AOUT
tristate 'Kernel support for ELF binaries' CONFIG_BINFMT_ELF
tristate 'Kernel support for MISC binaries' CONFIG_BINFMT_MISC

bool 'IA32 Emulation' CONFIG_IA32_EMULATION

endmenu

source drivers/mtd/Config.in

source drivers/parport/Config.in

#source drivers/pnp/Config.in

source drivers/block/Config.in

source drivers/md/Config.in

if [ "$CONFIG_NET" = "y" ]; then
   source net/Config.in
fi

source drivers/telephony/Config.in

mainmenu_option next_comment
comment 'ATA/IDE/MFM/RLL support'

tristate 'ATA/IDE/MFM/RLL support' CONFIG_IDE

if [ "$CONFIG_IDE" != "n" ]; then
  source drivers/ide/Config.in
else
  define_bool CONFIG_BLK_DEV_HD n
fi
endmenu

mainmenu_option next_comment
comment 'SCSI support'

tristate 'SCSI support' CONFIG_SCSI

if [ "$CONFIG_SCSI" != "n" ]; then
   source drivers/scsi/Config.in
fi
endmenu

source drivers/message/fusion/Config.in

source drivers/ieee1394/Config.in

#Currently not 64bit safe
#source drivers/message/i2o/Config.in

if [ "$CONFIG_NET" = "y" ]; then
   mainmenu_option next_comment
   comment 'Network device support'

   bool 'Network device support' CONFIG_NETDEVICES
   if [ "$CONFIG_NETDEVICES" = "y" ]; then
      source drivers/net/Config.in
# ATM seems to be largely 64bit unsafe and also unmaintained - disable it for now.
#      if [ "$CONFIG_ATM" = "y" ]; then
#         source drivers/atm/Config.in
#      fi
   fi
   endmenu
fi

source net/ax25/Config.in

source net/irda/Config.in

source drivers/isdn/Config.in

# no support for non IDE/SCSI cdroms as they were all ISA only

#
# input before char - char/joystick depends on it. As does USB.
#
source drivers/input/Config.in
source drivers/char/Config.in

source drivers/misc/Config.in

source drivers/media/Config.in

source fs/Config.in

if [ "$CONFIG_VT" = "y" ]; then
   mainmenu_option next_comment
   comment 'Console drivers'
   bool 'VGA text console' CONFIG_VGA_CONSOLE
   bool 'Video mode selection support' CONFIG_VIDEO_SELECT
   if [ "$CONFIG_EXPERIMENTAL" = "y" ]; then
      tristate 'MDA text console (dual-headed) (EXPERIMENTAL)' CONFIG_MDA_CONSOLE
      source drivers/video/Config.in
   fi
   endmenu
fi

mainmenu_option next_comment
comment 'Sound'

tristate 'Sound card support' CONFIG_SOUND
if [ "$CONFIG_SOUND" != "n" ]; then
   source sound/Config.in
fi
endmenu

source drivers/usb/Config.in

source net/bluetooth/Config.in

mainmenu_option next_comment
comment 'Kernel hacking'

bool 'Kernel debugging' CONFIG_DEBUG_KERNEL
if [ "$CONFIG_DEBUG_KERNEL" != "n" ]; then
   bool '  Debug memory allocations' CONFIG_DEBUG_SLAB
#   bool '  Memory mapped I/O debugging' CONFIG_DEBUG_IOVIRT
   bool '  Magic SysRq key' CONFIG_MAGIC_SYSRQ
   bool '  Spinlock debugging' CONFIG_DEBUG_SPINLOCK
   bool '  Additional run-time checks' CONFIG_CHECKING
   bool '  Debug __init statements' CONFIG_INIT_DEBUG
fi
endmenu

source lib/Config.in
```

## arch/x86_64/kernel/cpufreq/Kconfig
```kconfig
#
# CPU Frequency scaling
#

menu "CPU Frequency scaling"

config CPU_FREQ
	bool "CPU Frequency scaling"
	help
	  Clock scaling allows you to change the clock speed of CPUs on the
	  fly. This is a nice method to save battery power on notebooks,
	  because the lower the clock speed, the less power the CPU consumes.

	  For more information, take a look at <file:Documentation/cpu-freq/>
	  or at <http://www.codemonkey.org.uk/projects/cpufreq/>

	  If in doubt, say N.

source "drivers/cpufreq/Kconfig"

config CPU_FREQ_TABLE
       tristate "CPU frequency table helpers"
       depends on CPU_FREQ
       default y
       help
         Many CPUFreq drivers use these helpers, so only say N here if
	 the CPUFreq driver of your choice doesn't need these helpers.

	 If in doubt, say Y.

comment "CPUFreq processor drivers"
       depends on CPU_FREQ

config X86_POWERNOW_K8
	tristate "AMD Opteron/Athlon64 PowerNow!"
	depends on CPU_FREQ_TABLE
	help
	  This adds the CPUFreq driver for mobile AMD Opteron/Athlon64 processors.

	  For details, take a look at <file:Documentation/cpu-freq/>. 

	  If in doubt, say N.

config X86_POWERNOW_K8_ACPI
	bool
	depends on ((X86_POWERNOW_K8 = "m" && ACPI_PROCESSOR) || (X86_POWERNOW_K8 = "y" && ACPI_PROCESSOR = "y"))
	default y

config X86_SPEEDSTEP_CENTRINO
	tristate "Intel Enhanced SpeedStep"
	depends on CPU_FREQ_TABLE
	help
	  This adds the CPUFreq driver for Enhanced SpeedStep enabled
	  mobile CPUs.  This means Intel Pentium M (Centrino) CPUs
	  or 64bit enabled Intel Xeons.

	  For details, take a look at <file:Documentation/cpu-freq/>.

	  If in doubt, say N.

config X86_SPEEDSTEP_CENTRINO_TABLE
	bool
	depends on X86_SPEEDSTEP_CENTRINO
	default y

config X86_SPEEDSTEP_CENTRINO_ACPI
	bool "Use ACPI tables to decode valid frequency/voltage pairs (EXPERIMENTAL)"
	depends on EXPERIMENTAL
	depends on ((X86_SPEEDSTEP_CENTRINO = "m" && ACPI_PROCESSOR) || (X86_SPEEDSTEP_CENTRINO = "y" && ACPI_PROCESSOR = "y"))
	help
	  Use primarily the information provided in the BIOS ACPI tables
	  to determine valid CPU frequency and voltage pairings.

	  If in doubt, say Y.

config X86_ACPI_CPUFREQ
	tristate "ACPI Processor P-States driver"
	depends on CPU_FREQ_TABLE && ACPI_PROCESSOR
	help
	  This driver adds a CPUFreq driver which utilizes the ACPI
	  Processor Performance States.

	  For details, take a look at <file:Documentation/cpu-freq/>.

	  If in doubt, say N.

config X86_ACPI_CPUFREQ_PROC_INTF
        bool "/proc/acpi/processor/../performance interface (deprecated)"
	depends on X86_ACPI_CPUFREQ && PROC_FS
	help
	  This enables the deprecated /proc/acpi/processor/../performance
	  interface. While it is helpful for debugging, the generic,
	  cross-architecture cpufreq interfaces should be used.

	  If in doubt, say N.

endmenu
```

## crypto/Kconfig
```kconfig
#
# Cryptographic API Configuration
#

menu "Cryptographic options"

config CRYPTO
	bool "Cryptographic API"
	help
	  This option provides the core Cryptographic API.

config CRYPTO_MD4
	tristate "MD4 digest algorithm"
	depends on CRYPTO
	help
	  MD4 message digest algorithm (RFC1320), including HMAC (RFC2104).
	  

config CRYPTO_MD5
	tristate "MD5 digest algorithm"
	depends on CRYPTO
	help
	  MD5 message digest algorithm (RFC1321), including HMAC (RFC2104, RFC2403).

config CRYPTO_SHA1
	tristate "SHA-1 digest algorithm"
	depends on CRYPTO
	help
	  SHA-1 secure hash standard (FIPS 180-1), including HMAC (RFC2104, RFC2404).

config CRYPTO_DES
	tristate "DES and Triple DES EDE cipher algorithms"
	depends on CRYPTO
	help
	  DES cipher algorithm (FIPS 46-2), and Triple DES EDE (FIPS 46-3).

config CRYPTO_TEST
	tristate "Testing module"
	depends on CRYPTO
	help
	  Quick & dirty crypto test module.

endmenu
```

## drivers/acorn/net/Kconfig
```kconfig
#
# Acorn Network device configuration
#  These are for Acorn's Expansion card network interfaces
#
config ARM_ETHER1
	tristate "Acorn Ether1 support"
	depends on NET_ETHERNET && ARM && ARCH_ACORN
	help
	  If you have an Acorn system with one of these (AKA25) network cards,
	  you should say Y to this option if you wish to use it with Linux.

config ARM_ETHER3
	tristate "Acorn/ANT Ether3 support"
	depends on NET_ETHERNET && ARM && ARCH_ACORN
	help
	  If you have an Acorn system with one of these network cards, you
	  should say Y to this option if you wish to use it with Linux.

config ARM_ETHERH
	tristate "I-cubed EtherH/ANT EtherM support"
	depends on NET_ETHERNET && ARM && ARCH_ACORN
	help
	  If you have an Acorn system with one of these network cards, you
	  should say Y to this option if you wish to use it with Linux.
```
