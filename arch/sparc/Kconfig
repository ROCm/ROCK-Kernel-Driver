## arch/x86/perfmon/Kconfig
```kconfig
menu "Hardware Performance Monitoring support"
config PERFMON
	bool "Perfmon2 performance monitoring interface"
	select X86_LOCAL_APIC
	default n
	help
	Enables the perfmon2 interface to access the hardware
	performance counters. See <http://perfmon2.sf.net/> for
	more details.

config PERFMON_DEBUG
	bool "Perfmon debugging"
	default n
	depends on PERFMON
	help
	Enables perfmon debugging support

config PERFMON_DEBUG_FS
	bool "Enable perfmon statistics reporting via debugfs"
	default y
	depends on PERFMON && DEBUG_FS
	help
	Enable collection and reporting of perfmon timing statistics under
	debugfs. This is used for debugging and performance analysis of the
	subsystem.The debugfs filesystem must be mounted.

config X86_PERFMON_P6
	tristate "Support for Intel P6/Pentium M processor hardware performance counters"
	depends on PERFMON && X86_32
	default n
	help
	Enables support for Intel P6-style hardware performance counters.
	To be used for with Intel Pentium III, PentiumPro, Pentium M processors.

config X86_PERFMON_P4
	tristate "Support for Intel Pentium 4/Xeon hardware performance counters"
	depends on PERFMON
	default n
	help
	Enables support for Intel Pentium 4/Xeon (Netburst) hardware performance
	counters.

config	X86_PERFMON_PEBS_P4
	tristate "Support for Intel Netburst Precise Event-Based Sampling (PEBS)"
	depends on PERFMON && X86_PERFMON_P4
	default n
	help
	Enables support for Precise Event-Based Sampling (PEBS) on the Intel
	Netburst processors such as Pentium 4, Xeon which support it.

config  X86_PERFMON_CORE
	tristate "Support for Intel Core-based performance counters"
	depends on PERFMON
	default n
	help
	Enables support for Intel Core-based performance counters. Enable
	this option to support Intel Core 2 processors.

config	X86_PERFMON_PEBS_CORE
	tristate "Support for Intel Core Precise Event-Based Sampling (PEBS)"
	depends on PERFMON && X86_PERFMON_CORE
	default n
	help
	Enables support for Precise Event-Based Sampling (PEBS) on the Intel
	Core processors.

config  X86_PERFMON_INTEL_ATOM
	tristate "Support for Intel Atom processor"
	depends on PERFMON
	default n
	help
	Enables support for Intel Atom processors.

config  X86_PERFMON_INTEL_ARCH
	tristate "Support for Intel architectural perfmon v1/v2"
	depends on PERFMON
	default n
	help
	Enables support for Intel architectural performance counters.
	This feature was introduced with Intel Core Solo/Core Duo processors.

config	X86_PERFMON_AMD64
	tristate "Support AMD Athlon64/Opteron64 hardware performance counters"
	depends on PERFMON
	default n
	help
	Enables support for Athlon64/Opterton64 hardware performance counters.
	Support for family 6, 15 and 16(10H) processors.
endmenu
```
