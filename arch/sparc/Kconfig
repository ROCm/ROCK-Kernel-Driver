## arch/sparc64/config.in
```kconfig
# $Id: config.in,v 1.158 2002/01/24 22:14:44 davem Exp $
# For a description of the syntax of this configuration file,
# see the Configure script.
#
mainmenu_name "Linux/UltraSPARC Kernel Configuration"

source init/Config.in

mainmenu_option next_comment
comment 'General setup'

tristate 'UltraSPARC-III bootbus i2c controller driver' CONFIG_BBC_I2C

define_bool CONFIG_VT y
define_bool CONFIG_VT_CONSOLE y

bool 'Symmetric multi-processing support' CONFIG_SMP
bool 'Preemptible Kernel' CONFIG_PREEMPT

# Identify this as a Sparc64 build
define_bool CONFIG_SPARC64 y

bool 'Support for hot-pluggable devices' CONFIG_HOTPLUG

# Global things across all Sun machines.
define_bool CONFIG_HAVE_DEC_LOCK y
define_bool CONFIG_RWSEM_GENERIC_SPINLOCK n
define_bool CONFIG_RWSEM_XCHGADD_ALGORITHM y
define_bool CONFIG_GENERIC_ISA_DMA y
define_bool CONFIG_ISA n
define_bool CONFIG_ISAPNP n
define_bool CONFIG_EISA n
define_bool CONFIG_MCA n
define_bool CONFIG_PCMCIA n
define_bool CONFIG_SBUS y
define_bool CONFIG_SBUSCHAR y
define_bool CONFIG_SUN_AUXIO y
define_bool CONFIG_SUN_IO y
bool 'PCI support' CONFIG_PCI
if [ "$CONFIG_PCI" = "y" ] ; then
   define_bool CONFIG_RTC y
fi
source drivers/pci/Config.in

tristate 'Openprom tree appears in /proc/openprom' CONFIG_SUN_OPENPROMFS
if [ "$CONFIG_PROC_FS" = "y" ]; then
   define_bool CONFIG_KCORE_ELF y
fi
bool 'Kernel support for Linux/Sparc 32bit binary compatibility' CONFIG_SPARC32_COMPAT
if [ "$CONFIG_SPARC32_COMPAT" != "n" ]; then
   tristate '  Kernel support for 32-bit ELF binaries' CONFIG_BINFMT_ELF32
   bool '  Kernel support for 32-bit (ie. SunOS) a.out binaries' CONFIG_BINFMT_AOUT32
fi
tristate 'Kernel support for 64-bit ELF binaries' CONFIG_BINFMT_ELF
tristate 'Kernel support for MISC binaries' CONFIG_BINFMT_MISC
bool 'SunOS binary emulation' CONFIG_SUNOS_EMUL
if [ "$CONFIG_EXPERIMENTAL" = "y" ]; then
   tristate 'Solaris binary emulation (EXPERIMENTAL)' CONFIG_SOLARIS_EMUL
fi
source drivers/parport/Config.in
dep_tristate '  Parallel printer support' CONFIG_PRINTER $CONFIG_PARPORT
if [ "$CONFIG_PCI" = "y" ]; then
   tristate 'SUNW, envctrl support' CONFIG_ENVCTRL
   tristate '7-Segment Display support' CONFIG_DISPLAY7SEG
   tristate 'CP1XXX Hardware Watchdog support' CONFIG_WATCHDOG_CP1XXX
   tristate 'RIO Hardware Watchdog support' CONFIG_WATCHDOG_RIO
fi
endmenu

mainmenu_option next_comment
comment 'Console drivers'
bool 'PROM console' CONFIG_PROM_CONSOLE
source drivers/video/Config.in
endmenu

source drivers/serial/Config.in
source drivers/sbus/char/Config.in
source drivers/sbus/audio/Config.in
source drivers/mtd/Config.in
mainmenu_option next_comment
comment 'Block devices'

bool 'Normal floppy disk support' CONFIG_BLK_DEV_FD

tristate 'Loopback device support' CONFIG_BLK_DEV_LOOP
dep_tristate 'Network block device support' CONFIG_BLK_DEV_NBD $CONFIG_NET

source drivers/md/Config.in

tristate 'RAM disk support' CONFIG_BLK_DEV_RAM
if [ "$CONFIG_BLK_DEV_RAM" = "y" -o "$CONFIG_BLK_DEV_RAM" = "m" ]; then
	int '   Default RAM disk size' CONFIG_BLK_DEV_RAM_SIZE 4096
fi
dep_bool '  Initial RAM disk (initrd) support' CONFIG_BLK_DEV_INITRD $CONFIG_BLK_DEV_RAM

endmenu

mainmenu_option next_comment
comment 'ATA/ATAPI/MFM/RLL device support'

tristate 'ATA/ATAPI/MFM/RLL device support' CONFIG_IDE

if [ "$CONFIG_IDE" != "n" ]; then
  source drivers/ide/Config.in
else
  define_bool CONFIG_BLK_DEV_HD n
fi
endmenu

mainmenu_option next_comment
comment 'SCSI support'

tristate 'SCSI support' CONFIG_SCSI

if [ "$CONFIG_SCSI" != "n" ]; then
   comment 'SCSI support type (disk, tape, CDrom)'

   dep_tristate '  SCSI disk support' CONFIG_BLK_DEV_SD $CONFIG_SCSI

   if [ "$CONFIG_BLK_DEV_SD" != "n" ]; then
      int  'Maximum number of SCSI disks that can be loaded as modules' CONFIG_SD_EXTRA_DEVS 40
   fi

   dep_tristate '  SCSI tape support' CONFIG_CHR_DEV_ST $CONFIG_SCSI

   dep_tristate '  SCSI OnStream SC-x0 tape support' CONFIG_CHR_DEV_OSST $CONFIG_SCSI

   dep_tristate '  SCSI CDROM support' CONFIG_BLK_DEV_SR $CONFIG_SCSI

   if [ "$CONFIG_BLK_DEV_SR" != "n" ]; then
      bool '    Enable vendor-specific extensions (for SCSI CDROM)' CONFIG_BLK_DEV_SR_VENDOR
      int  'Maximum number of CDROM devices that can be loaded as modules' CONFIG_SR_EXTRA_DEVS 2
   fi

   dep_tristate '  SCSI generic support' CONFIG_CHR_DEV_SG $CONFIG_SCSI

   comment 'Some SCSI devices (e.g. CD jukebox) support multiple LUNs'

   bool '  Probe all LUNs on each SCSI device' CONFIG_SCSI_MULTI_LUN

   bool '  Verbose SCSI error reporting (kernel size +=12K)' CONFIG_SCSI_CONSTANTS
   bool '  SCSI logging facility' CONFIG_SCSI_LOGGING

   mainmenu_option next_comment
   comment 'SCSI low-level drivers'

   dep_tristate 'Sparc ESP Scsi Driver' CONFIG_SCSI_SUNESP $CONFIG_SCSI
   dep_tristate 'PTI Qlogic, ISP Driver' CONFIG_SCSI_QLOGICPTI $CONFIG_SCSI

   if [ "$CONFIG_PCI" != "n" ]; then
      source drivers/scsi/aic7xxx/Config.in
      if [ "$CONFIG_SCSI_AIC7XXX" != "y" ]; then
         dep_tristate 'Old Adaptec AIC7xxx support' CONFIG_SCSI_AIC7XXX_OLD $CONFIG_SCSI
         if [ "$CONFIG_SCSI_AIC7XXX_OLD" != "n" ]; then
            bool '  Enable Tagged Command Queueing (TCQ) by default' CONFIG_AIC7XXX_OLD_TCQ_ON_BY_DEFAULT
            int  '  Maximum number of TCQ commands per device' CONFIG_AIC7XXX_OLD_CMDS_PER_DEVICE 8
            bool '  Collect statistics to report in /proc' CONFIG_AIC7XXX_OLD_PROC_STATS
         fi
      fi
      dep_tristate 'SYM53C8XX Version 2 SCSI support' CONFIG_SCSI_SYM53C8XX_2 $CONFIG_SCSI
      if [ "$CONFIG_SCSI_SYM53C8XX_2" != "n" ]; then
         int  '  DMA addressing mode' CONFIG_SCSI_SYM53C8XX_DMA_ADDRESSING_MODE 1
         int  '  default tagged command queue depth' CONFIG_SCSI_SYM53C8XX_DEFAULT_TAGS 16
         int  '  maximum number of queued commands' CONFIG_SCSI_SYM53C8XX_MAX_TAGS 64
         bool '  use normal IO' CONFIG_SCSI_SYM53C8XX_IOMAPPED
      fi
      if [ "$CONFIG_SCSI_SYM53C8XX_2" != "y" ]; then
         dep_tristate 'NCR53C8XX SCSI support' CONFIG_SCSI_NCR53C8XX $CONFIG_SCSI
         dep_tristate 'SYM53C8XX SCSI support' CONFIG_SCSI_SYM53C8XX $CONFIG_SCSI
         if [ "$CONFIG_SCSI_NCR53C8XX" != "n" -o "$CONFIG_SCSI_SYM53C8XX" != "n" ]; then
            int 'default tagged command queue depth' CONFIG_SCSI_NCR53C8XX_DEFAULT_TAGS 8
            int 'maximum number of queued commands' CONFIG_SCSI_NCR53C8XX_MAX_TAGS 32
            int 'synchronous transfers frequency in MHz' CONFIG_SCSI_NCR53C8XX_SYNC 10
            bool '  enable profiling' CONFIG_SCSI_NCR53C8XX_PROFILE
            if [ "$CONFIG_SCSI_SYM53C8XX" != "n" ]; then
	       bool '  include support for the NCR PQS/PDS SCSI card' CONFIG_SCSI_NCR53C8XX_PQS_PDS
            fi
            if [ "$CONFIG_SCSI_NCR53C8XX_DEFAULT_TAGS" = "0" ]; then
               bool '  not allow targets to disconnect' CONFIG_SCSI_NCR53C8XX_NO_DISCONNECT
            fi
            if [ "$CONFIG_EXPERIMENTAL" = "y" ]; then
               bool '  assume boards are SYMBIOS compatible (EXPERIMENTAL)' CONFIG_SCSI_NCR53C8XX_SYMBIOS_COMPAT
            fi
         fi
      fi
      dep_tristate 'Qlogic ISP SCSI support' CONFIG_SCSI_QLOGIC_ISP $CONFIG_SCSI
      dep_tristate 'Qlogic ISP FC SCSI support' CONFIG_SCSI_QLOGIC_FC $CONFIG_SCSI
      if [ "$CONFIG_SCSI_QLOGIC_FC" != "n" ]; then
         define_bool CONFIG_SCSI_QLOGIC_FC_FIRMWARE y
      fi
   fi

   endmenu
fi
endmenu

source drivers/fc4/Config.in

if [ "$CONFIG_PCI" = "y" ]; then
   source drivers/message/fusion/Config.in
fi

source drivers/ieee1394/Config.in

if [ "$CONFIG_NET" = "y" ]; then
   source net/Config.in

   mainmenu_option next_comment
   comment 'Network device support'

   bool 'Network device support' CONFIG_NETDEVICES
   if [ "$CONFIG_NETDEVICES" = "y" ]; then
      source drivers/net/Config.in
      if [ "$CONFIG_ATM" = "y" ]; then
	source drivers/atm/Config.in
      fi
   fi
   endmenu
fi

# This one must be before the filesystem configs. -DaveM
mainmenu_option next_comment
comment 'Unix 98 PTY support'
bool 'Unix98 PTY support' CONFIG_UNIX98_PTYS
if [ "$CONFIG_UNIX98_PTYS" = "y" ]; then
   int 'Maximum number of Unix98 PTYs in use (0-2048)' CONFIG_UNIX98_PTY_COUNT 256
fi
endmenu

mainmenu_option next_comment
comment 'Video For Linux'
tristate 'Video For Linux' CONFIG_VIDEO_DEV
if [ "$CONFIG_VIDEO_DEV" != "n" ]; then
   if [ "$CONFIG_PCI" != "n" ]; then
      dep_tristate '  BT848 Video For Linux' CONFIG_VIDEO_BT848 $CONFIG_VIDEO_DEV
   fi
fi
endmenu

mainmenu_option next_comment
comment 'XFree86 DRI support'
bool 'Direct Rendering Manager (XFree86 DRI support)' CONFIG_DRM
dep_tristate '  Creator/Creator3D' CONFIG_DRM_FFB $CONFIG_DRM
dep_tristate '  3dfx Banshee/Voodoo3+' CONFIG_DRM_TDFX $CONFIG_DRM
dep_tristate '  ATI Rage 128' CONFIG_DRM_R128 $CONFIG_DRM
endmenu

source drivers/input/Config.in

source fs/Config.in

mainmenu_option next_comment
comment 'Sound'

tristate 'Sound card support' CONFIG_SOUND
if [ "$CONFIG_SOUND" != "n" ]; then
   source sound/Config.in
fi
endmenu

source drivers/usb/Config.in

source net/bluetooth/Config.in

mainmenu_option next_comment
comment 'Watchdog'

tristate 'Software watchdog' CONFIG_SOFT_WATCHDOG
endmenu

mainmenu_option next_comment
comment 'Kernel hacking'

bool 'Kernel debugging' CONFIG_DEBUG_KERNEL
if [ "$CONFIG_DEBUG_KERNEL" != "n" ]; then
   bool '  Debug memory allocations' CONFIG_DEBUG_SLAB
   bool '  Magic SysRq key' CONFIG_MAGIC_SYSRQ
   bool '  Spinlock debugging' CONFIG_DEBUG_SPINLOCK
   bool '  Verbose BUG() reporting (adds 70K)' CONFIG_DEBUG_BUGVERBOSE
   bool '  D-cache flush debugging' CONFIG_DEBUG_DCFLUSH
fi
bool 'Stack Overflow Detection Support' CONFIG_STACK_DEBUG
if [ "$CONFIG_STACK_DEBUG" = "y" ] ; then
   define_bool CONFIG_MCOUNT y
fi

endmenu

source security/Config.in
source lib/Config.in
```

## arch/sparc64/perfmon/Kconfig
```kconfig
menu "Hardware Performance Monitoring support"
config PERFMON
	bool "Perfmon2 performance monitoring interface"
	default n
	help
	Enables the perfmon2 interface to access the hardware
	performance counters. See <http://perfmon2.sf.net/> for
	more details.

config PERFMON_DEBUG
	bool "Perfmon debugging"
	depends on PERFMON
	default n
	help
	Enables perfmon debugging support

config PERFMON_DEBUG_FS
	bool "Enable perfmon statistics reporting via debugfs"
	default y
	depends on PERFMON && DEBUG_FS
	help
	Enable collection and reporting of perfmon timing statistics under
	debugfs. This is used for debugging and performance analysis of the
	subsystem. The debugfs filesystem must be mounted.

endmenu
```

## arch/um/Kconfig
```kconfig
config USERMODE
	bool
	default y

# XXX: does UM have a mmu/swap?
config MMU
	bool
	default y

config SWAP
	bool
	default y

mainmenu "Linux/Usermode Kernel Configuration"

config ISA
	bool

config SBUS
	bool

config PCI
	bool

config UID16
	bool
	default y

config RWSEM_GENERIC_SPINLOCK
	bool
	default y

config MODE_TT
	bool
	default y

config MODE_SKAS
	bool
	default y

menu "Code maturity level options"

config EXPERIMENTAL
	bool "Prompt for development and/or incomplete code/drivers"

endmenu


menu "General Setup"

config NET
	bool "Networking support"

config SYSVIPC
	bool "System V IPC"

config BSD_PROCESS_ACCT
	bool "BSD Process Accounting"

config SYSCTL
	bool "Sysctl support"

config BINFMT_AOUT
	tristate "Kernel support for a.out binaries"

config BINFMT_ELF
	tristate "Kernel support for ELF binaries"

config BINFMT_MISC
	tristate "Kernel support for MISC binaries"

config HOSTFS
	tristate "Host filesystem"

config MCONSOLE
	bool "Management console"

config MAGIC_SYSRQ
	bool "Magic SysRq key"
	depends on MCONSOLE

config HOST_2G_2G
	bool "2G/2G host address space split"

config UML_SMP
	bool "Symmetric multi-processing support"

config SMP
	bool
	default UML_SMP

config NR_CPUS
	int "Maximum number of CPUs (2-32)"
	depends on SMP
	default "32"

config NEST_LEVEL
	int "Nesting level"
	default "0"

config KERNEL_HALF_GIGS
	int "Kernel address space size (in .5G units)"
	default "1"

config HIGHMEM
	bool "Highmem support"

endmenu


menu "Loadable module support"

config MODULES
	bool "Enable loadable module support"

# MODVERSIONS does not yet work in this architecture
#   bool '  Set version information on all module symbols' CONFIG_MODVERSIONS
config KMOD
	bool "Kernel module loader"
	depends on MODULES

endmenu

source "arch/um/Kconfig_char"

source "arch/um/Kconfig_block"

config NETDEVICES
	bool
	default NET

source "arch/um/Kconfig_net"

source "net/Kconfig"

source "fs/Kconfig"


menu "SCSI support"

config SCSI
	tristate "SCSI support"

# This gives us free_dma, which scsi.c wants.
config GENERIC_ISA_DMA
	bool
	depends on SCSI
	default y

source "arch/um/Kconfig_scsi"

endmenu

source "drivers/md/Kconfig"

source "drivers/mtd/Kconfig"


menu "Kernel hacking"

config DEBUG_SLAB
	bool "Debug memory allocations"

config DEBUGSYM
	bool "Enable kernel debugging symbols"

config PT_PROXY
	bool "Enable ptrace proxy"
	depends on XTERM_CHAN && DEBUGSYM

config GPROF
	bool "Enable gprof support"
	depends on DEBUGSYM

config GCOV
	bool "Enable gcov support"
	depends on DEBUGSYM

endmenu
```
