## arch/ppc64/config.in
```kconfig
# 
# For a description of the syntax of this configuration file,
# see Documentation/kbuild/config-language.txt.
#
define_bool CONFIG_UID16 n
define_bool CONFIG_RWSEM_GENERIC_SPINLOCK n
define_bool CONFIG_RWSEM_XCHGADD_ALGORITHM y
define_bool CONFIG_GENERIC_ISA_DMA y
define_bool CONFIG_HAVE_DEC_LOCK y

source init/Config.in

mainmenu_option next_comment
comment 'Platform support'
choice 'Platform Type'	\
	 "iSeries               CONFIG_PPC_ISERIES \
	 pSeries                CONFIG_PPC_PSERIES " pSeries
define_bool CONFIG_PPC y
define_bool CONFIG_PPC64 y

bool 'Symmetric multi-processing support' CONFIG_SMP
if [ "$CONFIG_SMP" = "y" ]; then
  bool '  Distribute interrupts on all CPUs by default' CONFIG_IRQ_ALL_CPUS
  int  'Maximum number of CPUs (2-64)' CONFIG_NR_CPUS 64
  if [ "$CONFIG_PPC_PSERIES" = "y" ]; then
    bool '  Hardware multithreading' CONFIG_HMT
    bool '  Discontiguous Memory Support' CONFIG_DISCONTIGMEM
    if [ "$CONFIG_DISCONTIGMEM" = "y" ]; then
      bool '    NUMA support' CONFIG_NUMA
    fi
  fi
fi
define_bool CONFIG_PREEMPT n

if [ "$CONFIG_PPC_ISERIES" = "y" ]; then
   define_bool CONFIG_MSCHUNKS y
else
   tristate '  Firmware flash interface' CONFIG_RTAS_FLASH
fi

endmenu

mainmenu_option next_comment
comment 'General setup'

define_bool CONFIG_ISA n
define_bool CONFIG_SBUS n
define_bool CONFIG_MCA n
define_bool CONFIG_EISA n
define_bool CONFIG_PCI y

# only elf supported, a.out is not -- Cort
if [ "$CONFIG_PROC_FS" = "y" ]; then
   define_bool CONFIG_KCORE_ELF y
fi

bool 'Kernel support for 64-bit ELF binaries' CONFIG_BINFMT_ELF

tristate 'Kernel support for 32-bit ELF binaries' CONFIG_BINFMT_ELF32

tristate 'Kernel support for MISC binaries' CONFIG_BINFMT_MISC

source drivers/pci/Config.in

bool 'Support for hot-pluggable devices' CONFIG_HOTPLUG

if [ "$CONFIG_HOTPLUG" = "y" ]; then
   source drivers/pcmcia/Config.in
   source drivers/hotplug/Config.in
else
   define_bool CONFIG_PCMCIA n
   define_bool CONFIG_HOTPLUG_PCI n
fi

if [ "$CONFIG_PPC_ISERIES" != "y" ]; then
   bool 'Support for Open Firmware device tree in /proc' CONFIG_PROC_DEVICETREE

   bool 'Default bootloader kernel arguments' CONFIG_CMDLINE_BOOL
   if [ "$CONFIG_CMDLINE_BOOL" = "y" ] ; then
     string 'Initial kernel command string' CONFIG_CMDLINE "console=ttyS0,9600 console=tty0 root=/dev/sda2"
   fi
fi

endmenu

source drivers/mtd/Config.in
source drivers/parport/Config.in
source drivers/pnp/Config.in
source drivers/block/Config.in

mainmenu_option next_comment
comment 'ATA/ATAPI/MFM/RLL support'

tristate 'ATA/ATAPI/MFM/RLL support' CONFIG_IDE

if [ "$CONFIG_IDE" != "n" ]; then
  source drivers/ide/Config.in
else
  define_bool CONFIG_BLK_DEV_HD n
fi
endmenu

mainmenu_option next_comment
comment 'SCSI device support'
tristate 'SCSI device support' CONFIG_SCSI
if [ "$CONFIG_SCSI" != "n" ]; then
   source drivers/scsi/Config.in
fi
endmenu

source drivers/md/Config.in

source drivers/message/fusion/Config.in

source drivers/ieee1394/Config.in

source drivers/message/i2o/Config.in

if [ "$CONFIG_NET" = "y" ]; then
   source net/Config.in

   mainmenu_option next_comment
   comment 'Network device support'

   bool 'Network device support' CONFIG_NETDEVICES
   if [ "$CONFIG_NETDEVICES" = "y" ]; then
      source drivers/net/Config.in
      if [ "$CONFIG_ATM" = "y" ]; then
         source drivers/atm/Config.in
      fi
   fi
   endmenu
fi

source net/ax25/Config.in

source net/irda/Config.in

source drivers/isdn/Config.in

source drivers/telephony/Config.in

#
# input before char - char/joystick depends on it. As does USB.
#
source drivers/input/Config.in

source drivers/char/Config.in

source drivers/media/Config.in

source fs/Config.in

if [ "$CONFIG_VT" = "y" ]; then
   mainmenu_option next_comment
   comment 'Console drivers'
   source drivers/video/Config.in
   endmenu
fi

mainmenu_option next_comment
comment 'Sound'
tristate 'Sound card support' CONFIG_SOUND
if [ "$CONFIG_SOUND" != "n" ]; then
   source sound/Config.in
fi

endmenu

source drivers/usb/Config.in

source net/bluetooth/Config.in

if [ "$CONFIG_PPC_ISERIES" = "y" ]; then
mainmenu_option next_comment
comment 'iSeries device drivers'
   tristate 'iSeries Virtual Console Support' CONFIG_VIOCONS
   tristate 'iSeries Virtual I/O disk support' CONFIG_VIODASD
   if [ "$CONFIG_VIODASD" = "y" -o "$CONFIG_VIODASD" = "m" ]; then
      bool 'iSeries Virtual disk IDE emulation' CONFIG_VIODASD_IDE
   fi
   tristate 'iSeries Virtual I/O CD support' CONFIG_VIOCD
   if [ "$CONFIG_VIOCD" = "y" -o "$CONFIG_VIOCD" = "m" ]; then
      bool 'iSeries Virtual CD Aztech emulation' CONFIG_VIOCD_AZTECH
   fi
   tristate 'iSeries Virtual Tape Support' CONFIG_VIOTAPE
   tristate 'iSeries Virtual Ethernet driver support' CONFIG_VETH
endmenu

   define_bool CONFIG_VIOPATH y
fi

mainmenu_option next_comment
comment 'Kernel hacking'

bool 'Kernel debugging' CONFIG_DEBUG_KERNEL
if [ "$CONFIG_DEBUG_KERNEL" != "n" ]; then
   bool '  Debug memory allocations' CONFIG_DEBUG_SLAB
   bool '  Magic SysRq key' CONFIG_MAGIC_SYSRQ
   bool '  Include xmon kernel debugger' CONFIG_XMON
   if [ "$CONFIG_XMON" = "y" ]; then
      bool '  Enable xmon by default' CONFIG_XMON_DEFAULT
   fi
   bool '  Include PPCDBG realtime debugging' CONFIG_PPCDBG
fi
endmenu

source security/Config.in
source lib/Config.in
```
