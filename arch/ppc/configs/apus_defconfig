## arch/ppc/platforms/4xx/Kconfig
```kconfig
config 4xx
	bool
	depends on 40x || 44x
	default y

menu "IBM 4xx options"
	depends on 4xx

choice
	prompt "Machine Type"
	depends on 40x
	default WALNUT

config ASH
	bool "Ash"

config BEECH
	bool "Beech"

config CEDAR
	bool "Cedar"

config CPCI405
	bool "CPCI405"

config EP405
	bool "EP405/EP405PC"

config OAK
	bool "Oak"
	help
	  Select Oak if you have an IBM 403GCX "Oak" Evaluation Board.

	  Select Walnut if you have an IBM 405GP "Walnut" Evaluation Board.

	  More information on these boards is available at:
	  <http://www.chips.ibm.com/products/powerpc/tools/evk_pn.html#GCX>.

config REDWOOD_4
	bool "Redwood-4"

config REDWOOD_5
	bool "Redwood-5"

config REDWOOD_6
	bool "Redwood-6"

config SYCAMORE
	bool "Sycamore"

config TIVO
	bool "Tivo"

config WALNUT
	bool "Walnut"
	help
	  Select Walnut if you have an IBM 405GP "Walnut" Evaluation Board.

endchoice

choice
	prompt "Machine Type"
	depends on 44x
	default EBONY

config EBONY
	bool "Ebony"
	help
	  This option enables support for the IBM PPC440GP evaluation board.

config OCOTEA
	bool "Ocotea"
	help
	  This option enables support for the IBM PPC440GX evaluation board.

endchoice

config EP405PC
	bool "EP405PC Support"
	depends on EP405


# It's often necessary to know the specific 4xx processor type.
# Fortunately, it is impled (so far) from the board type, so we
# don't need to ask more redundant questions.
config NP405H
	bool
	depends on ASH
	default y

config 440GP
	bool
	depends on EBONY
	default y

config 440GX
	bool
	depends on OCOTEA
	default y

config 440
	bool
	depends on 440GP
	default y

config 440A
	bool
	depends on 440GX
	default y

# All 405-based cores up until the 405GPR and 405EP have this errata.
config IBM405_ERR77
	bool
	depends on 40x && !403GCX && !405GPR
	default y

# All 40x-based cores, up until the 405GPR and 405EP have this errata.
config IBM405_ERR51
	bool
	depends on 40x && !405GPR
	default y


config PIN_TLB
	bool
	depends on 44x
	default y

config BOOKE
	bool
	depends on 44x
	default y

config IBM_OCP
	bool
	depends on ASH || BEECH || CEDAR || CPCI405 || EBONY || EP405 || OCOTEA || REDWOOD_4 || REDWOOD_5 || REDWOOD_6 || SYCAMORE || WALNUT
	default y

config IBM_EMAC4
	bool
	depends on 440GX
	default y

config NP405L
	bool
	depends on CEDAR
	default y

config BIOS_FIXUP
	bool
	depends on CEDAR || EP405 || SYCAMORE || WALNUT
	default y

config 403GCX
	bool
	depends OAK || TIVO
	default y

config 405GP
	bool
	depends on CPCI405 || EP405 || WALNUT
	default y

config 405GPR
	bool
	depends on SYCAMORE

config 405LP
	bool
	depends on CEDAR

config STB03xxx
	bool
	depends on REDWOOD_5 || REDWOOD_4 || REDWOOD_6
	default y

config EMBEDDEDBOOT
	bool
	depends on EP405
	default y

config IBM_OPENBIOS
	bool
	depends on ASH || BEECH || CEDAR || REDWOOD_4 || REDWOOD_5 || REDWOOD_6 || SYCAMORE || WALNUT
	default y

config 405_DMA
	bool "Blue Logic DMA"
	depends on 40x

config PM
	bool "Power Management support (EXPERIMENTAL)"
	depends on 4xx && EXPERIMENTAL

choice
	prompt "TTYS0 device and default console"
	depends on 40x
	default UART0_TTYS0

config UART0_TTYS0
	bool "UART0"

config UART0_TTYS1
	bool "UART1"

endchoice

config SERIAL_SICC
	bool "SICC Serial port support"
	depends on STB03xxx

config UART1_DFLT_CONSOLE
	bool
	depends on SERIAL_SICC && UART0_TTYS1
	default y

config SERIAL_SICC_CONSOLE
	bool
	depends on SERIAL_SICC && UART0_TTYS1
	default y
endmenu
```

## arch/ppc/platforms/85xx/Kconfig
```kconfig
config 85xx
	bool
	depends on E500
	default y

config PPC_INDIRECT_PCI_BE
	bool
	depends on 85xx
	default y

menu "Freescale 85xx options"
	depends on E500

choice
	prompt "Machine Type"
	depends on 85xx
	default MPC8540_ADS

config MPC8540_ADS
	bool "MPC8540ADS"
	help
	  This option enables support for the MPC 8540 ADS evaluation board.

endchoice

# It's often necessary to know the specific 85xx processor type.
# Fortunately, it is implied (so far) from the board type, so we
# don't need to ask more redundant questions.
config MPC8540
	bool
	depends on MPC8540_ADS
	default y

config FSL_OCP
	bool
	depends on 85xx
	default y

config PPC_GEN550
	bool
	depends on MPC8540
	default y

endmenu
```

## arch/ppc64/Kconfig
```kconfig
# 
# For a description of the syntax of this configuration file,
# see Documentation/kbuild/kconfig-language.txt.
#

config 64BIT
	def_bool y

config MMU
	bool
	default y

config UID16
	bool

config RWSEM_GENERIC_SPINLOCK
	bool

config RWSEM_XCHGADD_ALGORITHM
	bool
	default y

config GENERIC_ISA_DMA
	bool
	default y

config HAVE_DEC_LOCK
	bool
	default y

config EARLY_PRINTK
	bool
	default y

config COMPAT
	bool
	default y

config FRAME_POINTER
	bool
	default y

# We optimistically allocate largepages from the VM, so make the limit
# large enough (16MB). This badly named config option is actually
# max order + 1
config FORCE_MAX_ZONEORDER
	int
	default "13"

source "init/Kconfig"


menu "Platform support"

choice
	prompt "Platform Type"
	default PPC_PSERIES

config PPC_ISERIES
	bool "iSeries"

config PPC_PSERIES
	bool "pSeries"

endchoice

config PPC
	bool
	default y

config PPC64
	bool
	default y

config SMP
	bool "Symmetric multi-processing support"
	---help---
	  This enables support for systems with more than one CPU. If you have
	  a system with only one CPU, say N. If you have a system with more
	  than one CPU, say Y.

	  If you say N here, the kernel will run on single and multiprocessor
	  machines, but will use only one CPU of a multiprocessor machine. If
	  you say Y here, the kernel will run on single-processor machines.
	  On a single-processor machine, the kernel will run faster if you say
	  N here.

	  If you don't know what to do here, say Y.

config IRQ_ALL_CPUS
	bool "Distribute interrupts on all CPUs by default"
	depends on SMP && PPC_PSERIES
	help
	  This option gives the kernel permission to distribute IRQs across
	  multiple CPUs.  Saying N here will route all IRQs to the first
	  CPU.

config NR_CPUS
	int "Maximum number of CPUs (2-128)"
	depends on SMP
	default "32"

config HMT
	bool "Hardware multithreading"
	depends on SMP && PPC_PSERIES

config DISCONTIGMEM
	bool "Discontiguous Memory Support"
	depends on SMP && PPC_PSERIES

config NUMA
	bool "NUMA support"
	depends on DISCONTIGMEM

config PREEMPT
	bool
	help
	  This option reduces the latency of the kernel when reacting to
	  real-time or interactive events by allowing a low priority process to
	  be preempted even if it is in kernel mode executing a system call.
	  Unfortunately the kernel code has some race conditions if both
	  CONFIG_SMP and CONFIG_PREEMPT are enabled, so this option is
	  currently disabled if you are building an SMP kernel.

	  Say Y here if you are building a kernel for a desktop, embedded
	  or real-time system.  Say N if you are unsure.

config MSCHUNKS
	bool
	depends on PPC_ISERIES
	default y

config RTAS_FLASH
	tristate "Firmware flash interface"
	depends on !PPC_ISERIES

config SCANLOG
	tristate "Scanlog dump interface"
	depends on !PPC_ISERIES

config PPC_RTAS
	bool "Proc interface to RTAS"
	depends on !PPC_ISERIES

endmenu


menu "General setup"

config ISA
	bool
	help
	  Find out whether you have ISA slots on your motherboard.  ISA is the
	  name of a bus system, i.e. the way the CPU talks to the other stuff
	  inside your box.  If you have an Apple machine, say N here; if you
	  have an IBM RS/6000 or pSeries machine or a PReP machine, say Y.  If
	  you have an embedded board, consult your board documentation.

config SBUS
	bool

config MCA
	bool

config EISA
	bool

config PCI
	bool
	default y
	help
	  Find out whether your system includes a PCI bus. PCI is the name of
	  a bus system, i.e. the way the CPU talks to the other stuff inside
	  your box.  If you say Y here, the kernel will include drivers and
	  infrastructure code to support PCI bus devices.

config PCI_DOMAINS
	bool
	default PCI

source "fs/Kconfig.binfmt"

source "drivers/pci/Kconfig"

config HOTPLUG
	bool "Support for hot-pluggable devices"
	---help---
	  Say Y here if you want to plug devices into your computer while
	  the system is running, and be able to use them quickly.  In many
	  cases, the devices can likewise be unplugged at any time too.

	  One well known example of this is PCMCIA- or PC-cards, credit-card
	  size devices such as network cards, modems or hard drives which are
	  plugged into slots found on all modern laptop computers.  Another
	  example, used on modern desktops as well as laptops, is USB.

	  Enable HOTPLUG and KMOD, and build a modular kernel.  Get agent
	  software (at <http://linux-hotplug.sourceforge.net/>) and install it.
	  Then your kernel will automatically call out to a user mode "policy
	  agent" (/sbin/hotplug) to load modules and set up software needed
	  to use devices as you hotplug them.

source "drivers/pcmcia/Kconfig"

source "drivers/pci/hotplug/Kconfig"

config PROC_DEVICETREE
	bool "Support for Open Firmware device tree in /proc"
	depends on !PPC_ISERIES
	help
	  This option adds a device-tree directory under /proc which contains
	  an image of the device tree that the kernel copies from Open
	  Firmware. If unsure, say Y here.

config CMDLINE_BOOL
	bool "Default bootloader kernel arguments"
	depends on !PPC_ISERIES

config CMDLINE
	string "Initial kernel command string"
	depends on CMDLINE_BOOL
	default "console=ttyS0,9600 console=tty0 root=/dev/sda2"
	help
	  On some platforms, there is currently no way for the boot loader to
	  pass arguments to the kernel. For these platforms, you can supply
	  some command-line options at build time by entering them here.  In
	  most cases you will need to specify the root device here.

endmenu

source "drivers/base/Kconfig"

source "drivers/mtd/Kconfig"

source "drivers/parport/Kconfig"

source "drivers/pnp/Kconfig"

source "drivers/block/Kconfig"

source "drivers/ide/Kconfig"

source "drivers/scsi/Kconfig"

source "drivers/md/Kconfig"

source "drivers/message/fusion/Kconfig"

source "drivers/ieee1394/Kconfig"

source "drivers/message/i2o/Kconfig"

source "net/Kconfig"

source "drivers/isdn/Kconfig"

source "drivers/telephony/Kconfig"

#
# input before char - char/joystick depends on it. As does USB.
#
source "drivers/input/Kconfig"

source "drivers/char/Kconfig"

source "drivers/media/Kconfig"

source "fs/Kconfig"

source "drivers/video/Kconfig"

source "sound/Kconfig"

source "drivers/usb/Kconfig"


menu "iSeries device drivers"
	depends on PPC_ISERIES

config VIOCONS
	tristate "iSeries Virtual Console Support"

config VIODASD
	tristate "iSeries Virtual I/O disk support"
	help
	  If you are running on an iSeries system and you want to use
 	  virtual disks created and managed by OS/400, say Y.

config VIODASD_IDE
	bool "iSeries Virtual disk IDE emulation"
	depends on VIODASD
	help
	  This causes the iSeries virtual disks to look like IDE disks.
	  If you have programs or utilities that only support certain
	  kinds of disks, this option will cause iSeries virtual disks
	  to pretend to be IDE disks, which may satisfy the program.

config VIOCD
	tristate "iSeries Virtual I/O CD support"
	help
	  If you are running Linux on an IBM iSeries system and you want to
	  read a CD drive owned by OS/400, say Y here.

config VIOCD_AZTECH
	bool "iSeries Virtual CD Aztech emulation"
	depends on VIOCD

config VIOTAPE
	tristate "iSeries Virtual Tape Support"
	help
	  If you are running Linux on an iSeries system and you want Linux
	  to read and/or write a tape drive owned by OS/400, say Y here.

config VETH
	tristate "iSeries Virtual Ethernet driver support"

endmenu

config VIOPATH
	bool
	depends on PPC_ISERIES
	default y

source "arch/ppc64/oprofile/Kconfig"

menu "Kernel hacking"

config DEBUG_KERNEL
	bool "Kernel debugging"
	help
	  Say Y here if you are developing drivers or trying to debug and
	  identify kernel problems.

config DEBUG_SLAB
	bool "Debug memory allocations"
	depends on DEBUG_KERNEL
	help
	  Say Y here to have the kernel do limited verification on memory
	  allocation as well as poisoning memory on free to catch use of freed
	  memory.

config MAGIC_SYSRQ
	bool "Magic SysRq key"
	depends on DEBUG_KERNEL
	help
	  If you say Y here, you will have some control over the system even
	  if the system crashes for example during kernel debugging (e.g., you
	  will be able to flush the buffer cache to disk, reboot the system
	  immediately or dump some status information). This is accomplished
	  by pressing various keys while holding SysRq (Alt+PrintScreen). It
	  also works on a serial console (on PC hardware at least), if you
	  send a BREAK and then within 5 seconds a command keypress. The
	  keys are documented in <file:Documentation/sysrq.txt>. Don't say Y
	  unless you really know what this hack does.

config XMON
	bool "Include xmon kernel debugger"
	depends on DEBUG_KERNEL
	help
	  Include in-kernel hooks for the xmon kernel monitor/debugger.
	  Unless you are intending to debug the kernel, say N here.

config XMON_DEFAULT
	bool "Enable xmon by default"
	depends on XMON

config PPCDBG
	bool "Include PPCDBG realtime debugging"
	depends on DEBUG_KERNEL

config DEBUG_INFO
	bool "Compile the kernel with debug info"
	depends on DEBUG_KERNEL
	help
          If you say Y here the resulting kernel image will include
	  debugging info resulting in a larger kernel image.
	  Say Y here only if you plan to use gdb to debug the kernel.
	  If you don't debug the kernel, you can say N.
	  
endmenu

source "security/Kconfig"

source "crypto/Kconfig"

source "lib/Kconfig"
```

## arch/ppc64/Kconfig.debug
```kconfig
menu "Kernel hacking"

source "lib/Kconfig.debug"

config DEBUG_STACKOVERFLOW
	bool "Check for stack overflows"
	depends on DEBUG_KERNEL

config DEBUG_STACK_USAGE
	bool "Stack utilization instrumentation"
	depends on DEBUG_KERNEL
	help
	  Enables the display of the minimum amount of free stack which each
	  task has ever had available in the sysrq-T and sysrq-P debug output.

	  This option will slow down process creation somewhat.

config DEBUGGER
	bool "Enable debugger hooks"
	depends on DEBUG_KERNEL
	help
	  Include in-kernel hooks for kernel debuggers. Unless you are
	  intending to debug the kernel, say N here.

config XMON
	bool "Include xmon kernel debugger"
	depends on DEBUGGER
	help
	  Include in-kernel hooks for the xmon kernel monitor/debugger.
	  Unless you are intending to debug the kernel, say N here.

config XMON_DEFAULT
	bool "Enable xmon by default"
	depends on XMON

config PPCDBG
	bool "Include PPCDBG realtime debugging"
	depends on DEBUG_KERNEL

config IRQSTACKS
	bool "Use separate kernel stacks when processing interrupts"
	help
	  If you say Y here the kernel will use separate kernel stacks
	  for handling hard and soft interrupts.  This can help avoid
	  overflowing the process kernel stacks.

endmenu
```
