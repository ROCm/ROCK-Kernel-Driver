## lib/Kconfig.statistic
```kconfig
config STATISTICS
	bool "Statistics infrastructure"
	depends on DEBUG_FS
	select SGRB
	help
	  The statistics infrastructure provides a debug-fs based user interface
	  for statistics of kernel components, that is, usually device drivers.
	  Statistics are available for components that have been instrumented to
	  feed data into the statistics infrastructure.
	  This feature is useful for performance measurements or performance
	  debugging.
	  If in doubt, say "N".
```

## lib/crypto/Kconfig
```kconfig
# SPDX-License-Identifier: GPL-2.0

comment "Crypto library routines"

config CRYPTO_LIB_ARC4
	tristate
```

## net/Config.in
```kconfig
#
# Network configuration
#
mainmenu_option next_comment
comment 'Networking options'
tristate 'Packet socket' CONFIG_PACKET
if [ "$CONFIG_PACKET" != "n" ]; then
   bool '  Packet socket: mmapped IO' CONFIG_PACKET_MMAP
fi

tristate 'Netlink device emulation' CONFIG_NETLINK_DEV

bool 'Network packet filtering (replaces ipchains)' CONFIG_NETFILTER
if [ "$CONFIG_NETFILTER" = "y" ]; then
   bool '  Network packet filtering debugging' CONFIG_NETFILTER_DEBUG
fi
bool 'Socket Filtering'  CONFIG_FILTER
tristate 'Unix domain sockets' CONFIG_UNIX
bool 'TCP/IP networking' CONFIG_INET
if [ "$CONFIG_INET" = "y" ]; then
   source net/ipv4/Config.in
   if [ "$CONFIG_EXPERIMENTAL" = "y" ]; then
#   IPv6 as module will cause a CRASH if you try to unload it
      tristate '  The IPv6 protocol (EXPERIMENTAL)' CONFIG_IPV6
      if [ "$CONFIG_IPV6" != "n" ]; then
	 source net/ipv6/Config.in
      fi
   fi
   if [ "$CONFIG_EXPERIMENTAL" = "y" ]; then
      source net/sctp/Config.in
   fi
fi
if [ "$CONFIG_EXPERIMENTAL" = "y" ]; then
   bool 'Asynchronous Transfer Mode (ATM) (EXPERIMENTAL)' CONFIG_ATM
   if [ "$CONFIG_ATM" = "y" ]; then
      if [ "$CONFIG_INET" = "y" ]; then
	 bool '  Classical IP over ATM (EXPERIMENTAL)' CONFIG_ATM_CLIP
	 if [ "$CONFIG_ATM_CLIP" = "y" ]; then
	    bool '    Do NOT send ICMP if no neighbour (EXPERIMENTAL)' CONFIG_ATM_CLIP_NO_ICMP
	 fi
      fi
      tristate '  LAN Emulation (LANE) support (EXPERIMENTAL)' CONFIG_ATM_LANE
      if [ "$CONFIG_INET" = "y" -a "$CONFIG_ATM_LANE" != "n" ]; then
	 tristate '    Multi-Protocol Over ATM (MPOA) support (EXPERIMENTAL)' CONFIG_ATM_MPOA
      fi
   fi
fi
tristate '802.1Q VLAN Support' CONFIG_VLAN_8021Q

tristate 'ANSI/IEEE 802.2 Data link layer protocol' CONFIG_LLC
if [ "$CONFIG_LLC" != "n" ]; then
   tristate '  LLC sockets interface' CONFIG_LLC_UI
fi

dep_tristate 'The IPX protocol' CONFIG_IPX $CONFIG_LLC
if [ "$CONFIG_IPX" != "n" ]; then
   source net/ipx/Config.in
fi

dep_tristate 'Appletalk protocol support' CONFIG_ATALK $CONFIG_LLC
source drivers/net/appletalk/Config.in

tristate 'DECnet Support' CONFIG_DECNET
if [ "$CONFIG_DECNET" != "n" ]; then
   source net/decnet/Config.in
fi
dep_tristate '802.1d Ethernet Bridging' CONFIG_BRIDGE $CONFIG_INET
if [ "$CONFIG_BRIDGE" != "n" -a "$CONFIG_NETFILTER" != "n" ]; then
   source net/bridge/netfilter/Config.in
fi
if [ "$CONFIG_EXPERIMENTAL" = "y" ]; then
   tristate 'CCITT X.25 Packet Layer (EXPERIMENTAL)' CONFIG_X25
   tristate 'LAPB Data Link Driver (EXPERIMENTAL)' CONFIG_LAPB
   bool 'Frame Diverter (EXPERIMENTAL)' CONFIG_NET_DIVERT
   if [ "$CONFIG_INET" = "y" ]; then
      tristate 'Acorn Econet/AUN protocols (EXPERIMENTAL)' CONFIG_ECONET
      if [ "$CONFIG_ECONET" != "n" ]; then
	 bool '  AUN over UDP' CONFIG_ECONET_AUNUDP
	 bool '  Native Econet' CONFIG_ECONET_NATIVE
      fi
   fi
   tristate 'WAN router' CONFIG_WAN_ROUTER
   bool 'Fast switching (read help!)' CONFIG_NET_FASTROUTE
   bool 'Forwarding between high speed interfaces' CONFIG_NET_HW_FLOWCONTROL
fi

mainmenu_option next_comment
comment 'QoS and/or fair queueing'
bool 'QoS and/or fair queueing' CONFIG_NET_SCHED
if [ "$CONFIG_NET_SCHED" = "y" ]; then
   source net/sched/Config.in
fi
#bool 'Network code profiler' CONFIG_NET_PROFILE
endmenu

endmenu
```

## net/bluetooth/Config.in
```kconfig
#
# Bluetooth subsystem configuration
#

if [ "$CONFIG_NET" != "n" ]; then

   mainmenu_option next_comment
   comment 'Bluetooth support'
   dep_tristate 'Bluetooth subsystem support' CONFIG_BT $CONFIG_NET

   if [ "$CONFIG_BT" != "n" ]; then
      dep_tristate 'L2CAP protocol support' CONFIG_BT_L2CAP $CONFIG_BT
      dep_tristate 'SCO links support' CONFIG_BT_SCO $CONFIG_BT
      source net/bluetooth/rfcomm/Config.in
      source net/bluetooth/bnep/Config.in
      source drivers/bluetooth/Config.in
   fi

   endmenu
fi
```

## net/bridge/netfilter/Kconfig
```kconfig
#
# Bridge netfilter configuration
#
config BRIDGE_NF_EBTABLES
	tristate "Bridge: ebtables"
	depends on NETFILTER && BRIDGE

config BRIDGE_EBT_T_FILTER
	tristate "ebt: filter table support"
	depends on BRIDGE_NF_EBTABLES
	help
	  The ebtables filter table is used to define frame filtering rules at
	  local input, forwarding and local output. See the man page for
	  ebtables(8).

	  If you want to compile it as a module, say M here and read
	  <file:Documentation/modules.txt>.  If unsure, say `N'.

config BRIDGE_EBT_T_NAT
	tristate "ebt: nat table support"
	depends on BRIDGE_NF_EBTABLES
	help
	  The ebtables nat table is used to define rules that alter the MAC
	  source address (MAC SNAT) or the MAC destination address (MAC DNAT).
	  See the man page for ebtables(8).

	  If you want to compile it as a module, say M here and read
	  <file:Documentation/modules.txt>.  If unsure, say `N'.

config BRIDGE_EBT_BROUTE
	tristate "ebt: broute table support"
	depends on BRIDGE_NF_EBTABLES
	help
	  The ebtables broute table is used to define rules that decide between
	  bridging and routing frames, giving Linux the functionality of a
	  brouter. See the man page for ebtables(8) and examples on the ebtables
	  website.

	  If you want to compile it as a module, say M here and read
	  <file:Documentation/modules.txt>.  If unsure, say `N'.

config BRIDGE_EBT_LOG
	tristate "ebt: log support"
	depends on BRIDGE_NF_EBTABLES
	help
	  This option adds the log target, that you can use in any rule in
	  any ebtables table. It records the frame header to the syslog.

	  If you want to compile it as a module, say M here and read
	  <file:Documentation/modules.txt>.  If unsure, say `N'.

config BRIDGE_EBT_IP
	tristate "ebt: IP filter support"
	depends on BRIDGE_NF_EBTABLES
	help
	  This option adds the IP match, which allows basic IP header field
	  filtering.

	  If you want to compile it as a module, say M here and read
	  <file:Documentation/modules.txt>.  If unsure, say `N'.

config BRIDGE_EBT_ARP
	tristate "ebt: ARP filter support"
	depends on BRIDGE_NF_EBTABLES
	help
	  This option adds the ARP match, which allows ARP and RARP header field
	  filtering.

	  If you want to compile it as a module, say M here and read
	  <file:Documentation/modules.txt>.  If unsure, say `N'.

config BRIDGE_EBT_VLAN
	tristate "ebt: 802.1Q VLAN filter support"
	depends on BRIDGE_NF_EBTABLES
	help
	  This option adds the 802.1Q vlan match, which allows the filtering of
	  802.1Q vlan fields.

	  If you want to compile it as a module, say M here and read
	  <file:Documentation/modules.txt>.  If unsure, say `N'.

config BRIDGE_EBT_MARK
	tristate "ebt: mark filter support"
	depends on BRIDGE_NF_EBTABLES
	help
	  This option adds the mark match, which allows matching frames based on
	  the 'nfmark' value in the frame. This can be set by the mark target.
	  This value is the same as the one used in the iptables mark match and
	  target.

	  If you want to compile it as a module, say M here and read
	  <file:Documentation/modules.txt>.  If unsure, say `N'.

config BRIDGE_EBT_PKTTYPE
	tristate "ebt: packet type filter support"
	depends on BRIDGE_NF_EBTABLES
	help
	  This option adds the packet type match, which allows matching on the
	  type of packet based on its Ethernet "class" (as determined by
	  the generic networking code): broadcast, multicast,
	  for this host alone or for another host.

	  If you want to compile it as a module, say M here and read
	  <file:Documentation/modules.txt>.  If unsure, say `N'.

config BRIDGE_EBT_SNAT
	tristate "ebt: snat target support"
	depends on BRIDGE_NF_EBTABLES
	help
	  This option adds the MAC SNAT target, which allows altering the MAC
	  source address of frames.

	  If you want to compile it as a module, say M here and read
	  <file:Documentation/modules.txt>.  If unsure, say `N'.

config BRIDGE_EBT_DNAT
	tristate "ebt: dnat target support"
	depends on BRIDGE_NF_EBTABLES
	help
	  This option adds the MAC DNAT target, which allows altering the MAC
	  destination address of frames.

	  If you want to compile it as a module, say M here and read
	  <file:Documentation/modules.txt>.  If unsure, say `N'.

config BRIDGE_EBT_REDIRECT
	tristate "ebt: redirect target support"
	depends on BRIDGE_NF_EBTABLES
	help
	  This option adds the MAC redirect target, which allows altering the MAC
	  destination address of a frame to that of the device it arrived on.

	  If you want to compile it as a module, say M here and read
	  <file:Documentation/modules.txt>.  If unsure, say `N'.

config BRIDGE_EBT_MARK_T
	tristate "ebt: mark target support"
	depends on BRIDGE_NF_EBTABLES
	help
	  This option adds the mark target, which allows marking frames by
	  setting the 'nfmark' value in the frame.
	  This value is the same as the one used in the iptables mark match and
	  target.

	  If you want to compile it as a module, say M here and read
	  <file:Documentation/modules.txt>.  If unsure, say `N'.
```
