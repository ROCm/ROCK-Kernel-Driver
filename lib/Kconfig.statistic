## net/ipv6/Config.in
```kconfig
#
# IPv6 configuration
# 

if [ "$CONFIG_NETFILTER" != "n" ]; then
   source net/ipv6/netfilter/Config.in
fi
```

## net/ipv6/Kconfig
```kconfig
#
# IPv6 configuration
# 
config IPV6_SUBTREES
	bool "IPv6: Subtree support (EXPERIMENTAL)"
	depends on IPV6
	---help---
	  This is needed for Mobility to work correctly, when the home
	  address of the mobile node is used as it's source address,
	  the route lookup will find the tunnel device as it is first
	  doing a route lookup based on source address and then the
	  destination address.

config IPV6_PRIVACY
	bool "IPv6: Privacy Extensions (RFC 3041) support"
	depends on IPV6
	---help---
	  Privacy Extensions for Stateless Address Autoconfiguration in IPv6
	  support.  With this option, additional periodically-alter 
	  pseudo-random global-scope unicast address(es) will assigned to
	  your interface(s).
	
	  By default, kernel do not generate temporary addresses.
	  To use temporary addresses, do
	
	        echo 2 >/proc/sys/net/ipv6/conf/all/use_tempaddr 

	  See <file:Documentation/networking/ip-sysctl.txt> for details.

config IPV6_NDISC_NEW
	bool
	default y

config INET6_AH
	tristate "IPv6: AH transformation"
	depends on IPV6
	select XFRM
	select CRYPTO
	select CRYPTO_HMAC
	select CRYPTO_MD5
	select CRYPTO_SHA1
	---help---
	  Support for IPsec AH.

	  If unsure, say Y.

config INET6_ESP
	tristate "IPv6: ESP transformation"
	depends on IPV6
	select XFRM
	select CRYPTO
	select CRYPTO_HMAC
	select CRYPTO_MD5
	select CRYPTO_SHA1
	select CRYPTO_DES
	---help---
	  Support for IPsec ESP.

	  If unsure, say Y.

config INET6_IPCOMP
	tristate "IPv6: IPComp transformation"
	depends on IPV6
	select XFRM
	select CRYPTO
	select CRYPTO_DEFLATE
	---help---
	  Support for IP Paylod Compression (RFC3173), typically needed
	  for IPsec.

	  If unsure, say Y.

config IPV6_TUNNEL
	tristate "IPv6: IPv6-in-IPv6 tunnel (EXPERIMENTAL)"
	depends on IPV6
	---help---
	  Support for IPv6-in-IPv6 tunnels described in RFC 2473. This is
	  needed for mobility to work.

	  If unsure, say N.

source net/ipv6/mobile_ip6/Kconfig
```

## net/ipv6/mobile_ip6/Kconfig
```kconfig
#
# Mobile IPv6 Configuration
#
menu "MOBILE IPv6 (EXPERIMENTAL)"
        depends on IPV6 && NETFILTER && EXPERIMENTAL

config IPV6_MOBILITY
	tristate '    IPv6: Mobility Support (Correspondent Node)' 
	#depends on CONFIG_IPV6
	if IPV6_TUNNEL != "n"
		config IPV6_MOBILITY_MN
			tristate '      MIPv6: Mobile Node Support' 
			depends on IPV6_MOBILITY
		config IPV6_MOBILITY_HA
			tristate '      MIPv6: Home Agent Support'
			depends on IPV6_MOBILITY
		config IPV6_MOBILITY_DEBUG
			bool '      MIPv6: Debug messages' 
			depends on IPV6_MOBILITY
	endif
endmenu
```

## net/irda/Config.in
```kconfig
#
# IrDA protocol configuration
#

if [ "$CONFIG_NET" != "n" ]; then

   mainmenu_option next_comment
   comment 'IrDA (infrared) support'
   dep_tristate 'IrDA subsystem support' CONFIG_IRDA $CONFIG_NET

   if [ "$CONFIG_IRDA" != "n" ]; then
      comment 'IrDA protocols'
      source net/irda/irlan/Config.in
      source net/irda/irnet/Config.in
      source net/irda/ircomm/Config.in
      bool '  Ultra (connectionless) protocol' CONFIG_IRDA_ULTRA
      bool '  IrDA protocol options' CONFIG_IRDA_OPTIONS
      if [ "$CONFIG_IRDA_OPTIONS" != "n" ]; then
	 comment '  IrDA options'
	 bool '    Cache last LSAP' CONFIG_IRDA_CACHE_LAST_LSAP
	 bool '    Fast RRs' CONFIG_IRDA_FAST_RR
	 bool '    Debug information' CONFIG_IRDA_DEBUG
      fi
   fi

   if [ "$CONFIG_IRDA" != "n" ]; then
      source drivers/net/irda/Config.in
   fi
   endmenu
fi
```

## net/irda/ircomm/Kconfig
```kconfig
config IRCOMM
	tristate "IrCOMM protocol"
	depends on IRDA
	help
	  Say Y here if you want to build support for the IrCOMM protocol.  If
	  you want to compile it as a module (you will get ircomm and
	  ircomm-tty), say M here and read <file:Documentation/modules.txt>.
	  IrCOMM implements serial port emulation, and makes it possible to
	  use all existing applications that understands TTY's with an
	  infrared link.  Thus you should be able to use application like PPP,
	  minicom and others.  Enabling this option will create two modules
	  called ircomm and ircomm_tty.
```

## net/irda/irlan/Kconfig
```kconfig
config IRLAN
	tristate "IrLAN protocol"
	depends on IRDA
	help
	  Say Y here if you want to build support for the IrLAN protocol.  If
	  you want to compile it as a module (irlan), say M here and read
	  <file:Documentation/modules.txt>.  IrLAN emulates an Ethernet and
	  makes it possible to put up a wireless LAN using infrared beams.

	  The IrLAN protocol can be used to talk with infrared access points
	  like the HP NetbeamIR, or the ESI JetEye NET.  You can also connect
	  to another Linux machine running the IrLAN protocol for ad-hoc
	  networking!
```

## net/netfilter/Kconfig
```kconfig
#
# protocol independent part of netfilter configuration
#

menu "Generic Netfilter Configuration"
	depends on INET && NETFILTER

config NF_CONNTRACK
	tristate "Layer 3 Independent Connection tracking (EXPERIMENTAL)"
	depends on EXPERIMENTAL && NET
	default n
	---help---
	  Connection tracking keeps a record of what packets have passed
	  through your machine, in order to figure out how they are related
	  into connections.

	  Layer 3 independent connection tracking is experimental scheme
	  which generalize ip_conntrack to support other layer 3 protocols.

	  To compile it as a module, choose M here.  If unsure, say N.

config NF_CT_ACCT
	bool "Connection tracking flow accounting"
	depends on NF_CONNTRACK
	help
	  If this option is enabled, the connection tracking code will
	  keep per-flow packet and byte counters.

	  Those counters can be used for flow-based accounting or the
	  `connbytes' match.

	  If unsure, say `N'.

config NF_CONNTRACK_MARK
	bool  'Connection mark tracking support'
	depends on NF_CONNTRACK
	help
	  This option enables support for connection marks, used by the
	  `CONNMARK' target and `connmark' match. Similar to the mark value
	  of packets, but this mark value is kept in the conntrack session
	  instead of the individual packets.

config NF_CT_PROTO_SCTP
	tristate 'SCTP protocol on new connection tracking support (EXPERIMENTAL)'
	depends on EXPERIMENTAL && NF_CONNTRACK
	default n
	help
	  With this option enabled, the layer 3 independent connection
	  tracking code will be able to do state tracking on SCTP connections.

	  If you want to compile it as a module, say M here and read
	  Documentation/modules.txt.  If unsure, say `N'.

config NF_CONNTRACK_FTP
	tristate "FTP support on new connection tracking (EXPERIMENTAL)"
	depends on EXPERIMENTAL && NF_CONNTRACK
	help
	  Tracking FTP connections is problematic: special helpers are
	  required for tracking them, and doing masquerading and other forms
	  of Network Address Translation on them.

	  This is FTP support on Layer 3 independent connection tracking.
	  Layer 3 independent connection tracking is experimental scheme
	  which generalize ip_conntrack to support other layer 3 protocols.

	  To compile it as a module, choose M here.  If unsure, say N.

endmenu
```

## net/sctp/Kconfig
```kconfig
#
# SCTP configuration
#

menu "SCTP Configuration (EXPERIMENTAL)"
	depends on INET && EXPERIMENTAL

config IPV6_SCTP__
	tristate
	default y if IPV6=n
	default IPV6 if IPV6

config IP_SCTP
	tristate "The SCTP Protocol (EXPERIMENTAL)"
	depends on IPV6_SCTP__
	---help---
	  Stream Control Transmission Protocol

	  From RFC 2960 (http://www.ietf.org/rfc/rfc2960.txt)

	  "SCTP is a reliable transport protocol operating on top of a
	  connectionless packet network such as IP.  It offers the following
	  services to its users:

	  -- acknowledged error-free non-duplicated transfer of user data,
	  -- data fragmentation to conform to discovered path MTU size,
	  -- sequenced delivery of user messages within multiple streams,
	  with an option for order-of-arrival delivery of individual user
	  messages,
	  -- optional bundling of multiple user messages into a single SCTP
	  packet, and
	  -- network-level fault tolerance through supporting of multi-
	  homing at either or both ends of an association."

	  To compile this protocol support as a module, choose M here: the
	  module will be called sctp.

	  If in doubt, say N.

config SCTP_ADLER32
	bool "SCTP: Use old checksum (Adler-32)"
	depends on IP_SCTP
	help
	  RFC2960 currently specifies the Adler-32 checksum algorithm for SCTP.
	  This has been deprecated and replaced by an algorithm now referred
	  to as crc32c.

	  If you say Y, this will use the Adler-32 algorithm, this might be 
	  useful for interoperation with downlevel peers. 

	  If unsure, say N.  

config SCTP_DBG_MSG
	bool "SCTP: Debug messages"
	depends on IP_SCTP
	help
	  If you say Y, this will enable verbose debugging messages. 

	  If unsure, say N.  However, if you are running into problems, use 
	  this option to gather detailed trace information

config SCTP_DBG_OBJCNT
	bool "SCTP: Debug object counts"
	depends on IP_SCTP
	help
	  If you say Y, this will enable debugging support for counting the 
	  type of objects that are currently allocated.  This is useful for 
	  identifying memory leaks.   If the /proc filesystem is enabled this 
	  debug information can be viewed by 
	  'cat /proc/net/sctp/sctp_dbg_objcnt'

	  If unsure, say N

choice
	prompt "SCTP: Cookie HMAC Algorithm"
	depends on IP_SCTP
	help
	  HMAC algorithm to be used during association initialization.  It
	  is strongly recommended to use HMAC-SHA1 or HMAC-MD5.  See 
	  configuration for Cryptographic API and enable those algorithms
          to make usable by SCTP. 

config SCTP_HMAC_NONE
	bool "None"
	help 
	  Choosing this disables the use of an HMAC during association 
	  establishment.  It is advised to use either HMAC-MD5 or HMAC-SHA1.

config SCTP_HMAC_SHA1
	bool "HMAC-SHA1" if CRYPTO_HMAC=y && CRYPTO_SHA1=y || CRYPTO_SHA1=m
	help 
	  Enable the use of HMAC-SHA1 during association establishment.  It 
	  is advised to use either HMAC-MD5 or HMAC-SHA1.

config SCTP_HMAC_MD5
	bool "HMAC-MD5" if CRYPTO_HMAC=y && CRYPTO_MD5=y || CRYPTO_MD5=m
	help
	  Enable the use of HMAC-MD5 during association establishment.  It is 
	  advised to use either HMAC-MD5 or HMAC-SHA1.

endchoice
endmenu
```

## net/xfrm/Kconfig
```kconfig
#
# XFRM configuration
#
config XFRM
       bool
       depends on NET

config XFRM_USER
	tristate "IPsec user configuration interface"
	depends on INET && XFRM
	---help---
	  Support for IPsec user configuration interface used
	  by native Linux tools.

	  If unsure, say Y.
```

## rpmify/Kconfig
```kconfig
#
# Build options
#

menu "Build options"

config SUSE_KERNEL
	bool
	default y

config CFGNAME
	string "Configuration name"
	default ""
	help
	  The name of the kernel configuration used. The configuration
	  files provided in arch/$ARCH/defconfig.$CFGNAME set the
	  CONFIG_CFGNAME option to $CFGNAME. The configuration name is
	  part of the EXTRAVERSION.

config RELEASE
	string "Release number"
	default "0"
	help
	  The release number of the kernel sources. The configuration
	  files provided in arch/$ARCH/defconfig.$CFGNAME set the
	  CONFIG_RELEASE option to the RPM release number of the
	  kernel source package. The release number of the kernel
	  sources and of all binary kernel packages built from those
	  sources should be the same. The release number is part of
	  the EXTRAVERSION.

endmenu
```
